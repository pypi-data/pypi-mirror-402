/*
 * Interface wrapper code.
 *
 * Generated by SIP 6.15.1
 */

#include "sipAPI_propgrid.h"

        #include <wx/propgrid/props.h>

        #include <wx/window.h>
        #include <wx/propgrid/props.h>
        #include <wx/validate.h>
        #include <wx/window.h>
        #include <wx/gdicmn.h>
        #include <wx/gdicmn.h>
        #include <wx/event.h>
        #include <wx/dialog.h>
        #include <wx/iconbndl.h>
        #include <wx/icon.h>
        #include <wx/sizer.h>
        #include <wx/sizer.h>
        #include <wx/toplevel.h>
            #include <wx/toplevel.h>
        #include <wx/region.h>
        #include <wx/graphics.h>
        #include <wx/event.h>
    #include <wx/setup.h>
    #include "wxpy_api.h"
        #include <wx/event.h>
        #include <wx/cursor.h>
        #include <wx/caret.h>
        #include <wx/layout.h>
        #include <wx/dnd.h>
        #include <wx/access.h>
        #include <wx/accel.h>
        #include <wx/menu.h>
        #include <wx/tooltip.h>
        #include <wx/event.h>
        #include <wx/gdicmn.h>
        #include <wx/event.h>
        #include <wx/event.h>
        #include <wx/palette.h>
        #include <wx/colour.h>
        #include <wx/font.h>
        
        
        #include <wx/eventfilter.h>
        #include <wx/object.h>
        #include <wx/object.h>
        #include <wx/object.h>


class sipwxPGArrayStringEditorDialog : public ::wxPGArrayStringEditorDialog
{
public:
    sipwxPGArrayStringEditorDialog();
    virtual ~sipwxPGArrayStringEditorDialog();

    /*
     * There is a public method for every protected method visible from
     * this class.
     */
    void sipProtect_SendDestroyEvent();
    bool sipProtectVirt_ProcessEvent(bool, ::wxEvent&);
    void sipProtectVirt_DoEnable(bool, bool);
    void sipProtectVirt_DoGetPosition(bool, int*, int*) const;
    void sipProtectVirt_DoGetSize(bool, int*, int*) const;
    void sipProtectVirt_DoGetClientSize(bool, int*, int*) const;
    ::wxSize sipProtectVirt_DoGetBestSize(bool) const;
    ::wxSize sipProtectVirt_DoGetBestClientSize(bool) const;
    void sipProtectVirt_DoSetSize(bool, int, int, int, int, int);
    void sipProtectVirt_DoSetClientSize(bool, int, int);
    void sipProtectVirt_DoSetSizeHints(bool, int, int, int, int, int, int);
    ::wxSize sipProtectVirt_DoGetBorderSize(bool) const;
    void sipProtectVirt_DoMoveWindow(bool, int, int, int, int);
    void sipProtectVirt_DoSetWindowVariant(bool, ::wxWindowVariant);
    ::wxBorder sipProtectVirt_GetDefaultBorder(bool) const;
    ::wxBorder sipProtectVirt_GetDefaultBorderForControl(bool) const;
    void sipProtectVirt_DoFreeze(bool);
    void sipProtectVirt_DoThaw(bool);
    bool sipProtectVirt_HasTransparentBackground(bool);
    bool sipProtectVirt_TryBefore(bool, ::wxEvent&);
    bool sipProtectVirt_TryAfter(bool, ::wxEvent&);
    ::wxString sipProtectVirt_ArrayGet(bool, size_t);
    size_t sipProtectVirt_ArrayGetCount(bool);
    bool sipProtectVirt_ArrayInsert(bool, const ::wxString&, int);
    bool sipProtectVirt_ArraySet(bool, size_t, const ::wxString&);
    void sipProtectVirt_ArrayRemoveAt(bool, int);
    void sipProtectVirt_ArraySwap(bool, size_t, size_t);

    /*
     * There is a protected method for every virtual method visible from
     * this class.
     */
protected:
    ::wxWindow* GetContentWindow() const SIP_OVERRIDE;
    void RemoveChild(::wxWindowBase*) SIP_OVERRIDE;
    void AddChild(::wxWindowBase*) SIP_OVERRIDE;
    bool ProcessEvent(::wxEvent&) SIP_OVERRIDE;
    bool TryBefore(::wxEvent&) SIP_OVERRIDE;
    bool TryAfter(::wxEvent&) SIP_OVERRIDE;
    bool AcceptsFocus() const SIP_OVERRIDE;
    bool AcceptsFocusFromKeyboard() const SIP_OVERRIDE;
    bool AcceptsFocusRecursively() const SIP_OVERRIDE;
    void SetCanFocus(bool) SIP_OVERRIDE;
    void EnableVisibleFocus(bool) SIP_OVERRIDE;
    bool InformFirstDirection(int, int, int) SIP_OVERRIDE;
    ::wxPoint GetClientAreaOrigin() const SIP_OVERRIDE;
    bool HasTransparentBackground() SIP_OVERRIDE;
    bool ShouldInheritColours() const SIP_OVERRIDE;
    ::wxValidator* GetValidator() SIP_OVERRIDE;
    void SetValidator(const ::wxValidator&) SIP_OVERRIDE;
    bool TransferDataFromWindow() SIP_OVERRIDE;
    bool TransferDataToWindow() SIP_OVERRIDE;
    bool Validate() SIP_OVERRIDE;
    bool Destroy() SIP_OVERRIDE;
    void InheritAttributes() SIP_OVERRIDE;
    void InitDialog() SIP_OVERRIDE;
    void OnInternalIdle() SIP_OVERRIDE;
    ::wxWindow* GetMainWindowOfCompositeControl() SIP_OVERRIDE;
    void DoEnable(bool) SIP_OVERRIDE;
    void DoGetPosition(int*, int*) const SIP_OVERRIDE;
    void DoGetSize(int*, int*) const SIP_OVERRIDE;
    void DoGetClientSize(int*, int*) const SIP_OVERRIDE;
    void DoSetSize(int, int, int, int, int) SIP_OVERRIDE;
    void DoSetClientSize(int, int) SIP_OVERRIDE;
    void DoSetSizeHints(int, int, int, int, int, int) SIP_OVERRIDE;
    ::wxSize DoGetBorderSize() const SIP_OVERRIDE;
    void DoMoveWindow(int, int, int, int) SIP_OVERRIDE;
    void DoSetWindowVariant(::wxWindowVariant) SIP_OVERRIDE;
    ::wxBorder GetDefaultBorder() const SIP_OVERRIDE;
    ::wxBorder GetDefaultBorderForControl() const SIP_OVERRIDE;
    void DoFreeze() SIP_OVERRIDE;
    void DoThaw() SIP_OVERRIDE;
    ::wxSize DoGetBestSize() const SIP_OVERRIDE;
    ::wxSize DoGetBestClientSize() const SIP_OVERRIDE;
    bool ShouldPreventAppExit() const SIP_OVERRIDE;
    void SetDialogValue(const ::wxPGVariant&) SIP_OVERRIDE;
    ::wxPGVariant GetDialogValue() const SIP_OVERRIDE;
    ::wxValidator* GetTextCtrlValidator() const SIP_OVERRIDE;
    ::wxString ArrayGet(size_t) SIP_OVERRIDE;
    size_t ArrayGetCount() SIP_OVERRIDE;
    bool ArrayInsert(const ::wxString&, int) SIP_OVERRIDE;
    bool ArraySet(size_t, const ::wxString&) SIP_OVERRIDE;
    void ArrayRemoveAt(int) SIP_OVERRIDE;
    void ArraySwap(size_t, size_t) SIP_OVERRIDE;
    bool OnCustomNewAction(::wxString*) SIP_OVERRIDE;

public:
    sipSimpleWrapper *sipPySelf;

private:
    sipwxPGArrayStringEditorDialog(const sipwxPGArrayStringEditorDialog &);
    sipwxPGArrayStringEditorDialog &operator = (const sipwxPGArrayStringEditorDialog &);

    char sipPyMethods[52];
};

sipwxPGArrayStringEditorDialog::sipwxPGArrayStringEditorDialog(): ::wxPGArrayStringEditorDialog(), sipPySelf(SIP_NULLPTR)
{
    memset(sipPyMethods, 0, sizeof (sipPyMethods));
}

sipwxPGArrayStringEditorDialog::~sipwxPGArrayStringEditorDialog()
{
    sipInstanceDestroyedEx(&sipPySelf);
}

::wxWindow* sipwxPGArrayStringEditorDialog::GetContentWindow() const
{
    sip_gilstate_t sipGILState;
    PyObject *sipMeth;

    sipMeth = sipIsPyMethod(&sipGILState, const_cast<char *>(&sipPyMethods[0]), const_cast<sipSimpleWrapper **>(&sipPySelf), SIP_NULLPTR, sipName_GetContentWindow);

    if (!sipMeth)
        return ::wxPGArrayStringEditorDialog::GetContentWindow();

    extern ::wxWindow* sipVH__propgrid_45(sip_gilstate_t, sipVirtErrorHandlerFunc, sipSimpleWrapper *, PyObject *);

    return sipVH__propgrid_45(sipGILState, 0, sipPySelf, sipMeth);
}

void sipwxPGArrayStringEditorDialog::RemoveChild(::wxWindowBase*child)
{
    sip_gilstate_t sipGILState;
    PyObject *sipMeth;

    sipMeth = sipIsPyMethod(&sipGILState, &sipPyMethods[1], &sipPySelf, SIP_NULLPTR, sipName_RemoveChild);

    if (!sipMeth)
    {
        ::wxPGArrayStringEditorDialog::RemoveChild(child);
        return;
    }

    extern void sipVH__propgrid_50(sip_gilstate_t, sipVirtErrorHandlerFunc, sipSimpleWrapper *, PyObject *, ::wxWindowBase*);

    sipVH__propgrid_50(sipGILState, 0, sipPySelf, sipMeth, child);
}

void sipwxPGArrayStringEditorDialog::AddChild(::wxWindowBase*child)
{
    sip_gilstate_t sipGILState;
    PyObject *sipMeth;

    sipMeth = sipIsPyMethod(&sipGILState, &sipPyMethods[2], &sipPySelf, SIP_NULLPTR, sipName_AddChild);

    if (!sipMeth)
    {
        ::wxPGArrayStringEditorDialog::AddChild(child);
        return;
    }

    extern void sipVH__propgrid_50(sip_gilstate_t, sipVirtErrorHandlerFunc, sipSimpleWrapper *, PyObject *, ::wxWindowBase*);

    sipVH__propgrid_50(sipGILState, 0, sipPySelf, sipMeth, child);
}

bool sipwxPGArrayStringEditorDialog::ProcessEvent(::wxEvent& event)
{
    sip_gilstate_t sipGILState;
    PyObject *sipMeth;

    sipMeth = sipIsPyMethod(&sipGILState, &sipPyMethods[3], &sipPySelf, SIP_NULLPTR, sipName_ProcessEvent);

    if (!sipMeth)
        return ::wxPGArrayStringEditorDialog::ProcessEvent(event);

    extern bool sipVH__propgrid_49(sip_gilstate_t, sipVirtErrorHandlerFunc, sipSimpleWrapper *, PyObject *, ::wxEvent&);

    return sipVH__propgrid_49(sipGILState, 0, sipPySelf, sipMeth, event);
}

bool sipwxPGArrayStringEditorDialog::TryBefore(::wxEvent& event)
{
    sip_gilstate_t sipGILState;
    PyObject *sipMeth;

    sipMeth = sipIsPyMethod(&sipGILState, &sipPyMethods[4], &sipPySelf, SIP_NULLPTR, sipName_TryBefore);

    if (!sipMeth)
        return ::wxPGArrayStringEditorDialog::TryBefore(event);

    extern bool sipVH__propgrid_49(sip_gilstate_t, sipVirtErrorHandlerFunc, sipSimpleWrapper *, PyObject *, ::wxEvent&);

    return sipVH__propgrid_49(sipGILState, 0, sipPySelf, sipMeth, event);
}

bool sipwxPGArrayStringEditorDialog::TryAfter(::wxEvent& event)
{
    sip_gilstate_t sipGILState;
    PyObject *sipMeth;

    sipMeth = sipIsPyMethod(&sipGILState, &sipPyMethods[5], &sipPySelf, SIP_NULLPTR, sipName_TryAfter);

    if (!sipMeth)
        return ::wxPGArrayStringEditorDialog::TryAfter(event);

    extern bool sipVH__propgrid_49(sip_gilstate_t, sipVirtErrorHandlerFunc, sipSimpleWrapper *, PyObject *, ::wxEvent&);

    return sipVH__propgrid_49(sipGILState, 0, sipPySelf, sipMeth, event);
}

bool sipwxPGArrayStringEditorDialog::AcceptsFocus() const
{
    sip_gilstate_t sipGILState;
    PyObject *sipMeth;

    sipMeth = sipIsPyMethod(&sipGILState, const_cast<char *>(&sipPyMethods[6]), const_cast<sipSimpleWrapper **>(&sipPySelf), SIP_NULLPTR, sipName_AcceptsFocus);

    if (!sipMeth)
        return ::wxPGArrayStringEditorDialog::AcceptsFocus();

    extern bool sipVH__propgrid_33(sip_gilstate_t, sipVirtErrorHandlerFunc, sipSimpleWrapper *, PyObject *);

    return sipVH__propgrid_33(sipGILState, 0, sipPySelf, sipMeth);
}

bool sipwxPGArrayStringEditorDialog::AcceptsFocusFromKeyboard() const
{
    sip_gilstate_t sipGILState;
    PyObject *sipMeth;

    sipMeth = sipIsPyMethod(&sipGILState, const_cast<char *>(&sipPyMethods[7]), const_cast<sipSimpleWrapper **>(&sipPySelf), SIP_NULLPTR, sipName_AcceptsFocusFromKeyboard);

    if (!sipMeth)
        return ::wxPGArrayStringEditorDialog::AcceptsFocusFromKeyboard();

    extern bool sipVH__propgrid_33(sip_gilstate_t, sipVirtErrorHandlerFunc, sipSimpleWrapper *, PyObject *);

    return sipVH__propgrid_33(sipGILState, 0, sipPySelf, sipMeth);
}

bool sipwxPGArrayStringEditorDialog::AcceptsFocusRecursively() const
{
    sip_gilstate_t sipGILState;
    PyObject *sipMeth;

    sipMeth = sipIsPyMethod(&sipGILState, const_cast<char *>(&sipPyMethods[8]), const_cast<sipSimpleWrapper **>(&sipPySelf), SIP_NULLPTR, sipName_AcceptsFocusRecursively);

    if (!sipMeth)
        return ::wxPGArrayStringEditorDialog::AcceptsFocusRecursively();

    extern bool sipVH__propgrid_33(sip_gilstate_t, sipVirtErrorHandlerFunc, sipSimpleWrapper *, PyObject *);

    return sipVH__propgrid_33(sipGILState, 0, sipPySelf, sipMeth);
}

void sipwxPGArrayStringEditorDialog::SetCanFocus(bool canFocus)
{
    sip_gilstate_t sipGILState;
    PyObject *sipMeth;

    sipMeth = sipIsPyMethod(&sipGILState, &sipPyMethods[9], &sipPySelf, SIP_NULLPTR, sipName_SetCanFocus);

    if (!sipMeth)
    {
        ::wxPGArrayStringEditorDialog::SetCanFocus(canFocus);
        return;
    }

    extern void sipVH__propgrid_44(sip_gilstate_t, sipVirtErrorHandlerFunc, sipSimpleWrapper *, PyObject *, bool);

    sipVH__propgrid_44(sipGILState, 0, sipPySelf, sipMeth, canFocus);
}

void sipwxPGArrayStringEditorDialog::EnableVisibleFocus(bool enabled)
{
    sip_gilstate_t sipGILState;
    PyObject *sipMeth;

    sipMeth = sipIsPyMethod(&sipGILState, &sipPyMethods[10], &sipPySelf, SIP_NULLPTR, sipName_EnableVisibleFocus);

    if (!sipMeth)
    {
        ::wxPGArrayStringEditorDialog::EnableVisibleFocus(enabled);
        return;
    }

    extern void sipVH__propgrid_44(sip_gilstate_t, sipVirtErrorHandlerFunc, sipSimpleWrapper *, PyObject *, bool);

    sipVH__propgrid_44(sipGILState, 0, sipPySelf, sipMeth, enabled);
}

bool sipwxPGArrayStringEditorDialog::InformFirstDirection(int direction, int size, int availableOtherDir)
{
    sip_gilstate_t sipGILState;
    PyObject *sipMeth;

    sipMeth = sipIsPyMethod(&sipGILState, &sipPyMethods[11], &sipPySelf, SIP_NULLPTR, sipName_InformFirstDirection);

    if (!sipMeth)
        return ::wxPGArrayStringEditorDialog::InformFirstDirection(direction, size, availableOtherDir);

    extern bool sipVH__propgrid_48(sip_gilstate_t, sipVirtErrorHandlerFunc, sipSimpleWrapper *, PyObject *, int, int, int);

    return sipVH__propgrid_48(sipGILState, 0, sipPySelf, sipMeth, direction, size, availableOtherDir);
}

::wxPoint sipwxPGArrayStringEditorDialog::GetClientAreaOrigin() const
{
    sip_gilstate_t sipGILState;
    PyObject *sipMeth;

    sipMeth = sipIsPyMethod(&sipGILState, const_cast<char *>(&sipPyMethods[12]), const_cast<sipSimpleWrapper **>(&sipPySelf), SIP_NULLPTR, sipName_GetClientAreaOrigin);

    if (!sipMeth)
        return ::wxPGArrayStringEditorDialog::GetClientAreaOrigin();

    extern ::wxPoint sipVH__propgrid_47(sip_gilstate_t, sipVirtErrorHandlerFunc, sipSimpleWrapper *, PyObject *);

    return sipVH__propgrid_47(sipGILState, 0, sipPySelf, sipMeth);
}

bool sipwxPGArrayStringEditorDialog::HasTransparentBackground()
{
    sip_gilstate_t sipGILState;
    PyObject *sipMeth;

    sipMeth = sipIsPyMethod(&sipGILState, &sipPyMethods[13], &sipPySelf, SIP_NULLPTR, sipName_HasTransparentBackground);

    if (!sipMeth)
        return ::wxPGArrayStringEditorDialog::HasTransparentBackground();

    extern bool sipVH__propgrid_33(sip_gilstate_t, sipVirtErrorHandlerFunc, sipSimpleWrapper *, PyObject *);

    return sipVH__propgrid_33(sipGILState, 0, sipPySelf, sipMeth);
}

bool sipwxPGArrayStringEditorDialog::ShouldInheritColours() const
{
    sip_gilstate_t sipGILState;
    PyObject *sipMeth;

    sipMeth = sipIsPyMethod(&sipGILState, const_cast<char *>(&sipPyMethods[14]), const_cast<sipSimpleWrapper **>(&sipPySelf), SIP_NULLPTR, sipName_ShouldInheritColours);

    if (!sipMeth)
        return ::wxPGArrayStringEditorDialog::ShouldInheritColours();

    extern bool sipVH__propgrid_33(sip_gilstate_t, sipVirtErrorHandlerFunc, sipSimpleWrapper *, PyObject *);

    return sipVH__propgrid_33(sipGILState, 0, sipPySelf, sipMeth);
}

::wxValidator* sipwxPGArrayStringEditorDialog::GetValidator()
{
    sip_gilstate_t sipGILState;
    PyObject *sipMeth;

    sipMeth = sipIsPyMethod(&sipGILState, &sipPyMethods[15], &sipPySelf, SIP_NULLPTR, sipName_GetValidator);

    if (!sipMeth)
        return ::wxPGArrayStringEditorDialog::GetValidator();

    extern ::wxValidator* sipVH__propgrid_13(sip_gilstate_t, sipVirtErrorHandlerFunc, sipSimpleWrapper *, PyObject *);

    return sipVH__propgrid_13(sipGILState, 0, sipPySelf, sipMeth);
}

void sipwxPGArrayStringEditorDialog::SetValidator(const ::wxValidator& validator)
{
    sip_gilstate_t sipGILState;
    PyObject *sipMeth;

    sipMeth = sipIsPyMethod(&sipGILState, &sipPyMethods[16], &sipPySelf, SIP_NULLPTR, sipName_SetValidator);

    if (!sipMeth)
    {
        ::wxPGArrayStringEditorDialog::SetValidator(validator);
        return;
    }

    extern void sipVH__propgrid_46(sip_gilstate_t, sipVirtErrorHandlerFunc, sipSimpleWrapper *, PyObject *, const ::wxValidator&);

    sipVH__propgrid_46(sipGILState, 0, sipPySelf, sipMeth, validator);
}

bool sipwxPGArrayStringEditorDialog::TransferDataFromWindow()
{
    sip_gilstate_t sipGILState;
    PyObject *sipMeth;

    sipMeth = sipIsPyMethod(&sipGILState, &sipPyMethods[17], &sipPySelf, SIP_NULLPTR, sipName_TransferDataFromWindow);

    if (!sipMeth)
        return ::wxPGArrayStringEditorDialog::TransferDataFromWindow();

    extern bool sipVH__propgrid_33(sip_gilstate_t, sipVirtErrorHandlerFunc, sipSimpleWrapper *, PyObject *);

    return sipVH__propgrid_33(sipGILState, 0, sipPySelf, sipMeth);
}

bool sipwxPGArrayStringEditorDialog::TransferDataToWindow()
{
    sip_gilstate_t sipGILState;
    PyObject *sipMeth;

    sipMeth = sipIsPyMethod(&sipGILState, &sipPyMethods[18], &sipPySelf, SIP_NULLPTR, sipName_TransferDataToWindow);

    if (!sipMeth)
        return ::wxPGArrayStringEditorDialog::TransferDataToWindow();

    extern bool sipVH__propgrid_33(sip_gilstate_t, sipVirtErrorHandlerFunc, sipSimpleWrapper *, PyObject *);

    return sipVH__propgrid_33(sipGILState, 0, sipPySelf, sipMeth);
}

bool sipwxPGArrayStringEditorDialog::Validate()
{
    sip_gilstate_t sipGILState;
    PyObject *sipMeth;

    sipMeth = sipIsPyMethod(&sipGILState, &sipPyMethods[19], &sipPySelf, SIP_NULLPTR, sipName_Validate);

    if (!sipMeth)
        return ::wxPGArrayStringEditorDialog::Validate();

    extern bool sipVH__propgrid_33(sip_gilstate_t, sipVirtErrorHandlerFunc, sipSimpleWrapper *, PyObject *);

    return sipVH__propgrid_33(sipGILState, 0, sipPySelf, sipMeth);
}

bool sipwxPGArrayStringEditorDialog::Destroy()
{
    sip_gilstate_t sipGILState;
    PyObject *sipMeth;

    sipMeth = sipIsPyMethod(&sipGILState, &sipPyMethods[20], &sipPySelf, SIP_NULLPTR, sipName_Destroy);

    if (!sipMeth)
        return ::wxPGArrayStringEditorDialog::Destroy();

    extern bool sipVH__propgrid_33(sip_gilstate_t, sipVirtErrorHandlerFunc, sipSimpleWrapper *, PyObject *);

    return sipVH__propgrid_33(sipGILState, 0, sipPySelf, sipMeth);
}

void sipwxPGArrayStringEditorDialog::InheritAttributes()
{
    sip_gilstate_t sipGILState;
    PyObject *sipMeth;

    sipMeth = sipIsPyMethod(&sipGILState, &sipPyMethods[21], &sipPySelf, SIP_NULLPTR, sipName_InheritAttributes);

    if (!sipMeth)
    {
        ::wxPGArrayStringEditorDialog::InheritAttributes();
        return;
    }

    extern void sipVH__propgrid_3(sip_gilstate_t, sipVirtErrorHandlerFunc, sipSimpleWrapper *, PyObject *);

    sipVH__propgrid_3(sipGILState, 0, sipPySelf, sipMeth);
}

void sipwxPGArrayStringEditorDialog::InitDialog()
{
    sip_gilstate_t sipGILState;
    PyObject *sipMeth;

    sipMeth = sipIsPyMethod(&sipGILState, &sipPyMethods[22], &sipPySelf, SIP_NULLPTR, sipName_InitDialog);

    if (!sipMeth)
    {
        ::wxPGArrayStringEditorDialog::InitDialog();
        return;
    }

    extern void sipVH__propgrid_3(sip_gilstate_t, sipVirtErrorHandlerFunc, sipSimpleWrapper *, PyObject *);

    sipVH__propgrid_3(sipGILState, 0, sipPySelf, sipMeth);
}

void sipwxPGArrayStringEditorDialog::OnInternalIdle()
{
    sip_gilstate_t sipGILState;
    PyObject *sipMeth;

    sipMeth = sipIsPyMethod(&sipGILState, &sipPyMethods[23], &sipPySelf, SIP_NULLPTR, sipName_OnInternalIdle);

    if (!sipMeth)
    {
        ::wxPGArrayStringEditorDialog::OnInternalIdle();
        return;
    }

    extern void sipVH__propgrid_3(sip_gilstate_t, sipVirtErrorHandlerFunc, sipSimpleWrapper *, PyObject *);

    sipVH__propgrid_3(sipGILState, 0, sipPySelf, sipMeth);
}

::wxWindow* sipwxPGArrayStringEditorDialog::GetMainWindowOfCompositeControl()
{
    sip_gilstate_t sipGILState;
    PyObject *sipMeth;

    sipMeth = sipIsPyMethod(&sipGILState, &sipPyMethods[24], &sipPySelf, SIP_NULLPTR, sipName_GetMainWindowOfCompositeControl);

    if (!sipMeth)
        return ::wxPGArrayStringEditorDialog::GetMainWindowOfCompositeControl();

    extern ::wxWindow* sipVH__propgrid_45(sip_gilstate_t, sipVirtErrorHandlerFunc, sipSimpleWrapper *, PyObject *);

    return sipVH__propgrid_45(sipGILState, 0, sipPySelf, sipMeth);
}

void sipwxPGArrayStringEditorDialog::DoEnable(bool enable)
{
    sip_gilstate_t sipGILState;
    PyObject *sipMeth;

    sipMeth = sipIsPyMethod(&sipGILState, &sipPyMethods[25], &sipPySelf, SIP_NULLPTR, sipName_DoEnable);

    if (!sipMeth)
    {
        ::wxPGArrayStringEditorDialog::DoEnable(enable);
        return;
    }

    extern void sipVH__propgrid_44(sip_gilstate_t, sipVirtErrorHandlerFunc, sipSimpleWrapper *, PyObject *, bool);

    sipVH__propgrid_44(sipGILState, 0, sipPySelf, sipMeth, enable);
}

void sipwxPGArrayStringEditorDialog::DoGetPosition(int*x, int*y) const
{
    sip_gilstate_t sipGILState;
    PyObject *sipMeth;

    sipMeth = sipIsPyMethod(&sipGILState, const_cast<char *>(&sipPyMethods[26]), const_cast<sipSimpleWrapper **>(&sipPySelf), SIP_NULLPTR, sipName_DoGetPosition);

    if (!sipMeth)
    {
        ::wxPGArrayStringEditorDialog::DoGetPosition(x, y);
        return;
    }

    extern void sipVH__propgrid_43(sip_gilstate_t, sipVirtErrorHandlerFunc, sipSimpleWrapper *, PyObject *, int*, int*);

    sipVH__propgrid_43(sipGILState, 0, sipPySelf, sipMeth, x, y);
}

void sipwxPGArrayStringEditorDialog::DoGetSize(int*width, int*height) const
{
    sip_gilstate_t sipGILState;
    PyObject *sipMeth;

    sipMeth = sipIsPyMethod(&sipGILState, const_cast<char *>(&sipPyMethods[27]), const_cast<sipSimpleWrapper **>(&sipPySelf), SIP_NULLPTR, sipName_DoGetSize);

    if (!sipMeth)
    {
        ::wxPGArrayStringEditorDialog::DoGetSize(width, height);
        return;
    }

    extern void sipVH__propgrid_43(sip_gilstate_t, sipVirtErrorHandlerFunc, sipSimpleWrapper *, PyObject *, int*, int*);

    sipVH__propgrid_43(sipGILState, 0, sipPySelf, sipMeth, width, height);
}

void sipwxPGArrayStringEditorDialog::DoGetClientSize(int*width, int*height) const
{
    sip_gilstate_t sipGILState;
    PyObject *sipMeth;

    sipMeth = sipIsPyMethod(&sipGILState, const_cast<char *>(&sipPyMethods[28]), const_cast<sipSimpleWrapper **>(&sipPySelf), SIP_NULLPTR, sipName_DoGetClientSize);

    if (!sipMeth)
    {
        ::wxPGArrayStringEditorDialog::DoGetClientSize(width, height);
        return;
    }

    extern void sipVH__propgrid_43(sip_gilstate_t, sipVirtErrorHandlerFunc, sipSimpleWrapper *, PyObject *, int*, int*);

    sipVH__propgrid_43(sipGILState, 0, sipPySelf, sipMeth, width, height);
}

void sipwxPGArrayStringEditorDialog::DoSetSize(int x, int y, int width, int height, int sizeFlags)
{
    sip_gilstate_t sipGILState;
    PyObject *sipMeth;

    sipMeth = sipIsPyMethod(&sipGILState, &sipPyMethods[29], &sipPySelf, SIP_NULLPTR, sipName_DoSetSize);

    if (!sipMeth)
    {
        ::wxPGArrayStringEditorDialog::DoSetSize(x, y, width, height, sizeFlags);
        return;
    }

    extern void sipVH__propgrid_42(sip_gilstate_t, sipVirtErrorHandlerFunc, sipSimpleWrapper *, PyObject *, int, int, int, int, int);

    sipVH__propgrid_42(sipGILState, 0, sipPySelf, sipMeth, x, y, width, height, sizeFlags);
}

void sipwxPGArrayStringEditorDialog::DoSetClientSize(int width, int height)
{
    sip_gilstate_t sipGILState;
    PyObject *sipMeth;

    sipMeth = sipIsPyMethod(&sipGILState, &sipPyMethods[30], &sipPySelf, SIP_NULLPTR, sipName_DoSetClientSize);

    if (!sipMeth)
    {
        ::wxPGArrayStringEditorDialog::DoSetClientSize(width, height);
        return;
    }

    extern void sipVH__propgrid_41(sip_gilstate_t, sipVirtErrorHandlerFunc, sipSimpleWrapper *, PyObject *, int, int);

    sipVH__propgrid_41(sipGILState, 0, sipPySelf, sipMeth, width, height);
}

void sipwxPGArrayStringEditorDialog::DoSetSizeHints(int minW, int minH, int maxW, int maxH, int incW, int incH)
{
    sip_gilstate_t sipGILState;
    PyObject *sipMeth;

    sipMeth = sipIsPyMethod(&sipGILState, &sipPyMethods[31], &sipPySelf, SIP_NULLPTR, sipName_DoSetSizeHints);

    if (!sipMeth)
    {
        ::wxPGArrayStringEditorDialog::DoSetSizeHints(minW, minH, maxW, maxH, incW, incH);
        return;
    }

    extern void sipVH__propgrid_40(sip_gilstate_t, sipVirtErrorHandlerFunc, sipSimpleWrapper *, PyObject *, int, int, int, int, int, int);

    sipVH__propgrid_40(sipGILState, 0, sipPySelf, sipMeth, minW, minH, maxW, maxH, incW, incH);
}

::wxSize sipwxPGArrayStringEditorDialog::DoGetBorderSize() const
{
    sip_gilstate_t sipGILState;
    PyObject *sipMeth;

    sipMeth = sipIsPyMethod(&sipGILState, const_cast<char *>(&sipPyMethods[32]), const_cast<sipSimpleWrapper **>(&sipPySelf), SIP_NULLPTR, sipName_DoGetBorderSize);

    if (!sipMeth)
        return ::wxPGArrayStringEditorDialog::DoGetBorderSize();

    extern ::wxSize sipVH__propgrid_36(sip_gilstate_t, sipVirtErrorHandlerFunc, sipSimpleWrapper *, PyObject *);

    return sipVH__propgrid_36(sipGILState, 0, sipPySelf, sipMeth);
}

void sipwxPGArrayStringEditorDialog::DoMoveWindow(int x, int y, int width, int height)
{
    sip_gilstate_t sipGILState;
    PyObject *sipMeth;

    sipMeth = sipIsPyMethod(&sipGILState, &sipPyMethods[33], &sipPySelf, SIP_NULLPTR, sipName_DoMoveWindow);

    if (!sipMeth)
    {
        ::wxPGArrayStringEditorDialog::DoMoveWindow(x, y, width, height);
        return;
    }

    extern void sipVH__propgrid_39(sip_gilstate_t, sipVirtErrorHandlerFunc, sipSimpleWrapper *, PyObject *, int, int, int, int);

    sipVH__propgrid_39(sipGILState, 0, sipPySelf, sipMeth, x, y, width, height);
}

void sipwxPGArrayStringEditorDialog::DoSetWindowVariant(::wxWindowVariant variant)
{
    sip_gilstate_t sipGILState;
    PyObject *sipMeth;

    sipMeth = sipIsPyMethod(&sipGILState, &sipPyMethods[34], &sipPySelf, SIP_NULLPTR, sipName_DoSetWindowVariant);

    if (!sipMeth)
    {
        ::wxPGArrayStringEditorDialog::DoSetWindowVariant(variant);
        return;
    }

    extern void sipVH__propgrid_38(sip_gilstate_t, sipVirtErrorHandlerFunc, sipSimpleWrapper *, PyObject *, ::wxWindowVariant);

    sipVH__propgrid_38(sipGILState, 0, sipPySelf, sipMeth, variant);
}

::wxBorder sipwxPGArrayStringEditorDialog::GetDefaultBorder() const
{
    sip_gilstate_t sipGILState;
    PyObject *sipMeth;

    sipMeth = sipIsPyMethod(&sipGILState, const_cast<char *>(&sipPyMethods[35]), const_cast<sipSimpleWrapper **>(&sipPySelf), SIP_NULLPTR, sipName_GetDefaultBorder);

    if (!sipMeth)
        return ::wxPGArrayStringEditorDialog::GetDefaultBorder();

    extern ::wxBorder sipVH__propgrid_37(sip_gilstate_t, sipVirtErrorHandlerFunc, sipSimpleWrapper *, PyObject *);

    return sipVH__propgrid_37(sipGILState, 0, sipPySelf, sipMeth);
}

::wxBorder sipwxPGArrayStringEditorDialog::GetDefaultBorderForControl() const
{
    sip_gilstate_t sipGILState;
    PyObject *sipMeth;

    sipMeth = sipIsPyMethod(&sipGILState, const_cast<char *>(&sipPyMethods[36]), const_cast<sipSimpleWrapper **>(&sipPySelf), SIP_NULLPTR, sipName_GetDefaultBorderForControl);

    if (!sipMeth)
        return ::wxPGArrayStringEditorDialog::GetDefaultBorderForControl();

    extern ::wxBorder sipVH__propgrid_37(sip_gilstate_t, sipVirtErrorHandlerFunc, sipSimpleWrapper *, PyObject *);

    return sipVH__propgrid_37(sipGILState, 0, sipPySelf, sipMeth);
}

void sipwxPGArrayStringEditorDialog::DoFreeze()
{
    sip_gilstate_t sipGILState;
    PyObject *sipMeth;

    sipMeth = sipIsPyMethod(&sipGILState, &sipPyMethods[37], &sipPySelf, SIP_NULLPTR, sipName_DoFreeze);

    if (!sipMeth)
    {
        ::wxPGArrayStringEditorDialog::DoFreeze();
        return;
    }

    extern void sipVH__propgrid_3(sip_gilstate_t, sipVirtErrorHandlerFunc, sipSimpleWrapper *, PyObject *);

    sipVH__propgrid_3(sipGILState, 0, sipPySelf, sipMeth);
}

void sipwxPGArrayStringEditorDialog::DoThaw()
{
    sip_gilstate_t sipGILState;
    PyObject *sipMeth;

    sipMeth = sipIsPyMethod(&sipGILState, &sipPyMethods[38], &sipPySelf, SIP_NULLPTR, sipName_DoThaw);

    if (!sipMeth)
    {
        ::wxPGArrayStringEditorDialog::DoThaw();
        return;
    }

    extern void sipVH__propgrid_3(sip_gilstate_t, sipVirtErrorHandlerFunc, sipSimpleWrapper *, PyObject *);

    sipVH__propgrid_3(sipGILState, 0, sipPySelf, sipMeth);
}

::wxSize sipwxPGArrayStringEditorDialog::DoGetBestSize() const
{
    sip_gilstate_t sipGILState;
    PyObject *sipMeth;

    sipMeth = sipIsPyMethod(&sipGILState, const_cast<char *>(&sipPyMethods[39]), const_cast<sipSimpleWrapper **>(&sipPySelf), SIP_NULLPTR, sipName_DoGetBestSize);

    if (!sipMeth)
        return ::wxPGArrayStringEditorDialog::DoGetBestSize();

    extern ::wxSize sipVH__propgrid_36(sip_gilstate_t, sipVirtErrorHandlerFunc, sipSimpleWrapper *, PyObject *);

    return sipVH__propgrid_36(sipGILState, 0, sipPySelf, sipMeth);
}

::wxSize sipwxPGArrayStringEditorDialog::DoGetBestClientSize() const
{
    sip_gilstate_t sipGILState;
    PyObject *sipMeth;

    sipMeth = sipIsPyMethod(&sipGILState, const_cast<char *>(&sipPyMethods[40]), const_cast<sipSimpleWrapper **>(&sipPySelf), SIP_NULLPTR, sipName_DoGetBestClientSize);

    if (!sipMeth)
        return ::wxPGArrayStringEditorDialog::DoGetBestClientSize();

    extern ::wxSize sipVH__propgrid_36(sip_gilstate_t, sipVirtErrorHandlerFunc, sipSimpleWrapper *, PyObject *);

    return sipVH__propgrid_36(sipGILState, 0, sipPySelf, sipMeth);
}

bool sipwxPGArrayStringEditorDialog::ShouldPreventAppExit() const
{
    sip_gilstate_t sipGILState;
    PyObject *sipMeth;

    sipMeth = sipIsPyMethod(&sipGILState, const_cast<char *>(&sipPyMethods[41]), const_cast<sipSimpleWrapper **>(&sipPySelf), SIP_NULLPTR, sipName_ShouldPreventAppExit);

    if (!sipMeth)
        return ::wxPGArrayStringEditorDialog::ShouldPreventAppExit();

    extern bool sipVH__propgrid_33(sip_gilstate_t, sipVirtErrorHandlerFunc, sipSimpleWrapper *, PyObject *);

    return sipVH__propgrid_33(sipGILState, 0, sipPySelf, sipMeth);
}

void sipwxPGArrayStringEditorDialog::SetDialogValue(const ::wxPGVariant& value)
{
    sip_gilstate_t sipGILState;
    PyObject *sipMeth;

    sipMeth = sipIsPyMethod(&sipGILState, &sipPyMethods[42], &sipPySelf, SIP_NULLPTR, sipName_SetDialogValue);

    if (!sipMeth)
    {
        ::wxPGArrayStringEditorDialog::SetDialogValue(value);
        return;
    }

    extern void sipVH__propgrid_77(sip_gilstate_t, sipVirtErrorHandlerFunc, sipSimpleWrapper *, PyObject *, const ::wxPGVariant&);

    sipVH__propgrid_77(sipGILState, 0, sipPySelf, sipMeth, value);
}

::wxPGVariant sipwxPGArrayStringEditorDialog::GetDialogValue() const
{
    sip_gilstate_t sipGILState;
    PyObject *sipMeth;

    sipMeth = sipIsPyMethod(&sipGILState, const_cast<char *>(&sipPyMethods[43]), const_cast<sipSimpleWrapper **>(&sipPySelf), SIP_NULLPTR, sipName_GetDialogValue);

    if (!sipMeth)
        return ::wxPGArrayStringEditorDialog::GetDialogValue();

    extern ::wxPGVariant sipVH__propgrid_4(sip_gilstate_t, sipVirtErrorHandlerFunc, sipSimpleWrapper *, PyObject *);

    return sipVH__propgrid_4(sipGILState, 0, sipPySelf, sipMeth);
}

::wxValidator* sipwxPGArrayStringEditorDialog::GetTextCtrlValidator() const
{
    sip_gilstate_t sipGILState;
    PyObject *sipMeth;

    sipMeth = sipIsPyMethod(&sipGILState, const_cast<char *>(&sipPyMethods[44]), const_cast<sipSimpleWrapper **>(&sipPySelf), SIP_NULLPTR, sipName_GetTextCtrlValidator);

    if (!sipMeth)
        return ::wxPGArrayStringEditorDialog::GetTextCtrlValidator();

    extern ::wxValidator* sipVH__propgrid_13(sip_gilstate_t, sipVirtErrorHandlerFunc, sipSimpleWrapper *, PyObject *);

    return sipVH__propgrid_13(sipGILState, 0, sipPySelf, sipMeth);
}

::wxString sipwxPGArrayStringEditorDialog::ArrayGet(size_t index)
{
    sip_gilstate_t sipGILState;
    PyObject *sipMeth;

    sipMeth = sipIsPyMethod(&sipGILState, &sipPyMethods[45], &sipPySelf, SIP_NULLPTR, sipName_ArrayGet);

    if (!sipMeth)
        return ::wxPGArrayStringEditorDialog::ArrayGet(index);

    extern ::wxString sipVH__propgrid_78(sip_gilstate_t, sipVirtErrorHandlerFunc, sipSimpleWrapper *, PyObject *, size_t);

    return sipVH__propgrid_78(sipGILState, 0, sipPySelf, sipMeth, index);
}

size_t sipwxPGArrayStringEditorDialog::ArrayGetCount()
{
    sip_gilstate_t sipGILState;
    PyObject *sipMeth;

    sipMeth = sipIsPyMethod(&sipGILState, &sipPyMethods[46], &sipPySelf, SIP_NULLPTR, sipName_ArrayGetCount);

    if (!sipMeth)
        return ::wxPGArrayStringEditorDialog::ArrayGetCount();

    extern size_t sipVH__propgrid_79(sip_gilstate_t, sipVirtErrorHandlerFunc, sipSimpleWrapper *, PyObject *);

    return sipVH__propgrid_79(sipGILState, 0, sipPySelf, sipMeth);
}

bool sipwxPGArrayStringEditorDialog::ArrayInsert(const ::wxString& str, int index)
{
    sip_gilstate_t sipGILState;
    PyObject *sipMeth;

    sipMeth = sipIsPyMethod(&sipGILState, &sipPyMethods[47], &sipPySelf, SIP_NULLPTR, sipName_ArrayInsert);

    if (!sipMeth)
        return ::wxPGArrayStringEditorDialog::ArrayInsert(str, index);

    extern bool sipVH__propgrid_80(sip_gilstate_t, sipVirtErrorHandlerFunc, sipSimpleWrapper *, PyObject *, const ::wxString&, int);

    return sipVH__propgrid_80(sipGILState, 0, sipPySelf, sipMeth, str, index);
}

bool sipwxPGArrayStringEditorDialog::ArraySet(size_t index, const ::wxString& str)
{
    sip_gilstate_t sipGILState;
    PyObject *sipMeth;

    sipMeth = sipIsPyMethod(&sipGILState, &sipPyMethods[48], &sipPySelf, SIP_NULLPTR, sipName_ArraySet);

    if (!sipMeth)
        return ::wxPGArrayStringEditorDialog::ArraySet(index, str);

    extern bool sipVH__propgrid_81(sip_gilstate_t, sipVirtErrorHandlerFunc, sipSimpleWrapper *, PyObject *, size_t, const ::wxString&);

    return sipVH__propgrid_81(sipGILState, 0, sipPySelf, sipMeth, index, str);
}

void sipwxPGArrayStringEditorDialog::ArrayRemoveAt(int index)
{
    sip_gilstate_t sipGILState;
    PyObject *sipMeth;

    sipMeth = sipIsPyMethod(&sipGILState, &sipPyMethods[49], &sipPySelf, SIP_NULLPTR, sipName_ArrayRemoveAt);

    if (!sipMeth)
    {
        ::wxPGArrayStringEditorDialog::ArrayRemoveAt(index);
        return;
    }

    extern void sipVH__propgrid_82(sip_gilstate_t, sipVirtErrorHandlerFunc, sipSimpleWrapper *, PyObject *, int);

    sipVH__propgrid_82(sipGILState, 0, sipPySelf, sipMeth, index);
}

void sipwxPGArrayStringEditorDialog::ArraySwap(size_t first, size_t second)
{
    sip_gilstate_t sipGILState;
    PyObject *sipMeth;

    sipMeth = sipIsPyMethod(&sipGILState, &sipPyMethods[50], &sipPySelf, SIP_NULLPTR, sipName_ArraySwap);

    if (!sipMeth)
    {
        ::wxPGArrayStringEditorDialog::ArraySwap(first, second);
        return;
    }

    extern void sipVH__propgrid_83(sip_gilstate_t, sipVirtErrorHandlerFunc, sipSimpleWrapper *, PyObject *, size_t, size_t);

    sipVH__propgrid_83(sipGILState, 0, sipPySelf, sipMeth, first, second);
}

bool sipwxPGArrayStringEditorDialog::OnCustomNewAction(::wxString*resString)
{
    sip_gilstate_t sipGILState;
    PyObject *sipMeth;

    sipMeth = sipIsPyMethod(&sipGILState, &sipPyMethods[51], &sipPySelf, SIP_NULLPTR, sipName_OnCustomNewAction);

    if (!sipMeth)
        return ::wxPGArrayStringEditorDialog::OnCustomNewAction(resString);

    extern bool sipVH__propgrid_84(sip_gilstate_t, sipVirtErrorHandlerFunc, sipSimpleWrapper *, PyObject *, ::wxString*);

    return sipVH__propgrid_84(sipGILState, 0, sipPySelf, sipMeth, resString);
}

void sipwxPGArrayStringEditorDialog::sipProtect_SendDestroyEvent()
{
    ::wxWindow::SendDestroyEvent();
}

bool sipwxPGArrayStringEditorDialog::sipProtectVirt_ProcessEvent(bool sipSelfWasArg, ::wxEvent& event)
{
    return (sipSelfWasArg ? ::wxDialog::ProcessEvent(event) : ProcessEvent(event));
}

void sipwxPGArrayStringEditorDialog::sipProtectVirt_DoEnable(bool sipSelfWasArg, bool enable)
{
    (sipSelfWasArg ? ::wxDialog::DoEnable(enable) : DoEnable(enable));
}

void sipwxPGArrayStringEditorDialog::sipProtectVirt_DoGetPosition(bool sipSelfWasArg, int*x, int*y) const
{
    (sipSelfWasArg ? ::wxDialog::DoGetPosition(x, y) : DoGetPosition(x, y));
}

void sipwxPGArrayStringEditorDialog::sipProtectVirt_DoGetSize(bool sipSelfWasArg, int*width, int*height) const
{
    (sipSelfWasArg ? ::wxDialog::DoGetSize(width, height) : DoGetSize(width, height));
}

void sipwxPGArrayStringEditorDialog::sipProtectVirt_DoGetClientSize(bool sipSelfWasArg, int*width, int*height) const
{
    (sipSelfWasArg ? ::wxDialog::DoGetClientSize(width, height) : DoGetClientSize(width, height));
}

::wxSize sipwxPGArrayStringEditorDialog::sipProtectVirt_DoGetBestSize(bool sipSelfWasArg) const
{
    return (sipSelfWasArg ? ::wxDialog::DoGetBestSize() : DoGetBestSize());
}

::wxSize sipwxPGArrayStringEditorDialog::sipProtectVirt_DoGetBestClientSize(bool sipSelfWasArg) const
{
    return (sipSelfWasArg ? ::wxDialog::DoGetBestClientSize() : DoGetBestClientSize());
}

void sipwxPGArrayStringEditorDialog::sipProtectVirt_DoSetSize(bool sipSelfWasArg, int x, int y, int width, int height, int sizeFlags)
{
    (sipSelfWasArg ? ::wxDialog::DoSetSize(x, y, width, height, sizeFlags) : DoSetSize(x, y, width, height, sizeFlags));
}

void sipwxPGArrayStringEditorDialog::sipProtectVirt_DoSetClientSize(bool sipSelfWasArg, int width, int height)
{
    (sipSelfWasArg ? ::wxDialog::DoSetClientSize(width, height) : DoSetClientSize(width, height));
}

void sipwxPGArrayStringEditorDialog::sipProtectVirt_DoSetSizeHints(bool sipSelfWasArg, int minW, int minH, int maxW, int maxH, int incW, int incH)
{
    (sipSelfWasArg ? ::wxDialog::DoSetSizeHints(minW, minH, maxW, maxH, incW, incH) : DoSetSizeHints(minW, minH, maxW, maxH, incW, incH));
}

::wxSize sipwxPGArrayStringEditorDialog::sipProtectVirt_DoGetBorderSize(bool sipSelfWasArg) const
{
    return (sipSelfWasArg ? ::wxDialog::DoGetBorderSize() : DoGetBorderSize());
}

void sipwxPGArrayStringEditorDialog::sipProtectVirt_DoMoveWindow(bool sipSelfWasArg, int x, int y, int width, int height)
{
    (sipSelfWasArg ? ::wxDialog::DoMoveWindow(x, y, width, height) : DoMoveWindow(x, y, width, height));
}

void sipwxPGArrayStringEditorDialog::sipProtectVirt_DoSetWindowVariant(bool sipSelfWasArg, ::wxWindowVariant variant)
{
    (sipSelfWasArg ? ::wxDialog::DoSetWindowVariant(variant) : DoSetWindowVariant(variant));
}

::wxBorder sipwxPGArrayStringEditorDialog::sipProtectVirt_GetDefaultBorder(bool sipSelfWasArg) const
{
    return (sipSelfWasArg ? ::wxDialog::GetDefaultBorder() : GetDefaultBorder());
}

::wxBorder sipwxPGArrayStringEditorDialog::sipProtectVirt_GetDefaultBorderForControl(bool sipSelfWasArg) const
{
    return (sipSelfWasArg ? ::wxDialog::GetDefaultBorderForControl() : GetDefaultBorderForControl());
}

void sipwxPGArrayStringEditorDialog::sipProtectVirt_DoFreeze(bool sipSelfWasArg)
{
    (sipSelfWasArg ? ::wxDialog::DoFreeze() : DoFreeze());
}

void sipwxPGArrayStringEditorDialog::sipProtectVirt_DoThaw(bool sipSelfWasArg)
{
    (sipSelfWasArg ? ::wxDialog::DoThaw() : DoThaw());
}

bool sipwxPGArrayStringEditorDialog::sipProtectVirt_HasTransparentBackground(bool sipSelfWasArg)
{
    return (sipSelfWasArg ? ::wxDialog::HasTransparentBackground() : HasTransparentBackground());
}

bool sipwxPGArrayStringEditorDialog::sipProtectVirt_TryBefore(bool sipSelfWasArg, ::wxEvent& event)
{
    return (sipSelfWasArg ? ::wxDialog::TryBefore(event) : TryBefore(event));
}

bool sipwxPGArrayStringEditorDialog::sipProtectVirt_TryAfter(bool sipSelfWasArg, ::wxEvent& event)
{
    return (sipSelfWasArg ? ::wxDialog::TryAfter(event) : TryAfter(event));
}

::wxString sipwxPGArrayStringEditorDialog::sipProtectVirt_ArrayGet(bool sipSelfWasArg, size_t index)
{
    return (sipSelfWasArg ? ::wxPGArrayStringEditorDialog::ArrayGet(index) : ArrayGet(index));
}

size_t sipwxPGArrayStringEditorDialog::sipProtectVirt_ArrayGetCount(bool sipSelfWasArg)
{
    return (sipSelfWasArg ? ::wxPGArrayStringEditorDialog::ArrayGetCount() : ArrayGetCount());
}

bool sipwxPGArrayStringEditorDialog::sipProtectVirt_ArrayInsert(bool sipSelfWasArg, const ::wxString& str, int index)
{
    return (sipSelfWasArg ? ::wxPGArrayStringEditorDialog::ArrayInsert(str, index) : ArrayInsert(str, index));
}

bool sipwxPGArrayStringEditorDialog::sipProtectVirt_ArraySet(bool sipSelfWasArg, size_t index, const ::wxString& str)
{
    return (sipSelfWasArg ? ::wxPGArrayStringEditorDialog::ArraySet(index, str) : ArraySet(index, str));
}

void sipwxPGArrayStringEditorDialog::sipProtectVirt_ArrayRemoveAt(bool sipSelfWasArg, int index)
{
    (sipSelfWasArg ? ::wxPGArrayStringEditorDialog::ArrayRemoveAt(index) : ArrayRemoveAt(index));
}

void sipwxPGArrayStringEditorDialog::sipProtectVirt_ArraySwap(bool sipSelfWasArg, size_t first, size_t second)
{
    (sipSelfWasArg ? ::wxPGArrayStringEditorDialog::ArraySwap(first, second) : ArraySwap(first, second));
}


PyDoc_STRVAR(doc_wxPGArrayStringEditorDialog_SendDestroyEvent, "SendDestroyEvent()\n"
"\n"
"Generate wxWindowDestroyEvent for this window.");

extern "C" {static PyObject *meth_wxPGArrayStringEditorDialog_SendDestroyEvent(PyObject *, PyObject *);}
static PyObject *meth_wxPGArrayStringEditorDialog_SendDestroyEvent(PyObject *sipSelf, PyObject *sipArgs)
{
    PyObject *sipParseErr = SIP_NULLPTR;

    {
        sipwxPGArrayStringEditorDialog *sipCpp;

        if (sipParseArgs(&sipParseErr, sipArgs, "B", &sipSelf, sipType_wxPGArrayStringEditorDialog, &sipCpp))
        {
            PyErr_Clear();

            Py_BEGIN_ALLOW_THREADS
            sipCpp->sipProtect_SendDestroyEvent();
            Py_END_ALLOW_THREADS

            if (PyErr_Occurred())
                return 0;

            Py_INCREF(Py_None);
            return Py_None;
        }
    }

    sipNoMethod(sipParseErr, sipName_PGArrayStringEditorDialog, sipName_SendDestroyEvent, SIP_NULLPTR);

    return SIP_NULLPTR;
}


PyDoc_STRVAR(doc_wxPGArrayStringEditorDialog_ProcessEvent, "ProcessEvent(self, event: Event) -> bool");

extern "C" {static PyObject *meth_wxPGArrayStringEditorDialog_ProcessEvent(PyObject *, PyObject *, PyObject *);}
static PyObject *meth_wxPGArrayStringEditorDialog_ProcessEvent(PyObject *sipSelf, PyObject *sipArgs, PyObject *sipKwds)
{
    PyObject *sipParseErr = SIP_NULLPTR;
    bool sipSelfWasArg = (!sipSelf || sipIsDerivedClass((sipSimpleWrapper *)sipSelf));

    {
        ::wxEvent* event;
        sipwxPGArrayStringEditorDialog *sipCpp;

        static const char *sipKwdList[] = {
            sipName_event,
        };

        if (sipParseKwdArgs(&sipParseErr, sipArgs, sipKwds, sipKwdList, SIP_NULLPTR, "BJ9", &sipSelf, sipType_wxPGArrayStringEditorDialog, &sipCpp, sipType_wxEvent, &event))
        {
            bool sipRes;

            PyErr_Clear();

            Py_BEGIN_ALLOW_THREADS
            sipRes = sipCpp->sipProtectVirt_ProcessEvent(sipSelfWasArg, *event);
            Py_END_ALLOW_THREADS

            if (PyErr_Occurred())
                return 0;

            return PyBool_FromLong(sipRes);
        }
    }

    sipNoMethod(sipParseErr, sipName_PGArrayStringEditorDialog, sipName_ProcessEvent, doc_wxPGArrayStringEditorDialog_ProcessEvent);

    return SIP_NULLPTR;
}


PyDoc_STRVAR(doc_wxPGArrayStringEditorDialog_DoEnable, "DoEnable(self, enable: bool)");

extern "C" {static PyObject *meth_wxPGArrayStringEditorDialog_DoEnable(PyObject *, PyObject *, PyObject *);}
static PyObject *meth_wxPGArrayStringEditorDialog_DoEnable(PyObject *sipSelf, PyObject *sipArgs, PyObject *sipKwds)
{
    PyObject *sipParseErr = SIP_NULLPTR;
    bool sipSelfWasArg = (!sipSelf || sipIsDerivedClass((sipSimpleWrapper *)sipSelf));

    {
        bool enable;
        sipwxPGArrayStringEditorDialog *sipCpp;

        static const char *sipKwdList[] = {
            sipName_enable,
        };

        if (sipParseKwdArgs(&sipParseErr, sipArgs, sipKwds, sipKwdList, SIP_NULLPTR, "Bb", &sipSelf, sipType_wxPGArrayStringEditorDialog, &sipCpp, &enable))
        {
            PyErr_Clear();

            Py_BEGIN_ALLOW_THREADS
            sipCpp->sipProtectVirt_DoEnable(sipSelfWasArg, enable);
            Py_END_ALLOW_THREADS

            if (PyErr_Occurred())
                return 0;

            Py_INCREF(Py_None);
            return Py_None;
        }
    }

    sipNoMethod(sipParseErr, sipName_PGArrayStringEditorDialog, sipName_DoEnable, doc_wxPGArrayStringEditorDialog_DoEnable);

    return SIP_NULLPTR;
}


PyDoc_STRVAR(doc_wxPGArrayStringEditorDialog_DoGetPosition, "DoGetPosition(self) -> (int, int)");

extern "C" {static PyObject *meth_wxPGArrayStringEditorDialog_DoGetPosition(PyObject *, PyObject *, PyObject *);}
static PyObject *meth_wxPGArrayStringEditorDialog_DoGetPosition(PyObject *sipSelf, PyObject *sipArgs, PyObject *sipKwds)
{
    PyObject *sipParseErr = SIP_NULLPTR;
    bool sipSelfWasArg = (!sipSelf || sipIsDerivedClass((sipSimpleWrapper *)sipSelf));

    {
        int x;
        int y;
        const sipwxPGArrayStringEditorDialog *sipCpp;

        if (sipParseKwdArgs(&sipParseErr, sipArgs, sipKwds, SIP_NULLPTR, SIP_NULLPTR, "B", &sipSelf, sipType_wxPGArrayStringEditorDialog, &sipCpp))
        {
            PyErr_Clear();

            Py_BEGIN_ALLOW_THREADS
            sipCpp->sipProtectVirt_DoGetPosition(sipSelfWasArg, &x, &y);
            Py_END_ALLOW_THREADS

            if (PyErr_Occurred())
                return 0;

            return sipBuildResult(0, "(ii)", x, y);
        }
    }

    sipNoMethod(sipParseErr, sipName_PGArrayStringEditorDialog, sipName_DoGetPosition, doc_wxPGArrayStringEditorDialog_DoGetPosition);

    return SIP_NULLPTR;
}


PyDoc_STRVAR(doc_wxPGArrayStringEditorDialog_DoGetSize, "DoGetSize(self) -> (int, int)");

extern "C" {static PyObject *meth_wxPGArrayStringEditorDialog_DoGetSize(PyObject *, PyObject *, PyObject *);}
static PyObject *meth_wxPGArrayStringEditorDialog_DoGetSize(PyObject *sipSelf, PyObject *sipArgs, PyObject *sipKwds)
{
    PyObject *sipParseErr = SIP_NULLPTR;
    bool sipSelfWasArg = (!sipSelf || sipIsDerivedClass((sipSimpleWrapper *)sipSelf));

    {
        int width;
        int height;
        const sipwxPGArrayStringEditorDialog *sipCpp;

        if (sipParseKwdArgs(&sipParseErr, sipArgs, sipKwds, SIP_NULLPTR, SIP_NULLPTR, "B", &sipSelf, sipType_wxPGArrayStringEditorDialog, &sipCpp))
        {
            PyErr_Clear();

            Py_BEGIN_ALLOW_THREADS
            sipCpp->sipProtectVirt_DoGetSize(sipSelfWasArg, &width, &height);
            Py_END_ALLOW_THREADS

            if (PyErr_Occurred())
                return 0;

            return sipBuildResult(0, "(ii)", width, height);
        }
    }

    sipNoMethod(sipParseErr, sipName_PGArrayStringEditorDialog, sipName_DoGetSize, doc_wxPGArrayStringEditorDialog_DoGetSize);

    return SIP_NULLPTR;
}


PyDoc_STRVAR(doc_wxPGArrayStringEditorDialog_DoGetClientSize, "DoGetClientSize(self) -> (int, int)");

extern "C" {static PyObject *meth_wxPGArrayStringEditorDialog_DoGetClientSize(PyObject *, PyObject *, PyObject *);}
static PyObject *meth_wxPGArrayStringEditorDialog_DoGetClientSize(PyObject *sipSelf, PyObject *sipArgs, PyObject *sipKwds)
{
    PyObject *sipParseErr = SIP_NULLPTR;
    bool sipSelfWasArg = (!sipSelf || sipIsDerivedClass((sipSimpleWrapper *)sipSelf));

    {
        int width;
        int height;
        const sipwxPGArrayStringEditorDialog *sipCpp;

        if (sipParseKwdArgs(&sipParseErr, sipArgs, sipKwds, SIP_NULLPTR, SIP_NULLPTR, "B", &sipSelf, sipType_wxPGArrayStringEditorDialog, &sipCpp))
        {
            PyErr_Clear();

            Py_BEGIN_ALLOW_THREADS
            sipCpp->sipProtectVirt_DoGetClientSize(sipSelfWasArg, &width, &height);
            Py_END_ALLOW_THREADS

            if (PyErr_Occurred())
                return 0;

            return sipBuildResult(0, "(ii)", width, height);
        }
    }

    sipNoMethod(sipParseErr, sipName_PGArrayStringEditorDialog, sipName_DoGetClientSize, doc_wxPGArrayStringEditorDialog_DoGetClientSize);

    return SIP_NULLPTR;
}


PyDoc_STRVAR(doc_wxPGArrayStringEditorDialog_DoGetBestSize, "DoGetBestSize(self) -> Size");

extern "C" {static PyObject *meth_wxPGArrayStringEditorDialog_DoGetBestSize(PyObject *, PyObject *);}
static PyObject *meth_wxPGArrayStringEditorDialog_DoGetBestSize(PyObject *sipSelf, PyObject *sipArgs)
{
    PyObject *sipParseErr = SIP_NULLPTR;
    bool sipSelfWasArg = (!sipSelf || sipIsDerivedClass((sipSimpleWrapper *)sipSelf));

    {
        const sipwxPGArrayStringEditorDialog *sipCpp;

        if (sipParseArgs(&sipParseErr, sipArgs, "B", &sipSelf, sipType_wxPGArrayStringEditorDialog, &sipCpp))
        {
            ::wxSize*sipRes;

            PyErr_Clear();

            Py_BEGIN_ALLOW_THREADS
            sipRes = new ::wxSize(sipCpp->sipProtectVirt_DoGetBestSize(sipSelfWasArg));
            Py_END_ALLOW_THREADS

            if (PyErr_Occurred())
                return 0;

            return sipConvertFromNewType(sipRes, sipType_wxSize, SIP_NULLPTR);
        }
    }

    sipNoMethod(sipParseErr, sipName_PGArrayStringEditorDialog, sipName_DoGetBestSize, doc_wxPGArrayStringEditorDialog_DoGetBestSize);

    return SIP_NULLPTR;
}


PyDoc_STRVAR(doc_wxPGArrayStringEditorDialog_DoGetBestClientSize, "DoGetBestClientSize(self) -> Size");

extern "C" {static PyObject *meth_wxPGArrayStringEditorDialog_DoGetBestClientSize(PyObject *, PyObject *);}
static PyObject *meth_wxPGArrayStringEditorDialog_DoGetBestClientSize(PyObject *sipSelf, PyObject *sipArgs)
{
    PyObject *sipParseErr = SIP_NULLPTR;
    bool sipSelfWasArg = (!sipSelf || sipIsDerivedClass((sipSimpleWrapper *)sipSelf));

    {
        const sipwxPGArrayStringEditorDialog *sipCpp;

        if (sipParseArgs(&sipParseErr, sipArgs, "B", &sipSelf, sipType_wxPGArrayStringEditorDialog, &sipCpp))
        {
            ::wxSize*sipRes;

            PyErr_Clear();

            Py_BEGIN_ALLOW_THREADS
            sipRes = new ::wxSize(sipCpp->sipProtectVirt_DoGetBestClientSize(sipSelfWasArg));
            Py_END_ALLOW_THREADS

            if (PyErr_Occurred())
                return 0;

            return sipConvertFromNewType(sipRes, sipType_wxSize, SIP_NULLPTR);
        }
    }

    sipNoMethod(sipParseErr, sipName_PGArrayStringEditorDialog, sipName_DoGetBestClientSize, doc_wxPGArrayStringEditorDialog_DoGetBestClientSize);

    return SIP_NULLPTR;
}


PyDoc_STRVAR(doc_wxPGArrayStringEditorDialog_DoSetSize, "DoSetSize(self, x: int, y: int, width: int, height: int, sizeFlags: int)");

extern "C" {static PyObject *meth_wxPGArrayStringEditorDialog_DoSetSize(PyObject *, PyObject *, PyObject *);}
static PyObject *meth_wxPGArrayStringEditorDialog_DoSetSize(PyObject *sipSelf, PyObject *sipArgs, PyObject *sipKwds)
{
    PyObject *sipParseErr = SIP_NULLPTR;
    bool sipSelfWasArg = (!sipSelf || sipIsDerivedClass((sipSimpleWrapper *)sipSelf));

    {
        int x;
        int y;
        int width;
        int height;
        int sizeFlags;
        sipwxPGArrayStringEditorDialog *sipCpp;

        static const char *sipKwdList[] = {
            sipName_x,
            sipName_y,
            sipName_width,
            sipName_height,
            sipName_sizeFlags,
        };

        if (sipParseKwdArgs(&sipParseErr, sipArgs, sipKwds, sipKwdList, SIP_NULLPTR, "Biiiii", &sipSelf, sipType_wxPGArrayStringEditorDialog, &sipCpp, &x, &y, &width, &height, &sizeFlags))
        {
            PyErr_Clear();

            Py_BEGIN_ALLOW_THREADS
            sipCpp->sipProtectVirt_DoSetSize(sipSelfWasArg, x, y, width, height, sizeFlags);
            Py_END_ALLOW_THREADS

            if (PyErr_Occurred())
                return 0;

            Py_INCREF(Py_None);
            return Py_None;
        }
    }

    sipNoMethod(sipParseErr, sipName_PGArrayStringEditorDialog, sipName_DoSetSize, doc_wxPGArrayStringEditorDialog_DoSetSize);

    return SIP_NULLPTR;
}


PyDoc_STRVAR(doc_wxPGArrayStringEditorDialog_DoSetClientSize, "DoSetClientSize(self, width: int, height: int)");

extern "C" {static PyObject *meth_wxPGArrayStringEditorDialog_DoSetClientSize(PyObject *, PyObject *, PyObject *);}
static PyObject *meth_wxPGArrayStringEditorDialog_DoSetClientSize(PyObject *sipSelf, PyObject *sipArgs, PyObject *sipKwds)
{
    PyObject *sipParseErr = SIP_NULLPTR;
    bool sipSelfWasArg = (!sipSelf || sipIsDerivedClass((sipSimpleWrapper *)sipSelf));

    {
        int width;
        int height;
        sipwxPGArrayStringEditorDialog *sipCpp;

        static const char *sipKwdList[] = {
            sipName_width,
            sipName_height,
        };

        if (sipParseKwdArgs(&sipParseErr, sipArgs, sipKwds, sipKwdList, SIP_NULLPTR, "Bii", &sipSelf, sipType_wxPGArrayStringEditorDialog, &sipCpp, &width, &height))
        {
            PyErr_Clear();

            Py_BEGIN_ALLOW_THREADS
            sipCpp->sipProtectVirt_DoSetClientSize(sipSelfWasArg, width, height);
            Py_END_ALLOW_THREADS

            if (PyErr_Occurred())
                return 0;

            Py_INCREF(Py_None);
            return Py_None;
        }
    }

    sipNoMethod(sipParseErr, sipName_PGArrayStringEditorDialog, sipName_DoSetClientSize, doc_wxPGArrayStringEditorDialog_DoSetClientSize);

    return SIP_NULLPTR;
}


PyDoc_STRVAR(doc_wxPGArrayStringEditorDialog_DoSetSizeHints, "DoSetSizeHints(self, minW: int, minH: int, maxW: int, maxH: int, incW: int, incH: int)");

extern "C" {static PyObject *meth_wxPGArrayStringEditorDialog_DoSetSizeHints(PyObject *, PyObject *, PyObject *);}
static PyObject *meth_wxPGArrayStringEditorDialog_DoSetSizeHints(PyObject *sipSelf, PyObject *sipArgs, PyObject *sipKwds)
{
    PyObject *sipParseErr = SIP_NULLPTR;
    bool sipSelfWasArg = (!sipSelf || sipIsDerivedClass((sipSimpleWrapper *)sipSelf));

    {
        int minW;
        int minH;
        int maxW;
        int maxH;
        int incW;
        int incH;
        sipwxPGArrayStringEditorDialog *sipCpp;

        static const char *sipKwdList[] = {
            sipName_minW,
            sipName_minH,
            sipName_maxW,
            sipName_maxH,
            sipName_incW,
            sipName_incH,
        };

        if (sipParseKwdArgs(&sipParseErr, sipArgs, sipKwds, sipKwdList, SIP_NULLPTR, "Biiiiii", &sipSelf, sipType_wxPGArrayStringEditorDialog, &sipCpp, &minW, &minH, &maxW, &maxH, &incW, &incH))
        {
            PyErr_Clear();

            Py_BEGIN_ALLOW_THREADS
            sipCpp->sipProtectVirt_DoSetSizeHints(sipSelfWasArg, minW, minH, maxW, maxH, incW, incH);
            Py_END_ALLOW_THREADS

            if (PyErr_Occurred())
                return 0;

            Py_INCREF(Py_None);
            return Py_None;
        }
    }

    sipNoMethod(sipParseErr, sipName_PGArrayStringEditorDialog, sipName_DoSetSizeHints, doc_wxPGArrayStringEditorDialog_DoSetSizeHints);

    return SIP_NULLPTR;
}


PyDoc_STRVAR(doc_wxPGArrayStringEditorDialog_DoGetBorderSize, "DoGetBorderSize(self) -> Size");

extern "C" {static PyObject *meth_wxPGArrayStringEditorDialog_DoGetBorderSize(PyObject *, PyObject *);}
static PyObject *meth_wxPGArrayStringEditorDialog_DoGetBorderSize(PyObject *sipSelf, PyObject *sipArgs)
{
    PyObject *sipParseErr = SIP_NULLPTR;
    bool sipSelfWasArg = (!sipSelf || sipIsDerivedClass((sipSimpleWrapper *)sipSelf));

    {
        const sipwxPGArrayStringEditorDialog *sipCpp;

        if (sipParseArgs(&sipParseErr, sipArgs, "B", &sipSelf, sipType_wxPGArrayStringEditorDialog, &sipCpp))
        {
            ::wxSize*sipRes;

            PyErr_Clear();

            Py_BEGIN_ALLOW_THREADS
            sipRes = new ::wxSize(sipCpp->sipProtectVirt_DoGetBorderSize(sipSelfWasArg));
            Py_END_ALLOW_THREADS

            if (PyErr_Occurred())
                return 0;

            return sipConvertFromNewType(sipRes, sipType_wxSize, SIP_NULLPTR);
        }
    }

    sipNoMethod(sipParseErr, sipName_PGArrayStringEditorDialog, sipName_DoGetBorderSize, doc_wxPGArrayStringEditorDialog_DoGetBorderSize);

    return SIP_NULLPTR;
}


PyDoc_STRVAR(doc_wxPGArrayStringEditorDialog_DoMoveWindow, "DoMoveWindow(self, x: int, y: int, width: int, height: int)");

extern "C" {static PyObject *meth_wxPGArrayStringEditorDialog_DoMoveWindow(PyObject *, PyObject *, PyObject *);}
static PyObject *meth_wxPGArrayStringEditorDialog_DoMoveWindow(PyObject *sipSelf, PyObject *sipArgs, PyObject *sipKwds)
{
    PyObject *sipParseErr = SIP_NULLPTR;
    bool sipSelfWasArg = (!sipSelf || sipIsDerivedClass((sipSimpleWrapper *)sipSelf));

    {
        int x;
        int y;
        int width;
        int height;
        sipwxPGArrayStringEditorDialog *sipCpp;

        static const char *sipKwdList[] = {
            sipName_x,
            sipName_y,
            sipName_width,
            sipName_height,
        };

        if (sipParseKwdArgs(&sipParseErr, sipArgs, sipKwds, sipKwdList, SIP_NULLPTR, "Biiii", &sipSelf, sipType_wxPGArrayStringEditorDialog, &sipCpp, &x, &y, &width, &height))
        {
            PyErr_Clear();

            Py_BEGIN_ALLOW_THREADS
            sipCpp->sipProtectVirt_DoMoveWindow(sipSelfWasArg, x, y, width, height);
            Py_END_ALLOW_THREADS

            if (PyErr_Occurred())
                return 0;

            Py_INCREF(Py_None);
            return Py_None;
        }
    }

    sipNoMethod(sipParseErr, sipName_PGArrayStringEditorDialog, sipName_DoMoveWindow, doc_wxPGArrayStringEditorDialog_DoMoveWindow);

    return SIP_NULLPTR;
}


PyDoc_STRVAR(doc_wxPGArrayStringEditorDialog_DoSetWindowVariant, "DoSetWindowVariant(self, variant: WindowVariant)");

extern "C" {static PyObject *meth_wxPGArrayStringEditorDialog_DoSetWindowVariant(PyObject *, PyObject *, PyObject *);}
static PyObject *meth_wxPGArrayStringEditorDialog_DoSetWindowVariant(PyObject *sipSelf, PyObject *sipArgs, PyObject *sipKwds)
{
    PyObject *sipParseErr = SIP_NULLPTR;
    bool sipSelfWasArg = (!sipSelf || sipIsDerivedClass((sipSimpleWrapper *)sipSelf));

    {
        ::wxWindowVariant variant;
        sipwxPGArrayStringEditorDialog *sipCpp;

        static const char *sipKwdList[] = {
            sipName_variant,
        };

        if (sipParseKwdArgs(&sipParseErr, sipArgs, sipKwds, sipKwdList, SIP_NULLPTR, "BE", &sipSelf, sipType_wxPGArrayStringEditorDialog, &sipCpp, sipType_wxWindowVariant, &variant))
        {
            PyErr_Clear();

            Py_BEGIN_ALLOW_THREADS
            sipCpp->sipProtectVirt_DoSetWindowVariant(sipSelfWasArg, variant);
            Py_END_ALLOW_THREADS

            if (PyErr_Occurred())
                return 0;

            Py_INCREF(Py_None);
            return Py_None;
        }
    }

    sipNoMethod(sipParseErr, sipName_PGArrayStringEditorDialog, sipName_DoSetWindowVariant, doc_wxPGArrayStringEditorDialog_DoSetWindowVariant);

    return SIP_NULLPTR;
}


PyDoc_STRVAR(doc_wxPGArrayStringEditorDialog_GetDefaultBorder, "GetDefaultBorder(self) -> Border");

extern "C" {static PyObject *meth_wxPGArrayStringEditorDialog_GetDefaultBorder(PyObject *, PyObject *);}
static PyObject *meth_wxPGArrayStringEditorDialog_GetDefaultBorder(PyObject *sipSelf, PyObject *sipArgs)
{
    PyObject *sipParseErr = SIP_NULLPTR;
    bool sipSelfWasArg = (!sipSelf || sipIsDerivedClass((sipSimpleWrapper *)sipSelf));

    {
        const sipwxPGArrayStringEditorDialog *sipCpp;

        if (sipParseArgs(&sipParseErr, sipArgs, "B", &sipSelf, sipType_wxPGArrayStringEditorDialog, &sipCpp))
        {
            ::wxBorder sipRes;

            PyErr_Clear();

            Py_BEGIN_ALLOW_THREADS
            sipRes = sipCpp->sipProtectVirt_GetDefaultBorder(sipSelfWasArg);
            Py_END_ALLOW_THREADS

            if (PyErr_Occurred())
                return 0;

            return sipConvertFromEnum(static_cast<int>(sipRes), sipType_wxBorder);
        }
    }

    sipNoMethod(sipParseErr, sipName_PGArrayStringEditorDialog, sipName_GetDefaultBorder, doc_wxPGArrayStringEditorDialog_GetDefaultBorder);

    return SIP_NULLPTR;
}


PyDoc_STRVAR(doc_wxPGArrayStringEditorDialog_GetDefaultBorderForControl, "GetDefaultBorderForControl(self) -> Border");

extern "C" {static PyObject *meth_wxPGArrayStringEditorDialog_GetDefaultBorderForControl(PyObject *, PyObject *);}
static PyObject *meth_wxPGArrayStringEditorDialog_GetDefaultBorderForControl(PyObject *sipSelf, PyObject *sipArgs)
{
    PyObject *sipParseErr = SIP_NULLPTR;
    bool sipSelfWasArg = (!sipSelf || sipIsDerivedClass((sipSimpleWrapper *)sipSelf));

    {
        const sipwxPGArrayStringEditorDialog *sipCpp;

        if (sipParseArgs(&sipParseErr, sipArgs, "B", &sipSelf, sipType_wxPGArrayStringEditorDialog, &sipCpp))
        {
            ::wxBorder sipRes;

            PyErr_Clear();

            Py_BEGIN_ALLOW_THREADS
            sipRes = sipCpp->sipProtectVirt_GetDefaultBorderForControl(sipSelfWasArg);
            Py_END_ALLOW_THREADS

            if (PyErr_Occurred())
                return 0;

            return sipConvertFromEnum(static_cast<int>(sipRes), sipType_wxBorder);
        }
    }

    sipNoMethod(sipParseErr, sipName_PGArrayStringEditorDialog, sipName_GetDefaultBorderForControl, doc_wxPGArrayStringEditorDialog_GetDefaultBorderForControl);

    return SIP_NULLPTR;
}


PyDoc_STRVAR(doc_wxPGArrayStringEditorDialog_DoFreeze, "DoFreeze(self)");

extern "C" {static PyObject *meth_wxPGArrayStringEditorDialog_DoFreeze(PyObject *, PyObject *);}
static PyObject *meth_wxPGArrayStringEditorDialog_DoFreeze(PyObject *sipSelf, PyObject *sipArgs)
{
    PyObject *sipParseErr = SIP_NULLPTR;
    bool sipSelfWasArg = (!sipSelf || sipIsDerivedClass((sipSimpleWrapper *)sipSelf));

    {
        sipwxPGArrayStringEditorDialog *sipCpp;

        if (sipParseArgs(&sipParseErr, sipArgs, "B", &sipSelf, sipType_wxPGArrayStringEditorDialog, &sipCpp))
        {
            PyErr_Clear();

            Py_BEGIN_ALLOW_THREADS
            sipCpp->sipProtectVirt_DoFreeze(sipSelfWasArg);
            Py_END_ALLOW_THREADS

            if (PyErr_Occurred())
                return 0;

            Py_INCREF(Py_None);
            return Py_None;
        }
    }

    sipNoMethod(sipParseErr, sipName_PGArrayStringEditorDialog, sipName_DoFreeze, doc_wxPGArrayStringEditorDialog_DoFreeze);

    return SIP_NULLPTR;
}


PyDoc_STRVAR(doc_wxPGArrayStringEditorDialog_DoThaw, "DoThaw(self)");

extern "C" {static PyObject *meth_wxPGArrayStringEditorDialog_DoThaw(PyObject *, PyObject *);}
static PyObject *meth_wxPGArrayStringEditorDialog_DoThaw(PyObject *sipSelf, PyObject *sipArgs)
{
    PyObject *sipParseErr = SIP_NULLPTR;
    bool sipSelfWasArg = (!sipSelf || sipIsDerivedClass((sipSimpleWrapper *)sipSelf));

    {
        sipwxPGArrayStringEditorDialog *sipCpp;

        if (sipParseArgs(&sipParseErr, sipArgs, "B", &sipSelf, sipType_wxPGArrayStringEditorDialog, &sipCpp))
        {
            PyErr_Clear();

            Py_BEGIN_ALLOW_THREADS
            sipCpp->sipProtectVirt_DoThaw(sipSelfWasArg);
            Py_END_ALLOW_THREADS

            if (PyErr_Occurred())
                return 0;

            Py_INCREF(Py_None);
            return Py_None;
        }
    }

    sipNoMethod(sipParseErr, sipName_PGArrayStringEditorDialog, sipName_DoThaw, doc_wxPGArrayStringEditorDialog_DoThaw);

    return SIP_NULLPTR;
}


PyDoc_STRVAR(doc_wxPGArrayStringEditorDialog_HasTransparentBackground, "HasTransparentBackground(self) -> bool");

extern "C" {static PyObject *meth_wxPGArrayStringEditorDialog_HasTransparentBackground(PyObject *, PyObject *);}
static PyObject *meth_wxPGArrayStringEditorDialog_HasTransparentBackground(PyObject *sipSelf, PyObject *sipArgs)
{
    PyObject *sipParseErr = SIP_NULLPTR;
    bool sipSelfWasArg = (!sipSelf || sipIsDerivedClass((sipSimpleWrapper *)sipSelf));

    {
        sipwxPGArrayStringEditorDialog *sipCpp;

        if (sipParseArgs(&sipParseErr, sipArgs, "B", &sipSelf, sipType_wxPGArrayStringEditorDialog, &sipCpp))
        {
            bool sipRes;

            PyErr_Clear();

            Py_BEGIN_ALLOW_THREADS
            sipRes = sipCpp->sipProtectVirt_HasTransparentBackground(sipSelfWasArg);
            Py_END_ALLOW_THREADS

            if (PyErr_Occurred())
                return 0;

            return PyBool_FromLong(sipRes);
        }
    }

    sipNoMethod(sipParseErr, sipName_PGArrayStringEditorDialog, sipName_HasTransparentBackground, doc_wxPGArrayStringEditorDialog_HasTransparentBackground);

    return SIP_NULLPTR;
}


PyDoc_STRVAR(doc_wxPGArrayStringEditorDialog_TryBefore, "TryBefore(self, event: Event) -> bool");

extern "C" {static PyObject *meth_wxPGArrayStringEditorDialog_TryBefore(PyObject *, PyObject *, PyObject *);}
static PyObject *meth_wxPGArrayStringEditorDialog_TryBefore(PyObject *sipSelf, PyObject *sipArgs, PyObject *sipKwds)
{
    PyObject *sipParseErr = SIP_NULLPTR;
    bool sipSelfWasArg = (!sipSelf || sipIsDerivedClass((sipSimpleWrapper *)sipSelf));

    {
        ::wxEvent* event;
        sipwxPGArrayStringEditorDialog *sipCpp;

        static const char *sipKwdList[] = {
            sipName_event,
        };

        if (sipParseKwdArgs(&sipParseErr, sipArgs, sipKwds, sipKwdList, SIP_NULLPTR, "BJ9", &sipSelf, sipType_wxPGArrayStringEditorDialog, &sipCpp, sipType_wxEvent, &event))
        {
            bool sipRes;

            PyErr_Clear();

            Py_BEGIN_ALLOW_THREADS
            sipRes = sipCpp->sipProtectVirt_TryBefore(sipSelfWasArg, *event);
            Py_END_ALLOW_THREADS

            if (PyErr_Occurred())
                return 0;

            return PyBool_FromLong(sipRes);
        }
    }

    sipNoMethod(sipParseErr, sipName_PGArrayStringEditorDialog, sipName_TryBefore, doc_wxPGArrayStringEditorDialog_TryBefore);

    return SIP_NULLPTR;
}


PyDoc_STRVAR(doc_wxPGArrayStringEditorDialog_TryAfter, "TryAfter(self, event: Event) -> bool");

extern "C" {static PyObject *meth_wxPGArrayStringEditorDialog_TryAfter(PyObject *, PyObject *, PyObject *);}
static PyObject *meth_wxPGArrayStringEditorDialog_TryAfter(PyObject *sipSelf, PyObject *sipArgs, PyObject *sipKwds)
{
    PyObject *sipParseErr = SIP_NULLPTR;
    bool sipSelfWasArg = (!sipSelf || sipIsDerivedClass((sipSimpleWrapper *)sipSelf));

    {
        ::wxEvent* event;
        sipwxPGArrayStringEditorDialog *sipCpp;

        static const char *sipKwdList[] = {
            sipName_event,
        };

        if (sipParseKwdArgs(&sipParseErr, sipArgs, sipKwds, sipKwdList, SIP_NULLPTR, "BJ9", &sipSelf, sipType_wxPGArrayStringEditorDialog, &sipCpp, sipType_wxEvent, &event))
        {
            bool sipRes;

            PyErr_Clear();

            Py_BEGIN_ALLOW_THREADS
            sipRes = sipCpp->sipProtectVirt_TryAfter(sipSelfWasArg, *event);
            Py_END_ALLOW_THREADS

            if (PyErr_Occurred())
                return 0;

            return PyBool_FromLong(sipRes);
        }
    }

    sipNoMethod(sipParseErr, sipName_PGArrayStringEditorDialog, sipName_TryAfter, doc_wxPGArrayStringEditorDialog_TryAfter);

    return SIP_NULLPTR;
}


PyDoc_STRVAR(doc_wxPGArrayStringEditorDialog_Init, "Init()");

extern "C" {static PyObject *meth_wxPGArrayStringEditorDialog_Init(PyObject *, PyObject *);}
static PyObject *meth_wxPGArrayStringEditorDialog_Init(PyObject *sipSelf, PyObject *sipArgs)
{
    PyObject *sipParseErr = SIP_NULLPTR;

    {
        ::wxPGArrayStringEditorDialog *sipCpp;

        if (sipParseArgs(&sipParseErr, sipArgs, "B", &sipSelf, sipType_wxPGArrayStringEditorDialog, &sipCpp))
        {
            PyErr_Clear();

            Py_BEGIN_ALLOW_THREADS
            sipCpp->Init();
            Py_END_ALLOW_THREADS

            if (PyErr_Occurred())
                return 0;

            Py_INCREF(Py_None);
            return Py_None;
        }
    }

    sipNoMethod(sipParseErr, sipName_PGArrayStringEditorDialog, sipName_Init, SIP_NULLPTR);

    return SIP_NULLPTR;
}


PyDoc_STRVAR(doc_wxPGArrayStringEditorDialog_SetDialogValue, "SetDialogValue(value)\n"
"\n"
"Set value modified by dialog.");

extern "C" {static PyObject *meth_wxPGArrayStringEditorDialog_SetDialogValue(PyObject *, PyObject *, PyObject *);}
static PyObject *meth_wxPGArrayStringEditorDialog_SetDialogValue(PyObject *sipSelf, PyObject *sipArgs, PyObject *sipKwds)
{
    PyObject *sipParseErr = SIP_NULLPTR;
    bool sipSelfWasArg = (!sipSelf || sipIsDerivedClass((sipSimpleWrapper *)sipSelf));

    {
        const ::wxPGVariant* value;
        int valueState = 0;
        ::wxPGArrayStringEditorDialog *sipCpp;

        static const char *sipKwdList[] = {
            sipName_value,
        };

        if (sipParseKwdArgs(&sipParseErr, sipArgs, sipKwds, sipKwdList, SIP_NULLPTR, "BJ1", &sipSelf, sipType_wxPGArrayStringEditorDialog, &sipCpp, sipType_wxPGVariant, &value, &valueState))
        {
            PyErr_Clear();

            Py_BEGIN_ALLOW_THREADS
            (sipSelfWasArg ? sipCpp->::wxPGArrayStringEditorDialog::SetDialogValue(*value) : sipCpp->SetDialogValue(*value));
            Py_END_ALLOW_THREADS
            sipReleaseType(const_cast< ::wxPGVariant *>(value), sipType_wxPGVariant, valueState);

            if (PyErr_Occurred())
                return 0;

            Py_INCREF(Py_None);
            return Py_None;
        }
    }

    sipNoMethod(sipParseErr, sipName_PGArrayStringEditorDialog, sipName_SetDialogValue, SIP_NULLPTR);

    return SIP_NULLPTR;
}


PyDoc_STRVAR(doc_wxPGArrayStringEditorDialog_GetDialogValue, "GetDialogValue() -> PGVariant\n"
"\n"
"Return value modified by dialog.");

extern "C" {static PyObject *meth_wxPGArrayStringEditorDialog_GetDialogValue(PyObject *, PyObject *);}
static PyObject *meth_wxPGArrayStringEditorDialog_GetDialogValue(PyObject *sipSelf, PyObject *sipArgs)
{
    PyObject *sipParseErr = SIP_NULLPTR;
    bool sipSelfWasArg = (!sipSelf || sipIsDerivedClass((sipSimpleWrapper *)sipSelf));

    {
        const ::wxPGArrayStringEditorDialog *sipCpp;

        if (sipParseArgs(&sipParseErr, sipArgs, "B", &sipSelf, sipType_wxPGArrayStringEditorDialog, &sipCpp))
        {
            ::wxPGVariant*sipRes;

            PyErr_Clear();

            Py_BEGIN_ALLOW_THREADS
            sipRes = new ::wxPGVariant((sipSelfWasArg ? sipCpp->::wxPGArrayStringEditorDialog::GetDialogValue() : sipCpp->GetDialogValue()));
            Py_END_ALLOW_THREADS

            if (PyErr_Occurred())
                return 0;

            return sipConvertFromNewType(sipRes, sipType_wxPGVariant, SIP_NULLPTR);
        }
    }

    sipNoMethod(sipParseErr, sipName_PGArrayStringEditorDialog, sipName_GetDialogValue, SIP_NULLPTR);

    return SIP_NULLPTR;
}


PyDoc_STRVAR(doc_wxPGArrayStringEditorDialog_SetCustomButton, "SetCustomButton(custBtText, pcc)");

extern "C" {static PyObject *meth_wxPGArrayStringEditorDialog_SetCustomButton(PyObject *, PyObject *, PyObject *);}
static PyObject *meth_wxPGArrayStringEditorDialog_SetCustomButton(PyObject *sipSelf, PyObject *sipArgs, PyObject *sipKwds)
{
    PyObject *sipParseErr = SIP_NULLPTR;

    {
        const ::wxString* custBtText;
        int custBtTextState = 0;
        ::wxArrayStringProperty* pcc;
        ::wxPGArrayStringEditorDialog *sipCpp;

        static const char *sipKwdList[] = {
            sipName_custBtText,
            sipName_pcc,
        };

        if (sipParseKwdArgs(&sipParseErr, sipArgs, sipKwds, sipKwdList, SIP_NULLPTR, "BJ1J8", &sipSelf, sipType_wxPGArrayStringEditorDialog, &sipCpp, sipType_wxString, &custBtText, &custBtTextState, sipType_wxArrayStringProperty, &pcc))
        {
            PyErr_Clear();

            Py_BEGIN_ALLOW_THREADS
            sipCpp->SetCustomButton(*custBtText, pcc);
            Py_END_ALLOW_THREADS
            sipReleaseType(const_cast< ::wxString *>(custBtText), sipType_wxString, custBtTextState);

            if (PyErr_Occurred())
                return 0;

            Py_INCREF(Py_None);
            return Py_None;
        }
    }

    sipNoMethod(sipParseErr, sipName_PGArrayStringEditorDialog, sipName_SetCustomButton, SIP_NULLPTR);

    return SIP_NULLPTR;
}


PyDoc_STRVAR(doc_wxPGArrayStringEditorDialog_OnCustomNewAction, "OnCustomNewAction(resString) -> bool");

extern "C" {static PyObject *meth_wxPGArrayStringEditorDialog_OnCustomNewAction(PyObject *, PyObject *, PyObject *);}
static PyObject *meth_wxPGArrayStringEditorDialog_OnCustomNewAction(PyObject *sipSelf, PyObject *sipArgs, PyObject *sipKwds)
{
    PyObject *sipParseErr = SIP_NULLPTR;
    bool sipSelfWasArg = (!sipSelf || sipIsDerivedClass((sipSimpleWrapper *)sipSelf));

    {
        ::wxString* resString;
        int resStringState = 0;
        ::wxPGArrayStringEditorDialog *sipCpp;

        static const char *sipKwdList[] = {
            sipName_resString,
        };

        if (sipParseKwdArgs(&sipParseErr, sipArgs, sipKwds, sipKwdList, SIP_NULLPTR, "BJ0", &sipSelf, sipType_wxPGArrayStringEditorDialog, &sipCpp, sipType_wxString, &resString, &resStringState))
        {
            bool sipRes;

            PyErr_Clear();

            Py_BEGIN_ALLOW_THREADS
            sipRes = (sipSelfWasArg ? sipCpp->::wxPGArrayStringEditorDialog::OnCustomNewAction(resString) : sipCpp->OnCustomNewAction(resString));
            Py_END_ALLOW_THREADS
            sipReleaseType(resString, sipType_wxString, resStringState);

            if (PyErr_Occurred())
                return 0;

            return PyBool_FromLong(sipRes);
        }
    }

    sipNoMethod(sipParseErr, sipName_PGArrayStringEditorDialog, sipName_OnCustomNewAction, SIP_NULLPTR);

    return SIP_NULLPTR;
}


PyDoc_STRVAR(doc_wxPGArrayStringEditorDialog_GetClassDefaultAttributes, "GetClassDefaultAttributes(variant=wx.WINDOW_VARIANT_NORMAL) -> wx.VisualAttributes");

extern "C" {static PyObject *meth_wxPGArrayStringEditorDialog_GetClassDefaultAttributes(PyObject *, PyObject *, PyObject *);}
static PyObject *meth_wxPGArrayStringEditorDialog_GetClassDefaultAttributes(PyObject *, PyObject *sipArgs, PyObject *sipKwds)
{
    PyObject *sipParseErr = SIP_NULLPTR;

    {
        ::wxWindowVariant variant = wxWINDOW_VARIANT_NORMAL;

        static const char *sipKwdList[] = {
            sipName_variant,
        };

        if (sipParseKwdArgs(&sipParseErr, sipArgs, sipKwds, sipKwdList, SIP_NULLPTR, "|E", sipType_wxWindowVariant, &variant))
        {
            ::wxVisualAttributes*sipRes;

        if (!wxPyCheckForApp()) return NULL;

            PyErr_Clear();

            Py_BEGIN_ALLOW_THREADS
            sipRes = new ::wxVisualAttributes(::wxPGArrayStringEditorDialog::GetClassDefaultAttributes(variant));
            Py_END_ALLOW_THREADS

            if (PyErr_Occurred())
                return 0;

            return sipConvertFromNewType(sipRes, sipType_wxVisualAttributes, SIP_NULLPTR);
        }
    }

    sipNoMethod(sipParseErr, sipName_PGArrayStringEditorDialog, sipName_GetClassDefaultAttributes, SIP_NULLPTR);

    return SIP_NULLPTR;
}


PyDoc_STRVAR(doc_wxPGArrayStringEditorDialog_ArrayGet, "ArrayGet(index) -> String");

extern "C" {static PyObject *meth_wxPGArrayStringEditorDialog_ArrayGet(PyObject *, PyObject *, PyObject *);}
static PyObject *meth_wxPGArrayStringEditorDialog_ArrayGet(PyObject *sipSelf, PyObject *sipArgs, PyObject *sipKwds)
{
    PyObject *sipParseErr = SIP_NULLPTR;
    bool sipSelfWasArg = (!sipSelf || sipIsDerivedClass((sipSimpleWrapper *)sipSelf));

    {
        size_t index;
        sipwxPGArrayStringEditorDialog *sipCpp;

        static const char *sipKwdList[] = {
            sipName_index,
        };

        if (sipParseKwdArgs(&sipParseErr, sipArgs, sipKwds, sipKwdList, SIP_NULLPTR, "B=", &sipSelf, sipType_wxPGArrayStringEditorDialog, &sipCpp, &index))
        {
            ::wxString*sipRes;

            PyErr_Clear();

            Py_BEGIN_ALLOW_THREADS
            sipRes = new ::wxString(sipCpp->sipProtectVirt_ArrayGet(sipSelfWasArg, index));
            Py_END_ALLOW_THREADS

            if (PyErr_Occurred())
                return 0;

            return sipConvertFromNewType(sipRes, sipType_wxString, SIP_NULLPTR);
        }
    }

    sipNoMethod(sipParseErr, sipName_PGArrayStringEditorDialog, sipName_ArrayGet, SIP_NULLPTR);

    return SIP_NULLPTR;
}


PyDoc_STRVAR(doc_wxPGArrayStringEditorDialog_ArrayGetCount, "ArrayGetCount() -> size_t");

extern "C" {static PyObject *meth_wxPGArrayStringEditorDialog_ArrayGetCount(PyObject *, PyObject *);}
static PyObject *meth_wxPGArrayStringEditorDialog_ArrayGetCount(PyObject *sipSelf, PyObject *sipArgs)
{
    PyObject *sipParseErr = SIP_NULLPTR;
    bool sipSelfWasArg = (!sipSelf || sipIsDerivedClass((sipSimpleWrapper *)sipSelf));

    {
        sipwxPGArrayStringEditorDialog *sipCpp;

        if (sipParseArgs(&sipParseErr, sipArgs, "B", &sipSelf, sipType_wxPGArrayStringEditorDialog, &sipCpp))
        {
            size_t sipRes;

            PyErr_Clear();

            Py_BEGIN_ALLOW_THREADS
            sipRes = sipCpp->sipProtectVirt_ArrayGetCount(sipSelfWasArg);
            Py_END_ALLOW_THREADS

            if (PyErr_Occurred())
                return 0;

            return PyLong_FromUnsignedLong(sipRes);
        }
    }

    sipNoMethod(sipParseErr, sipName_PGArrayStringEditorDialog, sipName_ArrayGetCount, SIP_NULLPTR);

    return SIP_NULLPTR;
}


PyDoc_STRVAR(doc_wxPGArrayStringEditorDialog_ArrayInsert, "ArrayInsert(str, index) -> bool");

extern "C" {static PyObject *meth_wxPGArrayStringEditorDialog_ArrayInsert(PyObject *, PyObject *, PyObject *);}
static PyObject *meth_wxPGArrayStringEditorDialog_ArrayInsert(PyObject *sipSelf, PyObject *sipArgs, PyObject *sipKwds)
{
    PyObject *sipParseErr = SIP_NULLPTR;
    bool sipSelfWasArg = (!sipSelf || sipIsDerivedClass((sipSimpleWrapper *)sipSelf));

    {
        const ::wxString* str;
        int strState = 0;
        int index;
        sipwxPGArrayStringEditorDialog *sipCpp;

        static const char *sipKwdList[] = {
            sipName_str,
            sipName_index,
        };

        if (sipParseKwdArgs(&sipParseErr, sipArgs, sipKwds, sipKwdList, SIP_NULLPTR, "BJ1i", &sipSelf, sipType_wxPGArrayStringEditorDialog, &sipCpp, sipType_wxString, &str, &strState, &index))
        {
            bool sipRes;

            PyErr_Clear();

            Py_BEGIN_ALLOW_THREADS
            sipRes = sipCpp->sipProtectVirt_ArrayInsert(sipSelfWasArg, *str, index);
            Py_END_ALLOW_THREADS
            sipReleaseType(const_cast< ::wxString *>(str), sipType_wxString, strState);

            if (PyErr_Occurred())
                return 0;

            return PyBool_FromLong(sipRes);
        }
    }

    sipNoMethod(sipParseErr, sipName_PGArrayStringEditorDialog, sipName_ArrayInsert, SIP_NULLPTR);

    return SIP_NULLPTR;
}


PyDoc_STRVAR(doc_wxPGArrayStringEditorDialog_ArraySet, "ArraySet(index, str) -> bool");

extern "C" {static PyObject *meth_wxPGArrayStringEditorDialog_ArraySet(PyObject *, PyObject *, PyObject *);}
static PyObject *meth_wxPGArrayStringEditorDialog_ArraySet(PyObject *sipSelf, PyObject *sipArgs, PyObject *sipKwds)
{
    PyObject *sipParseErr = SIP_NULLPTR;
    bool sipSelfWasArg = (!sipSelf || sipIsDerivedClass((sipSimpleWrapper *)sipSelf));

    {
        size_t index;
        const ::wxString* str;
        int strState = 0;
        sipwxPGArrayStringEditorDialog *sipCpp;

        static const char *sipKwdList[] = {
            sipName_index,
            sipName_str,
        };

        if (sipParseKwdArgs(&sipParseErr, sipArgs, sipKwds, sipKwdList, SIP_NULLPTR, "B=J1", &sipSelf, sipType_wxPGArrayStringEditorDialog, &sipCpp, &index, sipType_wxString, &str, &strState))
        {
            bool sipRes;

            PyErr_Clear();

            Py_BEGIN_ALLOW_THREADS
            sipRes = sipCpp->sipProtectVirt_ArraySet(sipSelfWasArg, index, *str);
            Py_END_ALLOW_THREADS
            sipReleaseType(const_cast< ::wxString *>(str), sipType_wxString, strState);

            if (PyErr_Occurred())
                return 0;

            return PyBool_FromLong(sipRes);
        }
    }

    sipNoMethod(sipParseErr, sipName_PGArrayStringEditorDialog, sipName_ArraySet, SIP_NULLPTR);

    return SIP_NULLPTR;
}


PyDoc_STRVAR(doc_wxPGArrayStringEditorDialog_ArrayRemoveAt, "ArrayRemoveAt(index)");

extern "C" {static PyObject *meth_wxPGArrayStringEditorDialog_ArrayRemoveAt(PyObject *, PyObject *, PyObject *);}
static PyObject *meth_wxPGArrayStringEditorDialog_ArrayRemoveAt(PyObject *sipSelf, PyObject *sipArgs, PyObject *sipKwds)
{
    PyObject *sipParseErr = SIP_NULLPTR;
    bool sipSelfWasArg = (!sipSelf || sipIsDerivedClass((sipSimpleWrapper *)sipSelf));

    {
        int index;
        sipwxPGArrayStringEditorDialog *sipCpp;

        static const char *sipKwdList[] = {
            sipName_index,
        };

        if (sipParseKwdArgs(&sipParseErr, sipArgs, sipKwds, sipKwdList, SIP_NULLPTR, "Bi", &sipSelf, sipType_wxPGArrayStringEditorDialog, &sipCpp, &index))
        {
            PyErr_Clear();

            Py_BEGIN_ALLOW_THREADS
            sipCpp->sipProtectVirt_ArrayRemoveAt(sipSelfWasArg, index);
            Py_END_ALLOW_THREADS

            if (PyErr_Occurred())
                return 0;

            Py_INCREF(Py_None);
            return Py_None;
        }
    }

    sipNoMethod(sipParseErr, sipName_PGArrayStringEditorDialog, sipName_ArrayRemoveAt, SIP_NULLPTR);

    return SIP_NULLPTR;
}


PyDoc_STRVAR(doc_wxPGArrayStringEditorDialog_ArraySwap, "ArraySwap(first, second)");

extern "C" {static PyObject *meth_wxPGArrayStringEditorDialog_ArraySwap(PyObject *, PyObject *, PyObject *);}
static PyObject *meth_wxPGArrayStringEditorDialog_ArraySwap(PyObject *sipSelf, PyObject *sipArgs, PyObject *sipKwds)
{
    PyObject *sipParseErr = SIP_NULLPTR;
    bool sipSelfWasArg = (!sipSelf || sipIsDerivedClass((sipSimpleWrapper *)sipSelf));

    {
        size_t first;
        size_t second;
        sipwxPGArrayStringEditorDialog *sipCpp;

        static const char *sipKwdList[] = {
            sipName_first,
            sipName_second,
        };

        if (sipParseKwdArgs(&sipParseErr, sipArgs, sipKwds, sipKwdList, SIP_NULLPTR, "B==", &sipSelf, sipType_wxPGArrayStringEditorDialog, &sipCpp, &first, &second))
        {
            PyErr_Clear();

            Py_BEGIN_ALLOW_THREADS
            sipCpp->sipProtectVirt_ArraySwap(sipSelfWasArg, first, second);
            Py_END_ALLOW_THREADS

            if (PyErr_Occurred())
                return 0;

            Py_INCREF(Py_None);
            return Py_None;
        }
    }

    sipNoMethod(sipParseErr, sipName_PGArrayStringEditorDialog, sipName_ArraySwap, SIP_NULLPTR);

    return SIP_NULLPTR;
}


/* Cast a pointer to a type somewhere in its inheritance hierarchy. */
extern "C" {static void *cast_wxPGArrayStringEditorDialog(void *, const sipTypeDef *);}
static void *cast_wxPGArrayStringEditorDialog(void *sipCppV, const sipTypeDef *targetType)
{
    ::wxPGArrayStringEditorDialog *sipCpp = reinterpret_cast< ::wxPGArrayStringEditorDialog *>(sipCppV);

    if (targetType == sipType_wxPGArrayStringEditorDialog)
        return sipCppV;

    sipCppV = ((const sipClassTypeDef *)sipType_wxPGArrayEditorDialog)->ctd_cast(static_cast< ::wxPGArrayEditorDialog *>(sipCpp), targetType);
    if (sipCppV)
        return sipCppV;

    return SIP_NULLPTR;
}


/* Call the instance's destructor. */
extern "C" {static void release_wxPGArrayStringEditorDialog(void *, int);}
static void release_wxPGArrayStringEditorDialog(void *sipCppV, int sipState)
{
    Py_BEGIN_ALLOW_THREADS

    if (sipState & SIP_DERIVED_CLASS)
        delete reinterpret_cast<sipwxPGArrayStringEditorDialog *>(sipCppV);
    else
        delete reinterpret_cast< ::wxPGArrayStringEditorDialog *>(sipCppV);

    Py_END_ALLOW_THREADS
}


extern "C" {static void *array_wxPGArrayStringEditorDialog(Py_ssize_t);}
static void *array_wxPGArrayStringEditorDialog(Py_ssize_t sipNrElem)
{
    return new ::wxPGArrayStringEditorDialog[sipNrElem];
}


extern "C" {static void array_delete_wxPGArrayStringEditorDialog(void *);}
static void array_delete_wxPGArrayStringEditorDialog(void *sipCpp)
{
    delete[] reinterpret_cast< ::wxPGArrayStringEditorDialog *>(sipCpp);
}


extern "C" {static void dealloc_wxPGArrayStringEditorDialog(sipSimpleWrapper *);}
static void dealloc_wxPGArrayStringEditorDialog(sipSimpleWrapper *sipSelf)
{
    if (sipIsDerivedClass(sipSelf))
        reinterpret_cast<sipwxPGArrayStringEditorDialog *>(sipGetAddress(sipSelf))->sipPySelf = SIP_NULLPTR;

    if (sipIsOwnedByPython(sipSelf))
    {
        release_wxPGArrayStringEditorDialog(sipGetAddress(sipSelf), sipIsDerivedClass(sipSelf));
    }
}


extern "C" {static void *init_type_wxPGArrayStringEditorDialog(sipSimpleWrapper *, PyObject *, PyObject *, PyObject **, PyObject **, PyObject **);}
static void *init_type_wxPGArrayStringEditorDialog(sipSimpleWrapper *sipSelf, PyObject *sipArgs, PyObject *sipKwds, PyObject **sipUnused, PyObject **, PyObject **sipParseErr)
{
    sipwxPGArrayStringEditorDialog *sipCpp = SIP_NULLPTR;

    {
        if (sipParseKwdArgs(sipParseErr, sipArgs, sipKwds, SIP_NULLPTR, sipUnused, ""))
        {

        if (!wxPyCheckForApp()) return NULL;

            PyErr_Clear();

            Py_BEGIN_ALLOW_THREADS
            sipCpp = new sipwxPGArrayStringEditorDialog();
            Py_END_ALLOW_THREADS

            if (PyErr_Occurred())
            {
                delete sipCpp;
                return SIP_NULLPTR;
            }

            sipCpp->sipPySelf = sipSelf;

            return sipCpp;
        }
    }

    return SIP_NULLPTR;
}


/* Define this type's super-types. */
static sipEncodedTypeDef supers_wxPGArrayStringEditorDialog[] = {{23, 255, 1}};


static PyMethodDef methods_wxPGArrayStringEditorDialog[] = {
    {sipName_ArrayGet, SIP_MLMETH_CAST(meth_wxPGArrayStringEditorDialog_ArrayGet), METH_VARARGS|METH_KEYWORDS, doc_wxPGArrayStringEditorDialog_ArrayGet},
    {sipName_ArrayGetCount, meth_wxPGArrayStringEditorDialog_ArrayGetCount, METH_VARARGS, doc_wxPGArrayStringEditorDialog_ArrayGetCount},
    {sipName_ArrayInsert, SIP_MLMETH_CAST(meth_wxPGArrayStringEditorDialog_ArrayInsert), METH_VARARGS|METH_KEYWORDS, doc_wxPGArrayStringEditorDialog_ArrayInsert},
    {sipName_ArrayRemoveAt, SIP_MLMETH_CAST(meth_wxPGArrayStringEditorDialog_ArrayRemoveAt), METH_VARARGS|METH_KEYWORDS, doc_wxPGArrayStringEditorDialog_ArrayRemoveAt},
    {sipName_ArraySet, SIP_MLMETH_CAST(meth_wxPGArrayStringEditorDialog_ArraySet), METH_VARARGS|METH_KEYWORDS, doc_wxPGArrayStringEditorDialog_ArraySet},
    {sipName_ArraySwap, SIP_MLMETH_CAST(meth_wxPGArrayStringEditorDialog_ArraySwap), METH_VARARGS|METH_KEYWORDS, doc_wxPGArrayStringEditorDialog_ArraySwap},
    {sipName_DoEnable, SIP_MLMETH_CAST(meth_wxPGArrayStringEditorDialog_DoEnable), METH_VARARGS|METH_KEYWORDS, SIP_NULLPTR},
    {sipName_DoFreeze, meth_wxPGArrayStringEditorDialog_DoFreeze, METH_VARARGS, SIP_NULLPTR},
    {sipName_DoGetBestClientSize, meth_wxPGArrayStringEditorDialog_DoGetBestClientSize, METH_VARARGS, SIP_NULLPTR},
    {sipName_DoGetBestSize, meth_wxPGArrayStringEditorDialog_DoGetBestSize, METH_VARARGS, SIP_NULLPTR},
    {sipName_DoGetBorderSize, meth_wxPGArrayStringEditorDialog_DoGetBorderSize, METH_VARARGS, SIP_NULLPTR},
    {sipName_DoGetClientSize, SIP_MLMETH_CAST(meth_wxPGArrayStringEditorDialog_DoGetClientSize), METH_VARARGS|METH_KEYWORDS, SIP_NULLPTR},
    {sipName_DoGetPosition, SIP_MLMETH_CAST(meth_wxPGArrayStringEditorDialog_DoGetPosition), METH_VARARGS|METH_KEYWORDS, SIP_NULLPTR},
    {sipName_DoGetSize, SIP_MLMETH_CAST(meth_wxPGArrayStringEditorDialog_DoGetSize), METH_VARARGS|METH_KEYWORDS, SIP_NULLPTR},
    {sipName_DoMoveWindow, SIP_MLMETH_CAST(meth_wxPGArrayStringEditorDialog_DoMoveWindow), METH_VARARGS|METH_KEYWORDS, SIP_NULLPTR},
    {sipName_DoSetClientSize, SIP_MLMETH_CAST(meth_wxPGArrayStringEditorDialog_DoSetClientSize), METH_VARARGS|METH_KEYWORDS, SIP_NULLPTR},
    {sipName_DoSetSize, SIP_MLMETH_CAST(meth_wxPGArrayStringEditorDialog_DoSetSize), METH_VARARGS|METH_KEYWORDS, SIP_NULLPTR},
    {sipName_DoSetSizeHints, SIP_MLMETH_CAST(meth_wxPGArrayStringEditorDialog_DoSetSizeHints), METH_VARARGS|METH_KEYWORDS, SIP_NULLPTR},
    {sipName_DoSetWindowVariant, SIP_MLMETH_CAST(meth_wxPGArrayStringEditorDialog_DoSetWindowVariant), METH_VARARGS|METH_KEYWORDS, SIP_NULLPTR},
    {sipName_DoThaw, meth_wxPGArrayStringEditorDialog_DoThaw, METH_VARARGS, SIP_NULLPTR},
    {sipName_GetClassDefaultAttributes, SIP_MLMETH_CAST(meth_wxPGArrayStringEditorDialog_GetClassDefaultAttributes), METH_VARARGS|METH_KEYWORDS, doc_wxPGArrayStringEditorDialog_GetClassDefaultAttributes},
    {sipName_GetDefaultBorder, meth_wxPGArrayStringEditorDialog_GetDefaultBorder, METH_VARARGS, SIP_NULLPTR},
    {sipName_GetDefaultBorderForControl, meth_wxPGArrayStringEditorDialog_GetDefaultBorderForControl, METH_VARARGS, SIP_NULLPTR},
    {sipName_GetDialogValue, meth_wxPGArrayStringEditorDialog_GetDialogValue, METH_VARARGS, doc_wxPGArrayStringEditorDialog_GetDialogValue},
    {sipName_HasTransparentBackground, meth_wxPGArrayStringEditorDialog_HasTransparentBackground, METH_VARARGS, SIP_NULLPTR},
    {sipName_Init, meth_wxPGArrayStringEditorDialog_Init, METH_VARARGS, doc_wxPGArrayStringEditorDialog_Init},
    {sipName_OnCustomNewAction, SIP_MLMETH_CAST(meth_wxPGArrayStringEditorDialog_OnCustomNewAction), METH_VARARGS|METH_KEYWORDS, doc_wxPGArrayStringEditorDialog_OnCustomNewAction},
    {sipName_ProcessEvent, SIP_MLMETH_CAST(meth_wxPGArrayStringEditorDialog_ProcessEvent), METH_VARARGS|METH_KEYWORDS, SIP_NULLPTR},
    {sipName_SendDestroyEvent, meth_wxPGArrayStringEditorDialog_SendDestroyEvent, METH_VARARGS, SIP_NULLPTR},
    {sipName_SetCustomButton, SIP_MLMETH_CAST(meth_wxPGArrayStringEditorDialog_SetCustomButton), METH_VARARGS|METH_KEYWORDS, doc_wxPGArrayStringEditorDialog_SetCustomButton},
    {sipName_SetDialogValue, SIP_MLMETH_CAST(meth_wxPGArrayStringEditorDialog_SetDialogValue), METH_VARARGS|METH_KEYWORDS, doc_wxPGArrayStringEditorDialog_SetDialogValue},
    {sipName_TryAfter, SIP_MLMETH_CAST(meth_wxPGArrayStringEditorDialog_TryAfter), METH_VARARGS|METH_KEYWORDS, SIP_NULLPTR},
    {sipName_TryBefore, SIP_MLMETH_CAST(meth_wxPGArrayStringEditorDialog_TryBefore), METH_VARARGS|METH_KEYWORDS, SIP_NULLPTR}
};

sipVariableDef variables_wxPGArrayStringEditorDialog[] = {
    {PropertyVariable, sipName_DialogValue, &methods_wxPGArrayStringEditorDialog[23], &methods_wxPGArrayStringEditorDialog[30], SIP_NULLPTR, SIP_NULLPTR},
};

PyDoc_STRVAR(doc_wxPGArrayStringEditorDialog, "PGArrayStringEditorDialog()");


sipClassTypeDef sipTypeDef__propgrid_wxPGArrayStringEditorDialog = {
    {
        -1,
        SIP_NULLPTR,
        SIP_NULLPTR,
        SIP_TYPE_SCC|SIP_TYPE_CLASS,
        sipNameNr_wxPGArrayStringEditorDialog,
        SIP_NULLPTR,
        SIP_NULLPTR,
    },
    {
        sipNameNr_PGArrayStringEditorDialog,
        {0, 0, 1},
        33, methods_wxPGArrayStringEditorDialog,
        0, SIP_NULLPTR,
        1, variables_wxPGArrayStringEditorDialog,
        {SIP_NULLPTR, SIP_NULLPTR, SIP_NULLPTR, SIP_NULLPTR, SIP_NULLPTR, SIP_NULLPTR, SIP_NULLPTR, SIP_NULLPTR, SIP_NULLPTR, SIP_NULLPTR},
    },
    doc_wxPGArrayStringEditorDialog,
    -1,
    -1,
    supers_wxPGArrayStringEditorDialog,
    SIP_NULLPTR,
    init_type_wxPGArrayStringEditorDialog,
    SIP_NULLPTR,
    SIP_NULLPTR,
    SIP_NULLPTR,
    SIP_NULLPTR,
    dealloc_wxPGArrayStringEditorDialog,
    SIP_NULLPTR,
    array_wxPGArrayStringEditorDialog,
    SIP_NULLPTR,
    release_wxPGArrayStringEditorDialog,
    cast_wxPGArrayStringEditorDialog,
    SIP_NULLPTR,
    SIP_NULLPTR,
    SIP_NULLPTR,
    SIP_NULLPTR,
    SIP_NULLPTR,
    SIP_NULLPTR,
    array_delete_wxPGArrayStringEditorDialog,
    sizeof (::wxPGArrayStringEditorDialog),
};
