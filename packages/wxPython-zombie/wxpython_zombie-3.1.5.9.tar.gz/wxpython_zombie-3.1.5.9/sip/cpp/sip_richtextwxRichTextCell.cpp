/*
 * Interface wrapper code.
 *
 * Generated by SIP 6.15.1
 */

#include "sipAPI_richtext.h"

        #include <wx/richtext/richtextbuffer.h>

        #include <wx/richtext/richtextbuffer.h>
        #include <wx/richtext/richtextbuffer.h>
        #include <wx/gdicmn.h>
        #include <wx/dc.h>
        #include <wx/richtext/richtextbuffer.h>
        #include <wx/gdicmn.h>
        #include <wx/gdicmn.h>
        #include <wx/window.h>
        #include <wx/richtext/richtextbuffer.h>
        #include <wx/richtext/richtextbuffer.h>
        
        
        #include <wx/richtext/richtextbuffer.h>
        #include <wx/richtext/richtextstyles.h>
        #include <wx/richtext/richtextbuffer.h>
        #include <wx/richtext/richtextbuffer.h>
        #include <wx/richtext/richtextbuffer.h>
        #include <wx/richtext/richtextstyles.h>
        #include <wx/richtext/richtextbuffer.h>
        #include <wx/image.h>
        #include <wx/richtext/richtextctrl.h>
        #include <wx/richtext/richtextbuffer.h>
        #include <wx/richtext/richtextbuffer.h>
        #include <wx/xml/xml.h>
        #include <wx/richtext/richtextxml.h>
        #include <wx/richtext/richtextbuffer.h>
        #include <wx/richtext/richtextbuffer.h>
        #include <wx/object.h>
        #include <wx/object.h>
        #include <wx/object.h>


class sipwxRichTextCell : public ::wxRichTextCell
{
public:
    sipwxRichTextCell(::wxRichTextObject*);
    sipwxRichTextCell(const ::wxRichTextCell&);
    virtual ~sipwxRichTextCell();

    /*
     * There is a protected method for every virtual method visible from
     * this class.
     */
protected:
    bool UpdateFloatingObjects(const ::wxRect&, ::wxRichTextObject*) SIP_OVERRIDE;
    void InvalidateHierarchy(const ::wxRichTextRange&) SIP_OVERRIDE;
    void DoInvalidate(const ::wxRichTextRange&) SIP_OVERRIDE;
    const ::wxRichTextAttr& GetBasicStyle() const SIP_OVERRIDE;
    void SetBasicStyle(const ::wxRichTextAttr&) SIP_OVERRIDE;
    const ::wxRichTextAttr& GetDefaultStyle() const SIP_OVERRIDE;
    bool SetDefaultStyle(const ::wxRichTextAttr&) SIP_OVERRIDE;
    ::wxString GetText() const SIP_OVERRIDE;
    void UpdateRanges() SIP_OVERRIDE;
    bool ApplyStyleSheet(::wxRichTextStyleSheet*) SIP_OVERRIDE;
    bool CopyFragment(const ::wxRichTextRange&, ::wxRichTextParagraphLayoutBox&) SIP_OVERRIDE;
    bool InsertFragment(long, ::wxRichTextParagraphLayoutBox&) SIP_OVERRIDE;
    void PrepareContent(::wxRichTextParagraphLayoutBox&) SIP_OVERRIDE;
    bool HasParagraphAttributes(const ::wxRichTextRange&, const ::wxRichTextAttr&) const SIP_OVERRIDE;
    bool HasCharacterAttributes(const ::wxRichTextRange&, const ::wxRichTextAttr&) const SIP_OVERRIDE;
    bool SetObjectPropertiesWithUndo(::wxRichTextObject&, const ::wxRichTextProperties&, ::wxRichTextObject*) SIP_OVERRIDE;
    bool SetProperties(const ::wxRichTextRange&, const ::wxRichTextProperties&, int) SIP_OVERRIDE;
    bool FindNextParagraphNumber(::wxRichTextParagraph*, ::wxRichTextAttr&) const SIP_OVERRIDE;
    bool DoNumberList(const ::wxRichTextRange&, const ::wxRichTextRange&, int, ::wxRichTextListStyleDefinition*, int, int, int) SIP_OVERRIDE;
    bool ClearListStyle(const ::wxRichTextRange&, int) SIP_OVERRIDE;
    bool GetStyleForRange(const ::wxRichTextRange&, ::wxRichTextAttr&) SIP_OVERRIDE;
    bool DoGetStyle(long, ::wxRichTextAttr&, bool) SIP_OVERRIDE;
    bool GetUncombinedStyle(long, ::wxRichTextAttr&) SIP_OVERRIDE;
    bool GetStyle(long, ::wxRichTextAttr&) SIP_OVERRIDE;
    void SetStyle(::wxRichTextObject*, const ::wxRichTextAttr&, int) SIP_OVERRIDE;
    bool SetStyle(const ::wxRichTextRange&, const ::wxRichTextAttr&, int) SIP_OVERRIDE;
    bool PositionToXY(long, long*, long*) const SIP_OVERRIDE;
    long XYToPosition(long, long) const SIP_OVERRIDE;
    ::wxString GetParagraphText(long) const SIP_OVERRIDE;
    int GetLineCount() const SIP_OVERRIDE;
    int GetParagraphCount() const SIP_OVERRIDE;
    int GetParagraphLength(long) const SIP_OVERRIDE;
    ::wxRichTextParagraph* GetParagraphForLine(::wxRichTextLine*) const SIP_OVERRIDE;
    ::wxRichTextParagraph* GetParagraphAtLine(long) const SIP_OVERRIDE;
    ::wxRichTextObject* GetLeafObjectAtPosition(long) const SIP_OVERRIDE;
    ::wxRichTextLine* GetLineForVisibleLineNumber(long) const SIP_OVERRIDE;
    long GetVisibleLineNumber(long, bool, bool) const SIP_OVERRIDE;
    ::wxSize GetLineSizeAtPosition(long, bool) const SIP_OVERRIDE;
    ::wxRichTextParagraph* GetParagraphAtPosition(long, bool) const SIP_OVERRIDE;
    ::wxRichTextLine* GetLineAtYPosition(int) const SIP_OVERRIDE;
    ::wxRichTextLine* GetLineAtPosition(long, bool) const SIP_OVERRIDE;
    ::wxRichTextRange AddParagraphs(const ::wxString&, ::wxRichTextAttr*) SIP_OVERRIDE;
    ::wxRichTextRange AddImage(const ::wxImage&, ::wxRichTextAttr*) SIP_OVERRIDE;
    ::wxRichTextRange AddParagraph(const ::wxString&, ::wxRichTextAttr*) SIP_OVERRIDE;
    void Reset() SIP_OVERRIDE;
    void Clear() SIP_OVERRIDE;
    ::wxRichTextStyleSheet* GetStyleSheet() const SIP_OVERRIDE;
    bool PromoteList(int, const ::wxRichTextRange&, const ::wxString&, int, int) SIP_OVERRIDE;
    bool PromoteList(int, const ::wxRichTextRange&, ::wxRichTextListStyleDefinition*, int, int) SIP_OVERRIDE;
    bool NumberList(const ::wxRichTextRange&, const ::wxString&, int, int, int) SIP_OVERRIDE;
    bool NumberList(const ::wxRichTextRange&, ::wxRichTextListStyleDefinition*, int, int, int) SIP_OVERRIDE;
    bool SetListStyle(const ::wxRichTextRange&, const ::wxString&, int, int, int) SIP_OVERRIDE;
    bool SetListStyle(const ::wxRichTextRange&, ::wxRichTextListStyleDefinition*, int, int, int) SIP_OVERRIDE;
    void Move(const ::wxPoint&) SIP_OVERRIDE;
    ::wxRichTextObject* Clone() const SIP_OVERRIDE;
    void Show(bool) SIP_OVERRIDE;
    bool IsTopLevel() const SIP_OVERRIDE;
    bool AdjustAttributes(::wxRichTextAttr&, ::wxRichTextDrawingContext&) SIP_OVERRIDE;
    bool LayoutToBestSize(::wxDC&, ::wxRichTextDrawingContext&, ::wxRichTextBuffer*, const ::wxRichTextAttr&, const ::wxRichTextAttr&, const ::wxRect&, const ::wxRect&, int) SIP_OVERRIDE;
    ::wxRect GetAvailableContentArea(::wxDC&, ::wxRichTextDrawingContext&, const ::wxRect&) const SIP_OVERRIDE;
    int GetBottomMargin() const SIP_OVERRIDE;
    int GetTopMargin() const SIP_OVERRIDE;
    int GetRightMargin() const SIP_OVERRIDE;
    int GetLeftMargin() const SIP_OVERRIDE;
    void SetMargins(int, int, int, int) SIP_OVERRIDE;
    void SetMargins(int) SIP_OVERRIDE;
    ::wxRichTextParagraphLayoutBox* GetParentContainer() const SIP_OVERRIDE;
    ::wxRichTextParagraphLayoutBox* GetContainer() const SIP_OVERRIDE;
    void SetParent(::wxRichTextObject*) SIP_OVERRIDE;
    ::wxRichTextObject* GetParent() const SIP_OVERRIDE;
    bool IsAtomic() const SIP_OVERRIDE;
    bool IsComposite() const SIP_OVERRIDE;
    ::wxRect GetRect() const SIP_OVERRIDE;
    ::wxPoint GetAbsolutePosition() const SIP_OVERRIDE;
    void SetPosition(const ::wxPoint&) SIP_OVERRIDE;
    ::wxPoint GetPosition() const SIP_OVERRIDE;
    ::wxTextAttrSize GetNaturalSize() const SIP_OVERRIDE;
    void SetMinSize(const ::wxSize&) SIP_OVERRIDE;
    ::wxSize GetMinSize() const SIP_OVERRIDE;
    void SetMaxSize(const ::wxSize&) SIP_OVERRIDE;
    ::wxSize GetMaxSize() const SIP_OVERRIDE;
    void SetCachedSize(const ::wxSize&) SIP_OVERRIDE;
    ::wxSize GetCachedSize() const SIP_OVERRIDE;
    ::wxRichTextSelection GetSelection(long, long) const SIP_OVERRIDE;
    bool HandlesChildSelections() const SIP_OVERRIDE;
    void Invalidate(const ::wxRichTextRange&) SIP_OVERRIDE;
    ::wxString GetXMLNodeName() const SIP_OVERRIDE;
    bool UsesParagraphAttributes() const SIP_OVERRIDE;
    bool ImportFromXML(::wxRichTextBuffer*, ::wxXmlNode*, ::wxRichTextXMLHandler*, bool*) SIP_OVERRIDE;
    bool AcceptsFocus() const SIP_OVERRIDE;
    ::wxString GetPropertiesMenuLabel() const SIP_OVERRIDE;
    bool EditProperties(::wxWindow*, ::wxRichTextBuffer*) SIP_OVERRIDE;
    bool CanEditProperties() const SIP_OVERRIDE;
    ::wxRichTextObject* Split(::wxRichTextDrawingContext&) SIP_OVERRIDE;
    bool CanSplit(::wxRichTextDrawingContext&) const SIP_OVERRIDE;
    bool Merge(::wxRichTextObject*, ::wxRichTextDrawingContext&) SIP_OVERRIDE;
    bool CanMerge(::wxRichTextObject*, ::wxRichTextDrawingContext&) const SIP_OVERRIDE;
    ::wxString GetTextForRange(const ::wxRichTextRange&) const SIP_OVERRIDE;
    int GetFloatDirection() const SIP_OVERRIDE;
    bool IsFloating() const SIP_OVERRIDE;
    bool IsFloatable() const SIP_OVERRIDE;
    bool IsEmpty() const SIP_OVERRIDE;
    bool DeleteRange(const ::wxRichTextRange&) SIP_OVERRIDE;
    void CalculateRange(long, long&) SIP_OVERRIDE;
    ::wxRichTextObject* DoSplit(long) SIP_OVERRIDE;
    bool GetRangeSize(const ::wxRichTextRange&, ::wxSize&, int&, ::wxDC&, ::wxRichTextDrawingContext&, int, const ::wxPoint&, const ::wxSize&, ::wxArrayInt*) const SIP_OVERRIDE;
    ::wxSize GetBestSize() const SIP_OVERRIDE;
    bool FindPosition(::wxDC&, ::wxRichTextDrawingContext&, long, ::wxPoint&, int*, bool) SIP_OVERRIDE;
    int HitTest(::wxDC&, ::wxRichTextDrawingContext&, const ::wxPoint&, long&, ::wxRichTextObject**, ::wxRichTextObject**, int) SIP_OVERRIDE;
    bool Layout(::wxDC&, ::wxRichTextDrawingContext&, const ::wxRect&, const ::wxRect&, int) SIP_OVERRIDE;
    bool Draw(::wxDC&, ::wxRichTextDrawingContext&, const ::wxRichTextRange&, const ::wxRichTextSelection&, const ::wxRect&, int, int) SIP_OVERRIDE;
    ::wxRichTextObject* GetChildAtPosition(long) const SIP_OVERRIDE;

public:
    sipSimpleWrapper *sipPySelf;

private:
    sipwxRichTextCell(const sipwxRichTextCell &);
    sipwxRichTextCell &operator = (const sipwxRichTextCell &);

    char sipPyMethods[112];
};

sipwxRichTextCell::sipwxRichTextCell(::wxRichTextObject*parent): ::wxRichTextCell(parent), sipPySelf(SIP_NULLPTR)
{
    memset(sipPyMethods, 0, sizeof (sipPyMethods));
}

sipwxRichTextCell::sipwxRichTextCell(const ::wxRichTextCell& obj): ::wxRichTextCell(obj), sipPySelf(SIP_NULLPTR)
{
    memset(sipPyMethods, 0, sizeof (sipPyMethods));
}

sipwxRichTextCell::~sipwxRichTextCell()
{
    sipInstanceDestroyedEx(&sipPySelf);
}

bool sipwxRichTextCell::UpdateFloatingObjects(const ::wxRect& availableRect, ::wxRichTextObject*untilObj)
{
    sip_gilstate_t sipGILState;
    PyObject *sipMeth;

    sipMeth = sipIsPyMethod(&sipGILState, &sipPyMethods[0], &sipPySelf, SIP_NULLPTR, sipName_UpdateFloatingObjects);

    if (!sipMeth)
        return ::wxRichTextCell::UpdateFloatingObjects(availableRect, untilObj);

    extern bool sipVH__richtext_73(sip_gilstate_t, sipVirtErrorHandlerFunc, sipSimpleWrapper *, PyObject *, const ::wxRect&, ::wxRichTextObject*);

    return sipVH__richtext_73(sipGILState, 0, sipPySelf, sipMeth, availableRect, untilObj);
}

void sipwxRichTextCell::InvalidateHierarchy(const ::wxRichTextRange& invalidRange)
{
    sip_gilstate_t sipGILState;
    PyObject *sipMeth;

    sipMeth = sipIsPyMethod(&sipGILState, &sipPyMethods[1], &sipPySelf, SIP_NULLPTR, sipName_InvalidateHierarchy);

    if (!sipMeth)
    {
        ::wxRichTextCell::InvalidateHierarchy(invalidRange);
        return;
    }

    extern void sipVH__richtext_18(sip_gilstate_t, sipVirtErrorHandlerFunc, sipSimpleWrapper *, PyObject *, const ::wxRichTextRange&);

    sipVH__richtext_18(sipGILState, 0, sipPySelf, sipMeth, invalidRange);
}

void sipwxRichTextCell::DoInvalidate(const ::wxRichTextRange& invalidRange)
{
    sip_gilstate_t sipGILState;
    PyObject *sipMeth;

    sipMeth = sipIsPyMethod(&sipGILState, &sipPyMethods[2], &sipPySelf, SIP_NULLPTR, sipName_DoInvalidate);

    if (!sipMeth)
    {
        ::wxRichTextCell::DoInvalidate(invalidRange);
        return;
    }

    extern void sipVH__richtext_18(sip_gilstate_t, sipVirtErrorHandlerFunc, sipSimpleWrapper *, PyObject *, const ::wxRichTextRange&);

    sipVH__richtext_18(sipGILState, 0, sipPySelf, sipMeth, invalidRange);
}

const ::wxRichTextAttr& sipwxRichTextCell::GetBasicStyle() const
{
    sip_gilstate_t sipGILState;
    PyObject *sipMeth;

    sipMeth = sipIsPyMethod(&sipGILState, const_cast<char *>(&sipPyMethods[3]), const_cast<sipSimpleWrapper **>(&sipPySelf), SIP_NULLPTR, sipName_GetBasicStyle);

    if (!sipMeth)
        return ::wxRichTextCell::GetBasicStyle();

    extern const ::wxRichTextAttr& sipVH__richtext_71(sip_gilstate_t, sipVirtErrorHandlerFunc, sipSimpleWrapper *, PyObject *);

    return sipVH__richtext_71(sipGILState, 0, sipPySelf, sipMeth);
}

void sipwxRichTextCell::SetBasicStyle(const ::wxRichTextAttr& style)
{
    sip_gilstate_t sipGILState;
    PyObject *sipMeth;

    sipMeth = sipIsPyMethod(&sipGILState, &sipPyMethods[4], &sipPySelf, SIP_NULLPTR, sipName_SetBasicStyle);

    if (!sipMeth)
    {
        ::wxRichTextCell::SetBasicStyle(style);
        return;
    }

    extern void sipVH__richtext_72(sip_gilstate_t, sipVirtErrorHandlerFunc, sipSimpleWrapper *, PyObject *, const ::wxRichTextAttr&);

    sipVH__richtext_72(sipGILState, 0, sipPySelf, sipMeth, style);
}

const ::wxRichTextAttr& sipwxRichTextCell::GetDefaultStyle() const
{
    sip_gilstate_t sipGILState;
    PyObject *sipMeth;

    sipMeth = sipIsPyMethod(&sipGILState, const_cast<char *>(&sipPyMethods[5]), const_cast<sipSimpleWrapper **>(&sipPySelf), SIP_NULLPTR, sipName_GetDefaultStyle);

    if (!sipMeth)
        return ::wxRichTextCell::GetDefaultStyle();

    extern const ::wxRichTextAttr& sipVH__richtext_71(sip_gilstate_t, sipVirtErrorHandlerFunc, sipSimpleWrapper *, PyObject *);

    return sipVH__richtext_71(sipGILState, 0, sipPySelf, sipMeth);
}

bool sipwxRichTextCell::SetDefaultStyle(const ::wxRichTextAttr& style)
{
    sip_gilstate_t sipGILState;
    PyObject *sipMeth;

    sipMeth = sipIsPyMethod(&sipGILState, &sipPyMethods[6], &sipPySelf, SIP_NULLPTR, sipName_SetDefaultStyle);

    if (!sipMeth)
        return ::wxRichTextCell::SetDefaultStyle(style);

    extern bool sipVH__richtext_70(sip_gilstate_t, sipVirtErrorHandlerFunc, sipSimpleWrapper *, PyObject *, const ::wxRichTextAttr&);

    return sipVH__richtext_70(sipGILState, 0, sipPySelf, sipMeth, style);
}

::wxString sipwxRichTextCell::GetText() const
{
    sip_gilstate_t sipGILState;
    PyObject *sipMeth;

    sipMeth = sipIsPyMethod(&sipGILState, const_cast<char *>(&sipPyMethods[7]), const_cast<sipSimpleWrapper **>(&sipPySelf), SIP_NULLPTR, sipName_GetText);

    if (!sipMeth)
        return ::wxRichTextCell::GetText();

    extern ::wxString sipVH__richtext_16(sip_gilstate_t, sipVirtErrorHandlerFunc, sipSimpleWrapper *, PyObject *);

    return sipVH__richtext_16(sipGILState, 0, sipPySelf, sipMeth);
}

void sipwxRichTextCell::UpdateRanges()
{
    sip_gilstate_t sipGILState;
    PyObject *sipMeth;

    sipMeth = sipIsPyMethod(&sipGILState, &sipPyMethods[8], &sipPySelf, SIP_NULLPTR, sipName_UpdateRanges);

    if (!sipMeth)
    {
        ::wxRichTextCell::UpdateRanges();
        return;
    }

    extern void sipVH__richtext_40(sip_gilstate_t, sipVirtErrorHandlerFunc, sipSimpleWrapper *, PyObject *);

    sipVH__richtext_40(sipGILState, 0, sipPySelf, sipMeth);
}

bool sipwxRichTextCell::ApplyStyleSheet(::wxRichTextStyleSheet*styleSheet)
{
    sip_gilstate_t sipGILState;
    PyObject *sipMeth;

    sipMeth = sipIsPyMethod(&sipGILState, &sipPyMethods[9], &sipPySelf, SIP_NULLPTR, sipName_ApplyStyleSheet);

    if (!sipMeth)
        return ::wxRichTextCell::ApplyStyleSheet(styleSheet);

    extern bool sipVH__richtext_69(sip_gilstate_t, sipVirtErrorHandlerFunc, sipSimpleWrapper *, PyObject *, ::wxRichTextStyleSheet*);

    return sipVH__richtext_69(sipGILState, 0, sipPySelf, sipMeth, styleSheet);
}

bool sipwxRichTextCell::CopyFragment(const ::wxRichTextRange& range, ::wxRichTextParagraphLayoutBox& fragment)
{
    sip_gilstate_t sipGILState;
    PyObject *sipMeth;

    sipMeth = sipIsPyMethod(&sipGILState, &sipPyMethods[10], &sipPySelf, SIP_NULLPTR, sipName_CopyFragment);

    if (!sipMeth)
        return ::wxRichTextCell::CopyFragment(range, fragment);

    extern bool sipVH__richtext_68(sip_gilstate_t, sipVirtErrorHandlerFunc, sipSimpleWrapper *, PyObject *, const ::wxRichTextRange&, ::wxRichTextParagraphLayoutBox&);

    return sipVH__richtext_68(sipGILState, 0, sipPySelf, sipMeth, range, fragment);
}

bool sipwxRichTextCell::InsertFragment(long position, ::wxRichTextParagraphLayoutBox& fragment)
{
    sip_gilstate_t sipGILState;
    PyObject *sipMeth;

    sipMeth = sipIsPyMethod(&sipGILState, &sipPyMethods[11], &sipPySelf, SIP_NULLPTR, sipName_InsertFragment);

    if (!sipMeth)
        return ::wxRichTextCell::InsertFragment(position, fragment);

    extern bool sipVH__richtext_67(sip_gilstate_t, sipVirtErrorHandlerFunc, sipSimpleWrapper *, PyObject *, long, ::wxRichTextParagraphLayoutBox&);

    return sipVH__richtext_67(sipGILState, 0, sipPySelf, sipMeth, position, fragment);
}

void sipwxRichTextCell::PrepareContent(::wxRichTextParagraphLayoutBox& container)
{
    sip_gilstate_t sipGILState;
    PyObject *sipMeth;

    sipMeth = sipIsPyMethod(&sipGILState, &sipPyMethods[12], &sipPySelf, SIP_NULLPTR, sipName_PrepareContent);

    if (!sipMeth)
    {
        ::wxRichTextCell::PrepareContent(container);
        return;
    }

    extern void sipVH__richtext_66(sip_gilstate_t, sipVirtErrorHandlerFunc, sipSimpleWrapper *, PyObject *, ::wxRichTextParagraphLayoutBox&);

    sipVH__richtext_66(sipGILState, 0, sipPySelf, sipMeth, container);
}

bool sipwxRichTextCell::HasParagraphAttributes(const ::wxRichTextRange& range, const ::wxRichTextAttr& style) const
{
    sip_gilstate_t sipGILState;
    PyObject *sipMeth;

    sipMeth = sipIsPyMethod(&sipGILState, const_cast<char *>(&sipPyMethods[13]), const_cast<sipSimpleWrapper **>(&sipPySelf), SIP_NULLPTR, sipName_HasParagraphAttributes);

    if (!sipMeth)
        return ::wxRichTextCell::HasParagraphAttributes(range, style);

    extern bool sipVH__richtext_65(sip_gilstate_t, sipVirtErrorHandlerFunc, sipSimpleWrapper *, PyObject *, const ::wxRichTextRange&, const ::wxRichTextAttr&);

    return sipVH__richtext_65(sipGILState, 0, sipPySelf, sipMeth, range, style);
}

bool sipwxRichTextCell::HasCharacterAttributes(const ::wxRichTextRange& range, const ::wxRichTextAttr& style) const
{
    sip_gilstate_t sipGILState;
    PyObject *sipMeth;

    sipMeth = sipIsPyMethod(&sipGILState, const_cast<char *>(&sipPyMethods[14]), const_cast<sipSimpleWrapper **>(&sipPySelf), SIP_NULLPTR, sipName_HasCharacterAttributes);

    if (!sipMeth)
        return ::wxRichTextCell::HasCharacterAttributes(range, style);

    extern bool sipVH__richtext_65(sip_gilstate_t, sipVirtErrorHandlerFunc, sipSimpleWrapper *, PyObject *, const ::wxRichTextRange&, const ::wxRichTextAttr&);

    return sipVH__richtext_65(sipGILState, 0, sipPySelf, sipMeth, range, style);
}

bool sipwxRichTextCell::SetObjectPropertiesWithUndo(::wxRichTextObject& obj, const ::wxRichTextProperties& properties, ::wxRichTextObject*objToSet)
{
    sip_gilstate_t sipGILState;
    PyObject *sipMeth;

    sipMeth = sipIsPyMethod(&sipGILState, &sipPyMethods[15], &sipPySelf, SIP_NULLPTR, sipName_SetObjectPropertiesWithUndo);

    if (!sipMeth)
        return ::wxRichTextCell::SetObjectPropertiesWithUndo(obj, properties, objToSet);

    extern bool sipVH__richtext_64(sip_gilstate_t, sipVirtErrorHandlerFunc, sipSimpleWrapper *, PyObject *, ::wxRichTextObject&, const ::wxRichTextProperties&, ::wxRichTextObject*);

    return sipVH__richtext_64(sipGILState, 0, sipPySelf, sipMeth, obj, properties, objToSet);
}

bool sipwxRichTextCell::SetProperties(const ::wxRichTextRange& range, const ::wxRichTextProperties& properties, int flags)
{
    sip_gilstate_t sipGILState;
    PyObject *sipMeth;

    sipMeth = sipIsPyMethod(&sipGILState, &sipPyMethods[16], &sipPySelf, SIP_NULLPTR, sipName_SetProperties);

    if (!sipMeth)
        return ::wxRichTextCell::SetProperties(range, properties, flags);

    extern bool sipVH__richtext_63(sip_gilstate_t, sipVirtErrorHandlerFunc, sipSimpleWrapper *, PyObject *, const ::wxRichTextRange&, const ::wxRichTextProperties&, int);

    return sipVH__richtext_63(sipGILState, 0, sipPySelf, sipMeth, range, properties, flags);
}

bool sipwxRichTextCell::FindNextParagraphNumber(::wxRichTextParagraph*previousParagraph, ::wxRichTextAttr& attr) const
{
    sip_gilstate_t sipGILState;
    PyObject *sipMeth;

    sipMeth = sipIsPyMethod(&sipGILState, const_cast<char *>(&sipPyMethods[17]), const_cast<sipSimpleWrapper **>(&sipPySelf), SIP_NULLPTR, sipName_FindNextParagraphNumber);

    if (!sipMeth)
        return ::wxRichTextCell::FindNextParagraphNumber(previousParagraph, attr);

    extern bool sipVH__richtext_62(sip_gilstate_t, sipVirtErrorHandlerFunc, sipSimpleWrapper *, PyObject *, ::wxRichTextParagraph*, ::wxRichTextAttr&);

    return sipVH__richtext_62(sipGILState, 0, sipPySelf, sipMeth, previousParagraph, attr);
}

bool sipwxRichTextCell::DoNumberList(const ::wxRichTextRange& range, const ::wxRichTextRange& promotionRange, int promoteBy, ::wxRichTextListStyleDefinition*styleDef, int flags, int startFrom, int specifiedLevel)
{
    sip_gilstate_t sipGILState;
    PyObject *sipMeth;

    sipMeth = sipIsPyMethod(&sipGILState, &sipPyMethods[18], &sipPySelf, SIP_NULLPTR, sipName_DoNumberList);

    if (!sipMeth)
        return ::wxRichTextCell::DoNumberList(range, promotionRange, promoteBy, styleDef, flags, startFrom, specifiedLevel);

    extern bool sipVH__richtext_61(sip_gilstate_t, sipVirtErrorHandlerFunc, sipSimpleWrapper *, PyObject *, const ::wxRichTextRange&, const ::wxRichTextRange&, int, ::wxRichTextListStyleDefinition*, int, int, int);

    return sipVH__richtext_61(sipGILState, 0, sipPySelf, sipMeth, range, promotionRange, promoteBy, styleDef, flags, startFrom, specifiedLevel);
}

bool sipwxRichTextCell::ClearListStyle(const ::wxRichTextRange& range, int flags)
{
    sip_gilstate_t sipGILState;
    PyObject *sipMeth;

    sipMeth = sipIsPyMethod(&sipGILState, &sipPyMethods[19], &sipPySelf, SIP_NULLPTR, sipName_ClearListStyle);

    if (!sipMeth)
        return ::wxRichTextCell::ClearListStyle(range, flags);

    extern bool sipVH__richtext_60(sip_gilstate_t, sipVirtErrorHandlerFunc, sipSimpleWrapper *, PyObject *, const ::wxRichTextRange&, int);

    return sipVH__richtext_60(sipGILState, 0, sipPySelf, sipMeth, range, flags);
}

bool sipwxRichTextCell::GetStyleForRange(const ::wxRichTextRange& range, ::wxRichTextAttr& style)
{
    sip_gilstate_t sipGILState;
    PyObject *sipMeth;

    sipMeth = sipIsPyMethod(&sipGILState, &sipPyMethods[20], &sipPySelf, SIP_NULLPTR, sipName_GetStyleForRange);

    if (!sipMeth)
        return ::wxRichTextCell::GetStyleForRange(range, style);

    extern bool sipVH__richtext_59(sip_gilstate_t, sipVirtErrorHandlerFunc, sipSimpleWrapper *, PyObject *, const ::wxRichTextRange&, ::wxRichTextAttr&);

    return sipVH__richtext_59(sipGILState, 0, sipPySelf, sipMeth, range, style);
}

bool sipwxRichTextCell::DoGetStyle(long position, ::wxRichTextAttr& style, bool combineStyles)
{
    sip_gilstate_t sipGILState;
    PyObject *sipMeth;

    sipMeth = sipIsPyMethod(&sipGILState, &sipPyMethods[21], &sipPySelf, SIP_NULLPTR, sipName_DoGetStyle);

    if (!sipMeth)
        return ::wxRichTextCell::DoGetStyle(position, style, combineStyles);

    extern bool sipVH__richtext_58(sip_gilstate_t, sipVirtErrorHandlerFunc, sipSimpleWrapper *, PyObject *, long, ::wxRichTextAttr&, bool);

    return sipVH__richtext_58(sipGILState, 0, sipPySelf, sipMeth, position, style, combineStyles);
}

bool sipwxRichTextCell::GetUncombinedStyle(long position, ::wxRichTextAttr& style)
{
    sip_gilstate_t sipGILState;
    PyObject *sipMeth;

    sipMeth = sipIsPyMethod(&sipGILState, &sipPyMethods[22], &sipPySelf, SIP_NULLPTR, sipName_GetUncombinedStyle);

    if (!sipMeth)
        return ::wxRichTextCell::GetUncombinedStyle(position, style);

    extern bool sipVH__richtext_57(sip_gilstate_t, sipVirtErrorHandlerFunc, sipSimpleWrapper *, PyObject *, long, ::wxRichTextAttr&);

    return sipVH__richtext_57(sipGILState, 0, sipPySelf, sipMeth, position, style);
}

bool sipwxRichTextCell::GetStyle(long position, ::wxRichTextAttr& style)
{
    sip_gilstate_t sipGILState;
    PyObject *sipMeth;

    sipMeth = sipIsPyMethod(&sipGILState, &sipPyMethods[23], &sipPySelf, SIP_NULLPTR, sipName_GetStyle);

    if (!sipMeth)
        return ::wxRichTextCell::GetStyle(position, style);

    extern bool sipVH__richtext_57(sip_gilstate_t, sipVirtErrorHandlerFunc, sipSimpleWrapper *, PyObject *, long, ::wxRichTextAttr&);

    return sipVH__richtext_57(sipGILState, 0, sipPySelf, sipMeth, position, style);
}

void sipwxRichTextCell::SetStyle(::wxRichTextObject*obj, const ::wxRichTextAttr& textAttr, int flags)
{
    sip_gilstate_t sipGILState;
    PyObject *sipMeth;

    sipMeth = sipIsPyMethod(&sipGILState, &sipPyMethods[24], &sipPySelf, SIP_NULLPTR, sipName_SetStyle);

    if (!sipMeth)
    {
        ::wxRichTextCell::SetStyle(obj, textAttr, flags);
        return;
    }

    extern void sipVH__richtext_56(sip_gilstate_t, sipVirtErrorHandlerFunc, sipSimpleWrapper *, PyObject *, ::wxRichTextObject*, const ::wxRichTextAttr&, int);

    sipVH__richtext_56(sipGILState, 0, sipPySelf, sipMeth, obj, textAttr, flags);
}

bool sipwxRichTextCell::SetStyle(const ::wxRichTextRange& range, const ::wxRichTextAttr& style, int flags)
{
    sip_gilstate_t sipGILState;
    PyObject *sipMeth;

    sipMeth = sipIsPyMethod(&sipGILState, &sipPyMethods[25], &sipPySelf, SIP_NULLPTR, sipName_SetStyle);

    if (!sipMeth)
        return ::wxRichTextCell::SetStyle(range, style, flags);

    extern bool sipVH__richtext_55(sip_gilstate_t, sipVirtErrorHandlerFunc, sipSimpleWrapper *, PyObject *, const ::wxRichTextRange&, const ::wxRichTextAttr&, int);

    return sipVH__richtext_55(sipGILState, 0, sipPySelf, sipMeth, range, style, flags);
}

bool sipwxRichTextCell::PositionToXY(long pos, long*x, long*y) const
{
    sip_gilstate_t sipGILState;
    PyObject *sipMeth;

    sipMeth = sipIsPyMethod(&sipGILState, const_cast<char *>(&sipPyMethods[26]), const_cast<sipSimpleWrapper **>(&sipPySelf), SIP_NULLPTR, sipName_PositionToXY);

    if (!sipMeth)
        return ::wxRichTextCell::PositionToXY(pos, x, y);

    extern bool sipVH__richtext_54(sip_gilstate_t, sipVirtErrorHandlerFunc, sipSimpleWrapper *, PyObject *, long, long*, long*);

    return sipVH__richtext_54(sipGILState, 0, sipPySelf, sipMeth, pos, x, y);
}

long sipwxRichTextCell::XYToPosition(long x, long y) const
{
    sip_gilstate_t sipGILState;
    PyObject *sipMeth;

    sipMeth = sipIsPyMethod(&sipGILState, const_cast<char *>(&sipPyMethods[27]), const_cast<sipSimpleWrapper **>(&sipPySelf), SIP_NULLPTR, sipName_XYToPosition);

    if (!sipMeth)
        return ::wxRichTextCell::XYToPosition(x, y);

    extern long sipVH__richtext_53(sip_gilstate_t, sipVirtErrorHandlerFunc, sipSimpleWrapper *, PyObject *, long, long);

    return sipVH__richtext_53(sipGILState, 0, sipPySelf, sipMeth, x, y);
}

::wxString sipwxRichTextCell::GetParagraphText(long paragraphNumber) const
{
    sip_gilstate_t sipGILState;
    PyObject *sipMeth;

    sipMeth = sipIsPyMethod(&sipGILState, const_cast<char *>(&sipPyMethods[28]), const_cast<sipSimpleWrapper **>(&sipPySelf), SIP_NULLPTR, sipName_GetParagraphText);

    if (!sipMeth)
        return ::wxRichTextCell::GetParagraphText(paragraphNumber);

    extern ::wxString sipVH__richtext_52(sip_gilstate_t, sipVirtErrorHandlerFunc, sipSimpleWrapper *, PyObject *, long);

    return sipVH__richtext_52(sipGILState, 0, sipPySelf, sipMeth, paragraphNumber);
}

int sipwxRichTextCell::GetLineCount() const
{
    sip_gilstate_t sipGILState;
    PyObject *sipMeth;

    sipMeth = sipIsPyMethod(&sipGILState, const_cast<char *>(&sipPyMethods[29]), const_cast<sipSimpleWrapper **>(&sipPySelf), SIP_NULLPTR, sipName_GetLineCount);

    if (!sipMeth)
        return ::wxRichTextCell::GetLineCount();

    extern int sipVH__richtext_10(sip_gilstate_t, sipVirtErrorHandlerFunc, sipSimpleWrapper *, PyObject *);

    return sipVH__richtext_10(sipGILState, 0, sipPySelf, sipMeth);
}

int sipwxRichTextCell::GetParagraphCount() const
{
    sip_gilstate_t sipGILState;
    PyObject *sipMeth;

    sipMeth = sipIsPyMethod(&sipGILState, const_cast<char *>(&sipPyMethods[30]), const_cast<sipSimpleWrapper **>(&sipPySelf), SIP_NULLPTR, sipName_GetParagraphCount);

    if (!sipMeth)
        return ::wxRichTextCell::GetParagraphCount();

    extern int sipVH__richtext_10(sip_gilstate_t, sipVirtErrorHandlerFunc, sipSimpleWrapper *, PyObject *);

    return sipVH__richtext_10(sipGILState, 0, sipPySelf, sipMeth);
}

int sipwxRichTextCell::GetParagraphLength(long paragraphNumber) const
{
    sip_gilstate_t sipGILState;
    PyObject *sipMeth;

    sipMeth = sipIsPyMethod(&sipGILState, const_cast<char *>(&sipPyMethods[31]), const_cast<sipSimpleWrapper **>(&sipPySelf), SIP_NULLPTR, sipName_GetParagraphLength);

    if (!sipMeth)
        return ::wxRichTextCell::GetParagraphLength(paragraphNumber);

    extern int sipVH__richtext_51(sip_gilstate_t, sipVirtErrorHandlerFunc, sipSimpleWrapper *, PyObject *, long);

    return sipVH__richtext_51(sipGILState, 0, sipPySelf, sipMeth, paragraphNumber);
}

::wxRichTextParagraph* sipwxRichTextCell::GetParagraphForLine(::wxRichTextLine*line) const
{
    sip_gilstate_t sipGILState;
    PyObject *sipMeth;

    sipMeth = sipIsPyMethod(&sipGILState, const_cast<char *>(&sipPyMethods[32]), const_cast<sipSimpleWrapper **>(&sipPySelf), SIP_NULLPTR, sipName_GetParagraphForLine);

    if (!sipMeth)
        return ::wxRichTextCell::GetParagraphForLine(line);

    extern ::wxRichTextParagraph* sipVH__richtext_50(sip_gilstate_t, sipVirtErrorHandlerFunc, sipSimpleWrapper *, PyObject *, ::wxRichTextLine*);

    return sipVH__richtext_50(sipGILState, 0, sipPySelf, sipMeth, line);
}

::wxRichTextParagraph* sipwxRichTextCell::GetParagraphAtLine(long paragraphNumber) const
{
    sip_gilstate_t sipGILState;
    PyObject *sipMeth;

    sipMeth = sipIsPyMethod(&sipGILState, const_cast<char *>(&sipPyMethods[33]), const_cast<sipSimpleWrapper **>(&sipPySelf), SIP_NULLPTR, sipName_GetParagraphAtLine);

    if (!sipMeth)
        return ::wxRichTextCell::GetParagraphAtLine(paragraphNumber);

    extern ::wxRichTextParagraph* sipVH__richtext_49(sip_gilstate_t, sipVirtErrorHandlerFunc, sipSimpleWrapper *, PyObject *, long);

    return sipVH__richtext_49(sipGILState, 0, sipPySelf, sipMeth, paragraphNumber);
}

::wxRichTextObject* sipwxRichTextCell::GetLeafObjectAtPosition(long position) const
{
    sip_gilstate_t sipGILState;
    PyObject *sipMeth;

    sipMeth = sipIsPyMethod(&sipGILState, const_cast<char *>(&sipPyMethods[34]), const_cast<sipSimpleWrapper **>(&sipPySelf), SIP_NULLPTR, sipName_GetLeafObjectAtPosition);

    if (!sipMeth)
        return ::wxRichTextCell::GetLeafObjectAtPosition(position);

    extern ::wxRichTextObject* sipVH__richtext_6(sip_gilstate_t, sipVirtErrorHandlerFunc, sipSimpleWrapper *, PyObject *, long);

    return sipVH__richtext_6(sipGILState, 0, sipPySelf, sipMeth, position);
}

::wxRichTextLine* sipwxRichTextCell::GetLineForVisibleLineNumber(long lineNumber) const
{
    sip_gilstate_t sipGILState;
    PyObject *sipMeth;

    sipMeth = sipIsPyMethod(&sipGILState, const_cast<char *>(&sipPyMethods[35]), const_cast<sipSimpleWrapper **>(&sipPySelf), SIP_NULLPTR, sipName_GetLineForVisibleLineNumber);

    if (!sipMeth)
        return ::wxRichTextCell::GetLineForVisibleLineNumber(lineNumber);

    extern ::wxRichTextLine* sipVH__richtext_48(sip_gilstate_t, sipVirtErrorHandlerFunc, sipSimpleWrapper *, PyObject *, long);

    return sipVH__richtext_48(sipGILState, 0, sipPySelf, sipMeth, lineNumber);
}

long sipwxRichTextCell::GetVisibleLineNumber(long pos, bool caretPosition, bool startOfLine) const
{
    sip_gilstate_t sipGILState;
    PyObject *sipMeth;

    sipMeth = sipIsPyMethod(&sipGILState, const_cast<char *>(&sipPyMethods[36]), const_cast<sipSimpleWrapper **>(&sipPySelf), SIP_NULLPTR, sipName_GetVisibleLineNumber);

    if (!sipMeth)
        return ::wxRichTextCell::GetVisibleLineNumber(pos, caretPosition, startOfLine);

    extern long sipVH__richtext_47(sip_gilstate_t, sipVirtErrorHandlerFunc, sipSimpleWrapper *, PyObject *, long, bool, bool);

    return sipVH__richtext_47(sipGILState, 0, sipPySelf, sipMeth, pos, caretPosition, startOfLine);
}

::wxSize sipwxRichTextCell::GetLineSizeAtPosition(long pos, bool caretPosition) const
{
    sip_gilstate_t sipGILState;
    PyObject *sipMeth;

    sipMeth = sipIsPyMethod(&sipGILState, const_cast<char *>(&sipPyMethods[37]), const_cast<sipSimpleWrapper **>(&sipPySelf), SIP_NULLPTR, sipName_GetLineSizeAtPosition);

    if (!sipMeth)
        return ::wxRichTextCell::GetLineSizeAtPosition(pos, caretPosition);

    extern ::wxSize sipVH__richtext_46(sip_gilstate_t, sipVirtErrorHandlerFunc, sipSimpleWrapper *, PyObject *, long, bool);

    return sipVH__richtext_46(sipGILState, 0, sipPySelf, sipMeth, pos, caretPosition);
}

::wxRichTextParagraph* sipwxRichTextCell::GetParagraphAtPosition(long pos, bool caretPosition) const
{
    sip_gilstate_t sipGILState;
    PyObject *sipMeth;

    sipMeth = sipIsPyMethod(&sipGILState, const_cast<char *>(&sipPyMethods[38]), const_cast<sipSimpleWrapper **>(&sipPySelf), SIP_NULLPTR, sipName_GetParagraphAtPosition);

    if (!sipMeth)
        return ::wxRichTextCell::GetParagraphAtPosition(pos, caretPosition);

    extern ::wxRichTextParagraph* sipVH__richtext_45(sip_gilstate_t, sipVirtErrorHandlerFunc, sipSimpleWrapper *, PyObject *, long, bool);

    return sipVH__richtext_45(sipGILState, 0, sipPySelf, sipMeth, pos, caretPosition);
}

::wxRichTextLine* sipwxRichTextCell::GetLineAtYPosition(int y) const
{
    sip_gilstate_t sipGILState;
    PyObject *sipMeth;

    sipMeth = sipIsPyMethod(&sipGILState, const_cast<char *>(&sipPyMethods[39]), const_cast<sipSimpleWrapper **>(&sipPySelf), SIP_NULLPTR, sipName_GetLineAtYPosition);

    if (!sipMeth)
        return ::wxRichTextCell::GetLineAtYPosition(y);

    extern ::wxRichTextLine* sipVH__richtext_44(sip_gilstate_t, sipVirtErrorHandlerFunc, sipSimpleWrapper *, PyObject *, int);

    return sipVH__richtext_44(sipGILState, 0, sipPySelf, sipMeth, y);
}

::wxRichTextLine* sipwxRichTextCell::GetLineAtPosition(long pos, bool caretPosition) const
{
    sip_gilstate_t sipGILState;
    PyObject *sipMeth;

    sipMeth = sipIsPyMethod(&sipGILState, const_cast<char *>(&sipPyMethods[40]), const_cast<sipSimpleWrapper **>(&sipPySelf), SIP_NULLPTR, sipName_GetLineAtPosition);

    if (!sipMeth)
        return ::wxRichTextCell::GetLineAtPosition(pos, caretPosition);

    extern ::wxRichTextLine* sipVH__richtext_43(sip_gilstate_t, sipVirtErrorHandlerFunc, sipSimpleWrapper *, PyObject *, long, bool);

    return sipVH__richtext_43(sipGILState, 0, sipPySelf, sipMeth, pos, caretPosition);
}

::wxRichTextRange sipwxRichTextCell::AddParagraphs(const ::wxString& text, ::wxRichTextAttr*paraStyle)
{
    sip_gilstate_t sipGILState;
    PyObject *sipMeth;

    sipMeth = sipIsPyMethod(&sipGILState, &sipPyMethods[41], &sipPySelf, SIP_NULLPTR, sipName_AddParagraphs);

    if (!sipMeth)
        return ::wxRichTextCell::AddParagraphs(text, paraStyle);

    extern ::wxRichTextRange sipVH__richtext_41(sip_gilstate_t, sipVirtErrorHandlerFunc, sipSimpleWrapper *, PyObject *, const ::wxString&, ::wxRichTextAttr*);

    return sipVH__richtext_41(sipGILState, 0, sipPySelf, sipMeth, text, paraStyle);
}

::wxRichTextRange sipwxRichTextCell::AddImage(const ::wxImage& image, ::wxRichTextAttr*paraStyle)
{
    sip_gilstate_t sipGILState;
    PyObject *sipMeth;

    sipMeth = sipIsPyMethod(&sipGILState, &sipPyMethods[42], &sipPySelf, SIP_NULLPTR, sipName_AddImage);

    if (!sipMeth)
        return ::wxRichTextCell::AddImage(image, paraStyle);

    extern ::wxRichTextRange sipVH__richtext_42(sip_gilstate_t, sipVirtErrorHandlerFunc, sipSimpleWrapper *, PyObject *, const ::wxImage&, ::wxRichTextAttr*);

    return sipVH__richtext_42(sipGILState, 0, sipPySelf, sipMeth, image, paraStyle);
}

::wxRichTextRange sipwxRichTextCell::AddParagraph(const ::wxString& text, ::wxRichTextAttr*paraStyle)
{
    sip_gilstate_t sipGILState;
    PyObject *sipMeth;

    sipMeth = sipIsPyMethod(&sipGILState, &sipPyMethods[43], &sipPySelf, SIP_NULLPTR, sipName_AddParagraph);

    if (!sipMeth)
        return ::wxRichTextCell::AddParagraph(text, paraStyle);

    extern ::wxRichTextRange sipVH__richtext_41(sip_gilstate_t, sipVirtErrorHandlerFunc, sipSimpleWrapper *, PyObject *, const ::wxString&, ::wxRichTextAttr*);

    return sipVH__richtext_41(sipGILState, 0, sipPySelf, sipMeth, text, paraStyle);
}

void sipwxRichTextCell::Reset()
{
    sip_gilstate_t sipGILState;
    PyObject *sipMeth;

    sipMeth = sipIsPyMethod(&sipGILState, &sipPyMethods[44], &sipPySelf, SIP_NULLPTR, sipName_Reset);

    if (!sipMeth)
    {
        ::wxRichTextCell::Reset();
        return;
    }

    extern void sipVH__richtext_40(sip_gilstate_t, sipVirtErrorHandlerFunc, sipSimpleWrapper *, PyObject *);

    sipVH__richtext_40(sipGILState, 0, sipPySelf, sipMeth);
}

void sipwxRichTextCell::Clear()
{
    sip_gilstate_t sipGILState;
    PyObject *sipMeth;

    sipMeth = sipIsPyMethod(&sipGILState, &sipPyMethods[45], &sipPySelf, SIP_NULLPTR, sipName_Clear);

    if (!sipMeth)
    {
        ::wxRichTextCell::Clear();
        return;
    }

    extern void sipVH__richtext_40(sip_gilstate_t, sipVirtErrorHandlerFunc, sipSimpleWrapper *, PyObject *);

    sipVH__richtext_40(sipGILState, 0, sipPySelf, sipMeth);
}

::wxRichTextStyleSheet* sipwxRichTextCell::GetStyleSheet() const
{
    sip_gilstate_t sipGILState;
    PyObject *sipMeth;

    sipMeth = sipIsPyMethod(&sipGILState, const_cast<char *>(&sipPyMethods[46]), const_cast<sipSimpleWrapper **>(&sipPySelf), SIP_NULLPTR, sipName_GetStyleSheet);

    if (!sipMeth)
        return ::wxRichTextCell::GetStyleSheet();

    extern ::wxRichTextStyleSheet* sipVH__richtext_39(sip_gilstate_t, sipVirtErrorHandlerFunc, sipSimpleWrapper *, PyObject *);

    return sipVH__richtext_39(sipGILState, 0, sipPySelf, sipMeth);
}

bool sipwxRichTextCell::PromoteList(int promoteBy, const ::wxRichTextRange& range, const ::wxString& defName, int flags, int specifiedLevel)
{
    sip_gilstate_t sipGILState;
    PyObject *sipMeth;

    sipMeth = sipIsPyMethod(&sipGILState, &sipPyMethods[47], &sipPySelf, SIP_NULLPTR, sipName_PromoteList);

    if (!sipMeth)
        return ::wxRichTextCell::PromoteList(promoteBy, range, defName, flags, specifiedLevel);

    extern bool sipVH__richtext_38(sip_gilstate_t, sipVirtErrorHandlerFunc, sipSimpleWrapper *, PyObject *, int, const ::wxRichTextRange&, const ::wxString&, int, int);

    return sipVH__richtext_38(sipGILState, 0, sipPySelf, sipMeth, promoteBy, range, defName, flags, specifiedLevel);
}

bool sipwxRichTextCell::PromoteList(int promoteBy, const ::wxRichTextRange& range, ::wxRichTextListStyleDefinition*def, int flags, int specifiedLevel)
{
    sip_gilstate_t sipGILState;
    PyObject *sipMeth;

    sipMeth = sipIsPyMethod(&sipGILState, &sipPyMethods[48], &sipPySelf, SIP_NULLPTR, sipName_PromoteList);

    if (!sipMeth)
        return ::wxRichTextCell::PromoteList(promoteBy, range, def, flags, specifiedLevel);

    extern bool sipVH__richtext_37(sip_gilstate_t, sipVirtErrorHandlerFunc, sipSimpleWrapper *, PyObject *, int, const ::wxRichTextRange&, ::wxRichTextListStyleDefinition*, int, int);

    return sipVH__richtext_37(sipGILState, 0, sipPySelf, sipMeth, promoteBy, range, def, flags, specifiedLevel);
}

bool sipwxRichTextCell::NumberList(const ::wxRichTextRange& range, const ::wxString& defName, int flags, int startFrom, int specifiedLevel)
{
    sip_gilstate_t sipGILState;
    PyObject *sipMeth;

    sipMeth = sipIsPyMethod(&sipGILState, &sipPyMethods[49], &sipPySelf, SIP_NULLPTR, sipName_NumberList);

    if (!sipMeth)
        return ::wxRichTextCell::NumberList(range, defName, flags, startFrom, specifiedLevel);

    extern bool sipVH__richtext_36(sip_gilstate_t, sipVirtErrorHandlerFunc, sipSimpleWrapper *, PyObject *, const ::wxRichTextRange&, const ::wxString&, int, int, int);

    return sipVH__richtext_36(sipGILState, 0, sipPySelf, sipMeth, range, defName, flags, startFrom, specifiedLevel);
}

bool sipwxRichTextCell::NumberList(const ::wxRichTextRange& range, ::wxRichTextListStyleDefinition*def, int flags, int startFrom, int specifiedLevel)
{
    sip_gilstate_t sipGILState;
    PyObject *sipMeth;

    sipMeth = sipIsPyMethod(&sipGILState, &sipPyMethods[50], &sipPySelf, SIP_NULLPTR, sipName_NumberList);

    if (!sipMeth)
        return ::wxRichTextCell::NumberList(range, def, flags, startFrom, specifiedLevel);

    extern bool sipVH__richtext_35(sip_gilstate_t, sipVirtErrorHandlerFunc, sipSimpleWrapper *, PyObject *, const ::wxRichTextRange&, ::wxRichTextListStyleDefinition*, int, int, int);

    return sipVH__richtext_35(sipGILState, 0, sipPySelf, sipMeth, range, def, flags, startFrom, specifiedLevel);
}

bool sipwxRichTextCell::SetListStyle(const ::wxRichTextRange& range, const ::wxString& defName, int flags, int startFrom, int specifiedLevel)
{
    sip_gilstate_t sipGILState;
    PyObject *sipMeth;

    sipMeth = sipIsPyMethod(&sipGILState, &sipPyMethods[51], &sipPySelf, SIP_NULLPTR, sipName_SetListStyle);

    if (!sipMeth)
        return ::wxRichTextCell::SetListStyle(range, defName, flags, startFrom, specifiedLevel);

    extern bool sipVH__richtext_36(sip_gilstate_t, sipVirtErrorHandlerFunc, sipSimpleWrapper *, PyObject *, const ::wxRichTextRange&, const ::wxString&, int, int, int);

    return sipVH__richtext_36(sipGILState, 0, sipPySelf, sipMeth, range, defName, flags, startFrom, specifiedLevel);
}

bool sipwxRichTextCell::SetListStyle(const ::wxRichTextRange& range, ::wxRichTextListStyleDefinition*styleDef, int flags, int startFrom, int specifiedLevel)
{
    sip_gilstate_t sipGILState;
    PyObject *sipMeth;

    sipMeth = sipIsPyMethod(&sipGILState, &sipPyMethods[52], &sipPySelf, SIP_NULLPTR, sipName_SetListStyle);

    if (!sipMeth)
        return ::wxRichTextCell::SetListStyle(range, styleDef, flags, startFrom, specifiedLevel);

    extern bool sipVH__richtext_35(sip_gilstate_t, sipVirtErrorHandlerFunc, sipSimpleWrapper *, PyObject *, const ::wxRichTextRange&, ::wxRichTextListStyleDefinition*, int, int, int);

    return sipVH__richtext_35(sipGILState, 0, sipPySelf, sipMeth, range, styleDef, flags, startFrom, specifiedLevel);
}

void sipwxRichTextCell::Move(const ::wxPoint& pt)
{
    sip_gilstate_t sipGILState;
    PyObject *sipMeth;

    sipMeth = sipIsPyMethod(&sipGILState, &sipPyMethods[53], &sipPySelf, SIP_NULLPTR, sipName_Move);

    if (!sipMeth)
    {
        ::wxRichTextCell::Move(pt);
        return;
    }

    extern void sipVH__richtext_23(sip_gilstate_t, sipVirtErrorHandlerFunc, sipSimpleWrapper *, PyObject *, const ::wxPoint&);

    sipVH__richtext_23(sipGILState, 0, sipPySelf, sipMeth, pt);
}

::wxRichTextObject* sipwxRichTextCell::Clone() const
{
    sip_gilstate_t sipGILState;
    PyObject *sipMeth;

    sipMeth = sipIsPyMethod(&sipGILState, const_cast<char *>(&sipPyMethods[54]), const_cast<sipSimpleWrapper **>(&sipPySelf), SIP_NULLPTR, sipName_Clone);

    if (!sipMeth)
        return ::wxRichTextCell::Clone();

    extern ::wxRichTextObject* sipVH__richtext_34(sip_gilstate_t, sipVirtErrorHandlerFunc, sipSimpleWrapper *, PyObject *);

    return sipVH__richtext_34(sipGILState, 0, sipPySelf, sipMeth);
}

void sipwxRichTextCell::Show(bool show)
{
    sip_gilstate_t sipGILState;
    PyObject *sipMeth;

    sipMeth = sipIsPyMethod(&sipGILState, &sipPyMethods[55], &sipPySelf, SIP_NULLPTR, sipName_Show);

    if (!sipMeth)
    {
        ::wxRichTextCell::Show(show);
        return;
    }

    extern void sipVH__richtext_33(sip_gilstate_t, sipVirtErrorHandlerFunc, sipSimpleWrapper *, PyObject *, bool);

    sipVH__richtext_33(sipGILState, 0, sipPySelf, sipMeth, show);
}

bool sipwxRichTextCell::IsTopLevel() const
{
    sip_gilstate_t sipGILState;
    PyObject *sipMeth;

    sipMeth = sipIsPyMethod(&sipGILState, const_cast<char *>(&sipPyMethods[56]), const_cast<sipSimpleWrapper **>(&sipPySelf), SIP_NULLPTR, sipName_IsTopLevel);

    if (!sipMeth)
        return ::wxRichTextCell::IsTopLevel();

    extern bool sipVH__richtext_9(sip_gilstate_t, sipVirtErrorHandlerFunc, sipSimpleWrapper *, PyObject *);

    return sipVH__richtext_9(sipGILState, 0, sipPySelf, sipMeth);
}

bool sipwxRichTextCell::AdjustAttributes(::wxRichTextAttr& attr, ::wxRichTextDrawingContext& context)
{
    sip_gilstate_t sipGILState;
    PyObject *sipMeth;

    sipMeth = sipIsPyMethod(&sipGILState, &sipPyMethods[57], &sipPySelf, SIP_NULLPTR, sipName_AdjustAttributes);

    if (!sipMeth)
        return ::wxRichTextCell::AdjustAttributes(attr, context);

    extern bool sipVH__richtext_32(sip_gilstate_t, sipVirtErrorHandlerFunc, sipSimpleWrapper *, PyObject *, ::wxRichTextAttr&, ::wxRichTextDrawingContext&);

    return sipVH__richtext_32(sipGILState, 0, sipPySelf, sipMeth, attr, context);
}

bool sipwxRichTextCell::LayoutToBestSize(::wxDC& dc, ::wxRichTextDrawingContext& context, ::wxRichTextBuffer*buffer, const ::wxRichTextAttr& parentAttr, const ::wxRichTextAttr& attr, const ::wxRect& availableParentSpace, const ::wxRect& availableContainerSpace, int style)
{
    sip_gilstate_t sipGILState;
    PyObject *sipMeth;

    sipMeth = sipIsPyMethod(&sipGILState, &sipPyMethods[58], &sipPySelf, SIP_NULLPTR, sipName_LayoutToBestSize);

    if (!sipMeth)
        return ::wxRichTextCell::LayoutToBestSize(dc, context, buffer, parentAttr, attr, availableParentSpace, availableContainerSpace, style);

    extern bool sipVH__richtext_31(sip_gilstate_t, sipVirtErrorHandlerFunc, sipSimpleWrapper *, PyObject *, ::wxDC&, ::wxRichTextDrawingContext&, ::wxRichTextBuffer*, const ::wxRichTextAttr&, const ::wxRichTextAttr&, const ::wxRect&, const ::wxRect&, int);

    return sipVH__richtext_31(sipGILState, 0, sipPySelf, sipMeth, dc, context, buffer, parentAttr, attr, availableParentSpace, availableContainerSpace, style);
}

::wxRect sipwxRichTextCell::GetAvailableContentArea(::wxDC& dc, ::wxRichTextDrawingContext& context, const ::wxRect& outerRect) const
{
    sip_gilstate_t sipGILState;
    PyObject *sipMeth;

    sipMeth = sipIsPyMethod(&sipGILState, const_cast<char *>(&sipPyMethods[59]), const_cast<sipSimpleWrapper **>(&sipPySelf), SIP_NULLPTR, sipName_GetAvailableContentArea);

    if (!sipMeth)
        return ::wxRichTextCell::GetAvailableContentArea(dc, context, outerRect);

    extern ::wxRect sipVH__richtext_30(sip_gilstate_t, sipVirtErrorHandlerFunc, sipSimpleWrapper *, PyObject *, ::wxDC&, ::wxRichTextDrawingContext&, const ::wxRect&);

    return sipVH__richtext_30(sipGILState, 0, sipPySelf, sipMeth, dc, context, outerRect);
}

int sipwxRichTextCell::GetBottomMargin() const
{
    sip_gilstate_t sipGILState;
    PyObject *sipMeth;

    sipMeth = sipIsPyMethod(&sipGILState, const_cast<char *>(&sipPyMethods[60]), const_cast<sipSimpleWrapper **>(&sipPySelf), SIP_NULLPTR, sipName_GetBottomMargin);

    if (!sipMeth)
        return ::wxRichTextCell::GetBottomMargin();

    extern int sipVH__richtext_10(sip_gilstate_t, sipVirtErrorHandlerFunc, sipSimpleWrapper *, PyObject *);

    return sipVH__richtext_10(sipGILState, 0, sipPySelf, sipMeth);
}

int sipwxRichTextCell::GetTopMargin() const
{
    sip_gilstate_t sipGILState;
    PyObject *sipMeth;

    sipMeth = sipIsPyMethod(&sipGILState, const_cast<char *>(&sipPyMethods[61]), const_cast<sipSimpleWrapper **>(&sipPySelf), SIP_NULLPTR, sipName_GetTopMargin);

    if (!sipMeth)
        return ::wxRichTextCell::GetTopMargin();

    extern int sipVH__richtext_10(sip_gilstate_t, sipVirtErrorHandlerFunc, sipSimpleWrapper *, PyObject *);

    return sipVH__richtext_10(sipGILState, 0, sipPySelf, sipMeth);
}

int sipwxRichTextCell::GetRightMargin() const
{
    sip_gilstate_t sipGILState;
    PyObject *sipMeth;

    sipMeth = sipIsPyMethod(&sipGILState, const_cast<char *>(&sipPyMethods[62]), const_cast<sipSimpleWrapper **>(&sipPySelf), SIP_NULLPTR, sipName_GetRightMargin);

    if (!sipMeth)
        return ::wxRichTextCell::GetRightMargin();

    extern int sipVH__richtext_10(sip_gilstate_t, sipVirtErrorHandlerFunc, sipSimpleWrapper *, PyObject *);

    return sipVH__richtext_10(sipGILState, 0, sipPySelf, sipMeth);
}

int sipwxRichTextCell::GetLeftMargin() const
{
    sip_gilstate_t sipGILState;
    PyObject *sipMeth;

    sipMeth = sipIsPyMethod(&sipGILState, const_cast<char *>(&sipPyMethods[63]), const_cast<sipSimpleWrapper **>(&sipPySelf), SIP_NULLPTR, sipName_GetLeftMargin);

    if (!sipMeth)
        return ::wxRichTextCell::GetLeftMargin();

    extern int sipVH__richtext_10(sip_gilstate_t, sipVirtErrorHandlerFunc, sipSimpleWrapper *, PyObject *);

    return sipVH__richtext_10(sipGILState, 0, sipPySelf, sipMeth);
}

void sipwxRichTextCell::SetMargins(int leftMargin, int rightMargin, int topMargin, int bottomMargin)
{
    sip_gilstate_t sipGILState;
    PyObject *sipMeth;

    sipMeth = sipIsPyMethod(&sipGILState, &sipPyMethods[64], &sipPySelf, SIP_NULLPTR, sipName_SetMargins);

    if (!sipMeth)
    {
        ::wxRichTextCell::SetMargins(leftMargin, rightMargin, topMargin, bottomMargin);
        return;
    }

    extern void sipVH__richtext_29(sip_gilstate_t, sipVirtErrorHandlerFunc, sipSimpleWrapper *, PyObject *, int, int, int, int);

    sipVH__richtext_29(sipGILState, 0, sipPySelf, sipMeth, leftMargin, rightMargin, topMargin, bottomMargin);
}

void sipwxRichTextCell::SetMargins(int margin)
{
    sip_gilstate_t sipGILState;
    PyObject *sipMeth;

    sipMeth = sipIsPyMethod(&sipGILState, &sipPyMethods[65], &sipPySelf, SIP_NULLPTR, sipName_SetMargins);

    if (!sipMeth)
    {
        ::wxRichTextCell::SetMargins(margin);
        return;
    }

    extern void sipVH__richtext_28(sip_gilstate_t, sipVirtErrorHandlerFunc, sipSimpleWrapper *, PyObject *, int);

    sipVH__richtext_28(sipGILState, 0, sipPySelf, sipMeth, margin);
}

::wxRichTextParagraphLayoutBox* sipwxRichTextCell::GetParentContainer() const
{
    sip_gilstate_t sipGILState;
    PyObject *sipMeth;

    sipMeth = sipIsPyMethod(&sipGILState, const_cast<char *>(&sipPyMethods[66]), const_cast<sipSimpleWrapper **>(&sipPySelf), SIP_NULLPTR, sipName_GetParentContainer);

    if (!sipMeth)
        return ::wxRichTextCell::GetParentContainer();

    extern ::wxRichTextParagraphLayoutBox* sipVH__richtext_27(sip_gilstate_t, sipVirtErrorHandlerFunc, sipSimpleWrapper *, PyObject *);

    return sipVH__richtext_27(sipGILState, 0, sipPySelf, sipMeth);
}

::wxRichTextParagraphLayoutBox* sipwxRichTextCell::GetContainer() const
{
    sip_gilstate_t sipGILState;
    PyObject *sipMeth;

    sipMeth = sipIsPyMethod(&sipGILState, const_cast<char *>(&sipPyMethods[67]), const_cast<sipSimpleWrapper **>(&sipPySelf), SIP_NULLPTR, sipName_GetContainer);

    if (!sipMeth)
        return ::wxRichTextCell::GetContainer();

    extern ::wxRichTextParagraphLayoutBox* sipVH__richtext_27(sip_gilstate_t, sipVirtErrorHandlerFunc, sipSimpleWrapper *, PyObject *);

    return sipVH__richtext_27(sipGILState, 0, sipPySelf, sipMeth);
}

void sipwxRichTextCell::SetParent(::wxRichTextObject*parent)
{
    sip_gilstate_t sipGILState;
    PyObject *sipMeth;

    sipMeth = sipIsPyMethod(&sipGILState, &sipPyMethods[68], &sipPySelf, SIP_NULLPTR, sipName_SetParent);

    if (!sipMeth)
    {
        ::wxRichTextCell::SetParent(parent);
        return;
    }

    extern void sipVH__richtext_26(sip_gilstate_t, sipVirtErrorHandlerFunc, sipSimpleWrapper *, PyObject *, ::wxRichTextObject*);

    sipVH__richtext_26(sipGILState, 0, sipPySelf, sipMeth, parent);
}

::wxRichTextObject* sipwxRichTextCell::GetParent() const
{
    sip_gilstate_t sipGILState;
    PyObject *sipMeth;

    sipMeth = sipIsPyMethod(&sipGILState, const_cast<char *>(&sipPyMethods[69]), const_cast<sipSimpleWrapper **>(&sipPySelf), SIP_NULLPTR, sipName_GetParent);

    if (!sipMeth)
        return ::wxRichTextCell::GetParent();

    extern ::wxRichTextObject* sipVH__richtext_34(sip_gilstate_t, sipVirtErrorHandlerFunc, sipSimpleWrapper *, PyObject *);

    return sipVH__richtext_34(sipGILState, 0, sipPySelf, sipMeth);
}

bool sipwxRichTextCell::IsAtomic() const
{
    sip_gilstate_t sipGILState;
    PyObject *sipMeth;

    sipMeth = sipIsPyMethod(&sipGILState, const_cast<char *>(&sipPyMethods[70]), const_cast<sipSimpleWrapper **>(&sipPySelf), SIP_NULLPTR, sipName_IsAtomic);

    if (!sipMeth)
        return ::wxRichTextCell::IsAtomic();

    extern bool sipVH__richtext_9(sip_gilstate_t, sipVirtErrorHandlerFunc, sipSimpleWrapper *, PyObject *);

    return sipVH__richtext_9(sipGILState, 0, sipPySelf, sipMeth);
}

bool sipwxRichTextCell::IsComposite() const
{
    sip_gilstate_t sipGILState;
    PyObject *sipMeth;

    sipMeth = sipIsPyMethod(&sipGILState, const_cast<char *>(&sipPyMethods[71]), const_cast<sipSimpleWrapper **>(&sipPySelf), SIP_NULLPTR, sipName_IsComposite);

    if (!sipMeth)
        return ::wxRichTextCell::IsComposite();

    extern bool sipVH__richtext_9(sip_gilstate_t, sipVirtErrorHandlerFunc, sipSimpleWrapper *, PyObject *);

    return sipVH__richtext_9(sipGILState, 0, sipPySelf, sipMeth);
}

::wxRect sipwxRichTextCell::GetRect() const
{
    sip_gilstate_t sipGILState;
    PyObject *sipMeth;

    sipMeth = sipIsPyMethod(&sipGILState, const_cast<char *>(&sipPyMethods[72]), const_cast<sipSimpleWrapper **>(&sipPySelf), SIP_NULLPTR, sipName_GetRect);

    if (!sipMeth)
        return ::wxRichTextCell::GetRect();

    extern ::wxRect sipVH__richtext_24(sip_gilstate_t, sipVirtErrorHandlerFunc, sipSimpleWrapper *, PyObject *);

    return sipVH__richtext_24(sipGILState, 0, sipPySelf, sipMeth);
}

::wxPoint sipwxRichTextCell::GetAbsolutePosition() const
{
    sip_gilstate_t sipGILState;
    PyObject *sipMeth;

    sipMeth = sipIsPyMethod(&sipGILState, const_cast<char *>(&sipPyMethods[73]), const_cast<sipSimpleWrapper **>(&sipPySelf), SIP_NULLPTR, sipName_GetAbsolutePosition);

    if (!sipMeth)
        return ::wxRichTextCell::GetAbsolutePosition();

    extern ::wxPoint sipVH__richtext_22(sip_gilstate_t, sipVirtErrorHandlerFunc, sipSimpleWrapper *, PyObject *);

    return sipVH__richtext_22(sipGILState, 0, sipPySelf, sipMeth);
}

void sipwxRichTextCell::SetPosition(const ::wxPoint& pos)
{
    sip_gilstate_t sipGILState;
    PyObject *sipMeth;

    sipMeth = sipIsPyMethod(&sipGILState, &sipPyMethods[74], &sipPySelf, SIP_NULLPTR, sipName_SetPosition);

    if (!sipMeth)
    {
        ::wxRichTextCell::SetPosition(pos);
        return;
    }

    extern void sipVH__richtext_23(sip_gilstate_t, sipVirtErrorHandlerFunc, sipSimpleWrapper *, PyObject *, const ::wxPoint&);

    sipVH__richtext_23(sipGILState, 0, sipPySelf, sipMeth, pos);
}

::wxPoint sipwxRichTextCell::GetPosition() const
{
    sip_gilstate_t sipGILState;
    PyObject *sipMeth;

    sipMeth = sipIsPyMethod(&sipGILState, const_cast<char *>(&sipPyMethods[75]), const_cast<sipSimpleWrapper **>(&sipPySelf), SIP_NULLPTR, sipName_GetPosition);

    if (!sipMeth)
        return ::wxRichTextCell::GetPosition();

    extern ::wxPoint sipVH__richtext_22(sip_gilstate_t, sipVirtErrorHandlerFunc, sipSimpleWrapper *, PyObject *);

    return sipVH__richtext_22(sipGILState, 0, sipPySelf, sipMeth);
}

::wxTextAttrSize sipwxRichTextCell::GetNaturalSize() const
{
    sip_gilstate_t sipGILState;
    PyObject *sipMeth;

    sipMeth = sipIsPyMethod(&sipGILState, const_cast<char *>(&sipPyMethods[76]), const_cast<sipSimpleWrapper **>(&sipPySelf), SIP_NULLPTR, sipName_GetNaturalSize);

    if (!sipMeth)
        return ::wxRichTextCell::GetNaturalSize();

    extern ::wxTextAttrSize sipVH__richtext_21(sip_gilstate_t, sipVirtErrorHandlerFunc, sipSimpleWrapper *, PyObject *);

    return sipVH__richtext_21(sipGILState, 0, sipPySelf, sipMeth);
}

void sipwxRichTextCell::SetMinSize(const ::wxSize& sz)
{
    sip_gilstate_t sipGILState;
    PyObject *sipMeth;

    sipMeth = sipIsPyMethod(&sipGILState, &sipPyMethods[77], &sipPySelf, SIP_NULLPTR, sipName_SetMinSize);

    if (!sipMeth)
    {
        ::wxRichTextCell::SetMinSize(sz);
        return;
    }

    extern void sipVH__richtext_20(sip_gilstate_t, sipVirtErrorHandlerFunc, sipSimpleWrapper *, PyObject *, const ::wxSize&);

    sipVH__richtext_20(sipGILState, 0, sipPySelf, sipMeth, sz);
}

::wxSize sipwxRichTextCell::GetMinSize() const
{
    sip_gilstate_t sipGILState;
    PyObject *sipMeth;

    sipMeth = sipIsPyMethod(&sipGILState, const_cast<char *>(&sipPyMethods[78]), const_cast<sipSimpleWrapper **>(&sipPySelf), SIP_NULLPTR, sipName_GetMinSize);

    if (!sipMeth)
        return ::wxRichTextCell::GetMinSize();

    extern ::wxSize sipVH__richtext_4(sip_gilstate_t, sipVirtErrorHandlerFunc, sipSimpleWrapper *, PyObject *);

    return sipVH__richtext_4(sipGILState, 0, sipPySelf, sipMeth);
}

void sipwxRichTextCell::SetMaxSize(const ::wxSize& sz)
{
    sip_gilstate_t sipGILState;
    PyObject *sipMeth;

    sipMeth = sipIsPyMethod(&sipGILState, &sipPyMethods[79], &sipPySelf, SIP_NULLPTR, sipName_SetMaxSize);

    if (!sipMeth)
    {
        ::wxRichTextCell::SetMaxSize(sz);
        return;
    }

    extern void sipVH__richtext_20(sip_gilstate_t, sipVirtErrorHandlerFunc, sipSimpleWrapper *, PyObject *, const ::wxSize&);

    sipVH__richtext_20(sipGILState, 0, sipPySelf, sipMeth, sz);
}

::wxSize sipwxRichTextCell::GetMaxSize() const
{
    sip_gilstate_t sipGILState;
    PyObject *sipMeth;

    sipMeth = sipIsPyMethod(&sipGILState, const_cast<char *>(&sipPyMethods[80]), const_cast<sipSimpleWrapper **>(&sipPySelf), SIP_NULLPTR, sipName_GetMaxSize);

    if (!sipMeth)
        return ::wxRichTextCell::GetMaxSize();

    extern ::wxSize sipVH__richtext_4(sip_gilstate_t, sipVirtErrorHandlerFunc, sipSimpleWrapper *, PyObject *);

    return sipVH__richtext_4(sipGILState, 0, sipPySelf, sipMeth);
}

void sipwxRichTextCell::SetCachedSize(const ::wxSize& sz)
{
    sip_gilstate_t sipGILState;
    PyObject *sipMeth;

    sipMeth = sipIsPyMethod(&sipGILState, &sipPyMethods[81], &sipPySelf, SIP_NULLPTR, sipName_SetCachedSize);

    if (!sipMeth)
    {
        ::wxRichTextCell::SetCachedSize(sz);
        return;
    }

    extern void sipVH__richtext_20(sip_gilstate_t, sipVirtErrorHandlerFunc, sipSimpleWrapper *, PyObject *, const ::wxSize&);

    sipVH__richtext_20(sipGILState, 0, sipPySelf, sipMeth, sz);
}

::wxSize sipwxRichTextCell::GetCachedSize() const
{
    sip_gilstate_t sipGILState;
    PyObject *sipMeth;

    sipMeth = sipIsPyMethod(&sipGILState, const_cast<char *>(&sipPyMethods[82]), const_cast<sipSimpleWrapper **>(&sipPySelf), SIP_NULLPTR, sipName_GetCachedSize);

    if (!sipMeth)
        return ::wxRichTextCell::GetCachedSize();

    extern ::wxSize sipVH__richtext_4(sip_gilstate_t, sipVirtErrorHandlerFunc, sipSimpleWrapper *, PyObject *);

    return sipVH__richtext_4(sipGILState, 0, sipPySelf, sipMeth);
}

::wxRichTextSelection sipwxRichTextCell::GetSelection(long start, long end) const
{
    sip_gilstate_t sipGILState;
    PyObject *sipMeth;

    sipMeth = sipIsPyMethod(&sipGILState, const_cast<char *>(&sipPyMethods[83]), const_cast<sipSimpleWrapper **>(&sipPySelf), SIP_NULLPTR, sipName_GetSelection);

    if (!sipMeth)
        return ::wxRichTextCell::GetSelection(start, end);

    extern ::wxRichTextSelection sipVH__richtext_19(sip_gilstate_t, sipVirtErrorHandlerFunc, sipSimpleWrapper *, PyObject *, long, long);

    return sipVH__richtext_19(sipGILState, 0, sipPySelf, sipMeth, start, end);
}

bool sipwxRichTextCell::HandlesChildSelections() const
{
    sip_gilstate_t sipGILState;
    PyObject *sipMeth;

    sipMeth = sipIsPyMethod(&sipGILState, const_cast<char *>(&sipPyMethods[84]), const_cast<sipSimpleWrapper **>(&sipPySelf), SIP_NULLPTR, sipName_HandlesChildSelections);

    if (!sipMeth)
        return ::wxRichTextCell::HandlesChildSelections();

    extern bool sipVH__richtext_9(sip_gilstate_t, sipVirtErrorHandlerFunc, sipSimpleWrapper *, PyObject *);

    return sipVH__richtext_9(sipGILState, 0, sipPySelf, sipMeth);
}

void sipwxRichTextCell::Invalidate(const ::wxRichTextRange& invalidRange)
{
    sip_gilstate_t sipGILState;
    PyObject *sipMeth;

    sipMeth = sipIsPyMethod(&sipGILState, &sipPyMethods[85], &sipPySelf, SIP_NULLPTR, sipName_Invalidate);

    if (!sipMeth)
    {
        ::wxRichTextCell::Invalidate(invalidRange);
        return;
    }

    extern void sipVH__richtext_18(sip_gilstate_t, sipVirtErrorHandlerFunc, sipSimpleWrapper *, PyObject *, const ::wxRichTextRange&);

    sipVH__richtext_18(sipGILState, 0, sipPySelf, sipMeth, invalidRange);
}

::wxString sipwxRichTextCell::GetXMLNodeName() const
{
    sip_gilstate_t sipGILState;
    PyObject *sipMeth;

    sipMeth = sipIsPyMethod(&sipGILState, const_cast<char *>(&sipPyMethods[86]), const_cast<sipSimpleWrapper **>(&sipPySelf), SIP_NULLPTR, sipName_GetXMLNodeName);

    if (!sipMeth)
        return ::wxRichTextCell::GetXMLNodeName();

    extern ::wxString sipVH__richtext_16(sip_gilstate_t, sipVirtErrorHandlerFunc, sipSimpleWrapper *, PyObject *);

    return sipVH__richtext_16(sipGILState, 0, sipPySelf, sipMeth);
}

bool sipwxRichTextCell::UsesParagraphAttributes() const
{
    sip_gilstate_t sipGILState;
    PyObject *sipMeth;

    sipMeth = sipIsPyMethod(&sipGILState, const_cast<char *>(&sipPyMethods[87]), const_cast<sipSimpleWrapper **>(&sipPySelf), SIP_NULLPTR, sipName_UsesParagraphAttributes);

    if (!sipMeth)
        return ::wxRichTextCell::UsesParagraphAttributes();

    extern bool sipVH__richtext_9(sip_gilstate_t, sipVirtErrorHandlerFunc, sipSimpleWrapper *, PyObject *);

    return sipVH__richtext_9(sipGILState, 0, sipPySelf, sipMeth);
}

bool sipwxRichTextCell::ImportFromXML(::wxRichTextBuffer*buffer, ::wxXmlNode*node, ::wxRichTextXMLHandler*handler, bool*recurse)
{
    sip_gilstate_t sipGILState;
    PyObject *sipMeth;

    sipMeth = sipIsPyMethod(&sipGILState, &sipPyMethods[88], &sipPySelf, SIP_NULLPTR, sipName_ImportFromXML);

    if (!sipMeth)
        return ::wxRichTextCell::ImportFromXML(buffer, node, handler, recurse);

    extern bool sipVH__richtext_17(sip_gilstate_t, sipVirtErrorHandlerFunc, sipSimpleWrapper *, PyObject *, ::wxRichTextBuffer*, ::wxXmlNode*, ::wxRichTextXMLHandler*, bool*);

    return sipVH__richtext_17(sipGILState, 0, sipPySelf, sipMeth, buffer, node, handler, recurse);
}

bool sipwxRichTextCell::AcceptsFocus() const
{
    sip_gilstate_t sipGILState;
    PyObject *sipMeth;

    sipMeth = sipIsPyMethod(&sipGILState, const_cast<char *>(&sipPyMethods[89]), const_cast<sipSimpleWrapper **>(&sipPySelf), SIP_NULLPTR, sipName_AcceptsFocus);

    if (!sipMeth)
        return ::wxRichTextCell::AcceptsFocus();

    extern bool sipVH__richtext_9(sip_gilstate_t, sipVirtErrorHandlerFunc, sipSimpleWrapper *, PyObject *);

    return sipVH__richtext_9(sipGILState, 0, sipPySelf, sipMeth);
}

::wxString sipwxRichTextCell::GetPropertiesMenuLabel() const
{
    sip_gilstate_t sipGILState;
    PyObject *sipMeth;

    sipMeth = sipIsPyMethod(&sipGILState, const_cast<char *>(&sipPyMethods[90]), const_cast<sipSimpleWrapper **>(&sipPySelf), SIP_NULLPTR, sipName_GetPropertiesMenuLabel);

    if (!sipMeth)
        return ::wxRichTextCell::GetPropertiesMenuLabel();

    extern ::wxString sipVH__richtext_16(sip_gilstate_t, sipVirtErrorHandlerFunc, sipSimpleWrapper *, PyObject *);

    return sipVH__richtext_16(sipGILState, 0, sipPySelf, sipMeth);
}

bool sipwxRichTextCell::EditProperties(::wxWindow*parent, ::wxRichTextBuffer*buffer)
{
    sip_gilstate_t sipGILState;
    PyObject *sipMeth;

    sipMeth = sipIsPyMethod(&sipGILState, &sipPyMethods[91], &sipPySelf, SIP_NULLPTR, sipName_EditProperties);

    if (!sipMeth)
        return ::wxRichTextCell::EditProperties(parent, buffer);

    extern bool sipVH__richtext_15(sip_gilstate_t, sipVirtErrorHandlerFunc, sipSimpleWrapper *, PyObject *, ::wxWindow*, ::wxRichTextBuffer*);

    return sipVH__richtext_15(sipGILState, 0, sipPySelf, sipMeth, parent, buffer);
}

bool sipwxRichTextCell::CanEditProperties() const
{
    sip_gilstate_t sipGILState;
    PyObject *sipMeth;

    sipMeth = sipIsPyMethod(&sipGILState, const_cast<char *>(&sipPyMethods[92]), const_cast<sipSimpleWrapper **>(&sipPySelf), SIP_NULLPTR, sipName_CanEditProperties);

    if (!sipMeth)
        return ::wxRichTextCell::CanEditProperties();

    extern bool sipVH__richtext_9(sip_gilstate_t, sipVirtErrorHandlerFunc, sipSimpleWrapper *, PyObject *);

    return sipVH__richtext_9(sipGILState, 0, sipPySelf, sipMeth);
}

::wxRichTextObject* sipwxRichTextCell::Split(::wxRichTextDrawingContext& context)
{
    sip_gilstate_t sipGILState;
    PyObject *sipMeth;

    sipMeth = sipIsPyMethod(&sipGILState, &sipPyMethods[93], &sipPySelf, SIP_NULLPTR, sipName_Split);

    if (!sipMeth)
        return ::wxRichTextCell::Split(context);

    extern ::wxRichTextObject* sipVH__richtext_14(sip_gilstate_t, sipVirtErrorHandlerFunc, sipSimpleWrapper *, PyObject *, ::wxRichTextDrawingContext&);

    return sipVH__richtext_14(sipGILState, 0, sipPySelf, sipMeth, context);
}

bool sipwxRichTextCell::CanSplit(::wxRichTextDrawingContext& context) const
{
    sip_gilstate_t sipGILState;
    PyObject *sipMeth;

    sipMeth = sipIsPyMethod(&sipGILState, const_cast<char *>(&sipPyMethods[94]), const_cast<sipSimpleWrapper **>(&sipPySelf), SIP_NULLPTR, sipName_CanSplit);

    if (!sipMeth)
        return ::wxRichTextCell::CanSplit(context);

    extern bool sipVH__richtext_13(sip_gilstate_t, sipVirtErrorHandlerFunc, sipSimpleWrapper *, PyObject *, ::wxRichTextDrawingContext&);

    return sipVH__richtext_13(sipGILState, 0, sipPySelf, sipMeth, context);
}

bool sipwxRichTextCell::Merge(::wxRichTextObject*object, ::wxRichTextDrawingContext& context)
{
    sip_gilstate_t sipGILState;
    PyObject *sipMeth;

    sipMeth = sipIsPyMethod(&sipGILState, &sipPyMethods[95], &sipPySelf, SIP_NULLPTR, sipName_Merge);

    if (!sipMeth)
        return ::wxRichTextCell::Merge(object, context);

    extern bool sipVH__richtext_12(sip_gilstate_t, sipVirtErrorHandlerFunc, sipSimpleWrapper *, PyObject *, ::wxRichTextObject*, ::wxRichTextDrawingContext&);

    return sipVH__richtext_12(sipGILState, 0, sipPySelf, sipMeth, object, context);
}

bool sipwxRichTextCell::CanMerge(::wxRichTextObject*object, ::wxRichTextDrawingContext& context) const
{
    sip_gilstate_t sipGILState;
    PyObject *sipMeth;

    sipMeth = sipIsPyMethod(&sipGILState, const_cast<char *>(&sipPyMethods[96]), const_cast<sipSimpleWrapper **>(&sipPySelf), SIP_NULLPTR, sipName_CanMerge);

    if (!sipMeth)
        return ::wxRichTextCell::CanMerge(object, context);

    extern bool sipVH__richtext_12(sip_gilstate_t, sipVirtErrorHandlerFunc, sipSimpleWrapper *, PyObject *, ::wxRichTextObject*, ::wxRichTextDrawingContext&);

    return sipVH__richtext_12(sipGILState, 0, sipPySelf, sipMeth, object, context);
}

::wxString sipwxRichTextCell::GetTextForRange(const ::wxRichTextRange& range) const
{
    sip_gilstate_t sipGILState;
    PyObject *sipMeth;

    sipMeth = sipIsPyMethod(&sipGILState, const_cast<char *>(&sipPyMethods[97]), const_cast<sipSimpleWrapper **>(&sipPySelf), SIP_NULLPTR, sipName_GetTextForRange);

    if (!sipMeth)
        return ::wxRichTextCell::GetTextForRange(range);

    extern ::wxString sipVH__richtext_11(sip_gilstate_t, sipVirtErrorHandlerFunc, sipSimpleWrapper *, PyObject *, const ::wxRichTextRange&);

    return sipVH__richtext_11(sipGILState, 0, sipPySelf, sipMeth, range);
}

int sipwxRichTextCell::GetFloatDirection() const
{
    sip_gilstate_t sipGILState;
    PyObject *sipMeth;

    sipMeth = sipIsPyMethod(&sipGILState, const_cast<char *>(&sipPyMethods[98]), const_cast<sipSimpleWrapper **>(&sipPySelf), SIP_NULLPTR, sipName_GetFloatDirection);

    if (!sipMeth)
        return ::wxRichTextCell::GetFloatDirection();

    extern int sipVH__richtext_10(sip_gilstate_t, sipVirtErrorHandlerFunc, sipSimpleWrapper *, PyObject *);

    return sipVH__richtext_10(sipGILState, 0, sipPySelf, sipMeth);
}

bool sipwxRichTextCell::IsFloating() const
{
    sip_gilstate_t sipGILState;
    PyObject *sipMeth;

    sipMeth = sipIsPyMethod(&sipGILState, const_cast<char *>(&sipPyMethods[99]), const_cast<sipSimpleWrapper **>(&sipPySelf), SIP_NULLPTR, sipName_IsFloating);

    if (!sipMeth)
        return ::wxRichTextCell::IsFloating();

    extern bool sipVH__richtext_9(sip_gilstate_t, sipVirtErrorHandlerFunc, sipSimpleWrapper *, PyObject *);

    return sipVH__richtext_9(sipGILState, 0, sipPySelf, sipMeth);
}

bool sipwxRichTextCell::IsFloatable() const
{
    sip_gilstate_t sipGILState;
    PyObject *sipMeth;

    sipMeth = sipIsPyMethod(&sipGILState, const_cast<char *>(&sipPyMethods[100]), const_cast<sipSimpleWrapper **>(&sipPySelf), SIP_NULLPTR, sipName_IsFloatable);

    if (!sipMeth)
        return ::wxRichTextCell::IsFloatable();

    extern bool sipVH__richtext_9(sip_gilstate_t, sipVirtErrorHandlerFunc, sipSimpleWrapper *, PyObject *);

    return sipVH__richtext_9(sipGILState, 0, sipPySelf, sipMeth);
}

bool sipwxRichTextCell::IsEmpty() const
{
    sip_gilstate_t sipGILState;
    PyObject *sipMeth;

    sipMeth = sipIsPyMethod(&sipGILState, const_cast<char *>(&sipPyMethods[101]), const_cast<sipSimpleWrapper **>(&sipPySelf), SIP_NULLPTR, sipName_IsEmpty);

    if (!sipMeth)
        return ::wxRichTextCell::IsEmpty();

    extern bool sipVH__richtext_9(sip_gilstate_t, sipVirtErrorHandlerFunc, sipSimpleWrapper *, PyObject *);

    return sipVH__richtext_9(sipGILState, 0, sipPySelf, sipMeth);
}

bool sipwxRichTextCell::DeleteRange(const ::wxRichTextRange& range)
{
    sip_gilstate_t sipGILState;
    PyObject *sipMeth;

    sipMeth = sipIsPyMethod(&sipGILState, &sipPyMethods[102], &sipPySelf, SIP_NULLPTR, sipName_DeleteRange);

    if (!sipMeth)
        return ::wxRichTextCell::DeleteRange(range);

    extern bool sipVH__richtext_8(sip_gilstate_t, sipVirtErrorHandlerFunc, sipSimpleWrapper *, PyObject *, const ::wxRichTextRange&);

    return sipVH__richtext_8(sipGILState, 0, sipPySelf, sipMeth, range);
}

void sipwxRichTextCell::CalculateRange(long start, long& end)
{
    sip_gilstate_t sipGILState;
    PyObject *sipMeth;

    sipMeth = sipIsPyMethod(&sipGILState, &sipPyMethods[103], &sipPySelf, SIP_NULLPTR, sipName_CalculateRange);

    if (!sipMeth)
    {
        ::wxRichTextCell::CalculateRange(start, end);
        return;
    }

    extern void sipVH__richtext_7(sip_gilstate_t, sipVirtErrorHandlerFunc, sipSimpleWrapper *, PyObject *, long, long&);

    sipVH__richtext_7(sipGILState, 0, sipPySelf, sipMeth, start, end);
}

::wxRichTextObject* sipwxRichTextCell::DoSplit(long pos)
{
    sip_gilstate_t sipGILState;
    PyObject *sipMeth;

    sipMeth = sipIsPyMethod(&sipGILState, &sipPyMethods[104], &sipPySelf, SIP_NULLPTR, sipName_DoSplit);

    if (!sipMeth)
        return ::wxRichTextCell::DoSplit(pos);

    extern ::wxRichTextObject* sipVH__richtext_6(sip_gilstate_t, sipVirtErrorHandlerFunc, sipSimpleWrapper *, PyObject *, long);

    return sipVH__richtext_6(sipGILState, 0, sipPySelf, sipMeth, pos);
}

bool sipwxRichTextCell::GetRangeSize(const ::wxRichTextRange& range, ::wxSize& size, int& descent, ::wxDC& dc, ::wxRichTextDrawingContext& context, int flags, const ::wxPoint& position, const ::wxSize& parentSize, ::wxArrayInt*partialExtents) const
{
    sip_gilstate_t sipGILState;
    PyObject *sipMeth;

    sipMeth = sipIsPyMethod(&sipGILState, const_cast<char *>(&sipPyMethods[105]), const_cast<sipSimpleWrapper **>(&sipPySelf), SIP_NULLPTR, sipName_GetRangeSize);

    if (!sipMeth)
        return ::wxRichTextCell::GetRangeSize(range, size, descent, dc, context, flags, position, parentSize, partialExtents);

    extern bool sipVH__richtext_5(sip_gilstate_t, sipVirtErrorHandlerFunc, sipSimpleWrapper *, PyObject *, const ::wxRichTextRange&, ::wxSize&, int&, ::wxDC&, ::wxRichTextDrawingContext&, int, const ::wxPoint&, const ::wxSize&, ::wxArrayInt*);

    return sipVH__richtext_5(sipGILState, 0, sipPySelf, sipMeth, range, size, descent, dc, context, flags, position, parentSize, partialExtents);
}

::wxSize sipwxRichTextCell::GetBestSize() const
{
    sip_gilstate_t sipGILState;
    PyObject *sipMeth;

    sipMeth = sipIsPyMethod(&sipGILState, const_cast<char *>(&sipPyMethods[106]), const_cast<sipSimpleWrapper **>(&sipPySelf), SIP_NULLPTR, sipName_GetBestSize);

    if (!sipMeth)
        return ::wxRichTextCell::GetBestSize();

    extern ::wxSize sipVH__richtext_4(sip_gilstate_t, sipVirtErrorHandlerFunc, sipSimpleWrapper *, PyObject *);

    return sipVH__richtext_4(sipGILState, 0, sipPySelf, sipMeth);
}

bool sipwxRichTextCell::FindPosition(::wxDC& dc, ::wxRichTextDrawingContext& context, long index, ::wxPoint& pt, int*height, bool forceLineStart)
{
    sip_gilstate_t sipGILState;
    PyObject *sipMeth;

    sipMeth = sipIsPyMethod(&sipGILState, &sipPyMethods[107], &sipPySelf, SIP_NULLPTR, sipName_FindPosition);

    if (!sipMeth)
        return ::wxRichTextCell::FindPosition(dc, context, index, pt, height, forceLineStart);

    extern bool sipVH__richtext_3(sip_gilstate_t, sipVirtErrorHandlerFunc, sipSimpleWrapper *, PyObject *, ::wxDC&, ::wxRichTextDrawingContext&, long, ::wxPoint&, int*, bool);

    return sipVH__richtext_3(sipGILState, 0, sipPySelf, sipMeth, dc, context, index, pt, height, forceLineStart);
}

int sipwxRichTextCell::HitTest(::wxDC& dc, ::wxRichTextDrawingContext& context, const ::wxPoint& pt, long& textPosition, ::wxRichTextObject**obj, ::wxRichTextObject**contextObj, int flags)
{
    sip_gilstate_t sipGILState;
    PyObject *sipMeth;

    sipMeth = sipIsPyMethod(&sipGILState, &sipPyMethods[108], &sipPySelf, SIP_NULLPTR, sipName_HitTest);

    if (!sipMeth)
        return ::wxRichTextCell::HitTest(dc, context, pt, textPosition, obj, contextObj, flags);

    extern int sipVH__richtext_2(sip_gilstate_t, sipVirtErrorHandlerFunc, sipSimpleWrapper *, PyObject *, ::wxDC&, ::wxRichTextDrawingContext&, const ::wxPoint&, long&, ::wxRichTextObject**, ::wxRichTextObject**, int);

    return sipVH__richtext_2(sipGILState, 0, sipPySelf, sipMeth, dc, context, pt, textPosition, obj, contextObj, flags);
}

bool sipwxRichTextCell::Layout(::wxDC& dc, ::wxRichTextDrawingContext& context, const ::wxRect& rect, const ::wxRect& parentRect, int style)
{
    sip_gilstate_t sipGILState;
    PyObject *sipMeth;

    sipMeth = sipIsPyMethod(&sipGILState, &sipPyMethods[109], &sipPySelf, SIP_NULLPTR, sipName_Layout);

    if (!sipMeth)
        return ::wxRichTextCell::Layout(dc, context, rect, parentRect, style);

    extern bool sipVH__richtext_1(sip_gilstate_t, sipVirtErrorHandlerFunc, sipSimpleWrapper *, PyObject *, ::wxDC&, ::wxRichTextDrawingContext&, const ::wxRect&, const ::wxRect&, int);

    return sipVH__richtext_1(sipGILState, 0, sipPySelf, sipMeth, dc, context, rect, parentRect, style);
}

bool sipwxRichTextCell::Draw(::wxDC& dc, ::wxRichTextDrawingContext& context, const ::wxRichTextRange& range, const ::wxRichTextSelection& selection, const ::wxRect& rect, int descent, int style)
{
    sip_gilstate_t sipGILState;
    PyObject *sipMeth;

    sipMeth = sipIsPyMethod(&sipGILState, &sipPyMethods[110], &sipPySelf, SIP_NULLPTR, sipName_Draw);

    if (!sipMeth)
        return ::wxRichTextCell::Draw(dc, context, range, selection, rect, descent, style);

    extern bool sipVH__richtext_0(sip_gilstate_t, sipVirtErrorHandlerFunc, sipSimpleWrapper *, PyObject *, ::wxDC&, ::wxRichTextDrawingContext&, const ::wxRichTextRange&, const ::wxRichTextSelection&, const ::wxRect&, int, int);

    return sipVH__richtext_0(sipGILState, 0, sipPySelf, sipMeth, dc, context, range, selection, rect, descent, style);
}

::wxRichTextObject* sipwxRichTextCell::GetChildAtPosition(long pos) const
{
    sip_gilstate_t sipGILState;
    PyObject *sipMeth;

    sipMeth = sipIsPyMethod(&sipGILState, const_cast<char *>(&sipPyMethods[111]), const_cast<sipSimpleWrapper **>(&sipPySelf), SIP_NULLPTR, sipName_GetChildAtPosition);

    if (!sipMeth)
        return ::wxRichTextCell::GetChildAtPosition(pos);

    extern ::wxRichTextObject* sipVH__richtext_6(sip_gilstate_t, sipVirtErrorHandlerFunc, sipSimpleWrapper *, PyObject *, long);

    return sipVH__richtext_6(sipGILState, 0, sipPySelf, sipMeth, pos);
}


PyDoc_STRVAR(doc_wxRichTextCell_Draw, "Draw(dc, context, range, selection, rect, descent, style) -> bool\n"
"\n"
"Draw the item, within the given range.");

extern "C" {static PyObject *meth_wxRichTextCell_Draw(PyObject *, PyObject *, PyObject *);}
static PyObject *meth_wxRichTextCell_Draw(PyObject *sipSelf, PyObject *sipArgs, PyObject *sipKwds)
{
    PyObject *sipParseErr = SIP_NULLPTR;
    bool sipSelfWasArg = (!sipSelf || sipIsDerivedClass((sipSimpleWrapper *)sipSelf));

    {
        ::wxDC* dc;
        ::wxRichTextDrawingContext* context;
        const ::wxRichTextRange* range;
        int rangeState = 0;
        const ::wxRichTextSelection* selection;
        const ::wxRect* rect;
        int rectState = 0;
        int descent;
        int style;
        ::wxRichTextCell *sipCpp;

        static const char *sipKwdList[] = {
            sipName_dc,
            sipName_context,
            sipName_range,
            sipName_selection,
            sipName_rect,
            sipName_descent,
            sipName_style,
        };

        if (sipParseKwdArgs(&sipParseErr, sipArgs, sipKwds, sipKwdList, SIP_NULLPTR, "BJ9J9J1J9J1ii", &sipSelf, sipType_wxRichTextCell, &sipCpp, sipType_wxDC, &dc, sipType_wxRichTextDrawingContext, &context, sipType_wxRichTextRange, &range, &rangeState, sipType_wxRichTextSelection, &selection, sipType_wxRect, &rect, &rectState, &descent, &style))
        {
            bool sipRes;

            PyErr_Clear();

            Py_BEGIN_ALLOW_THREADS
            sipRes = (sipSelfWasArg ? sipCpp->::wxRichTextCell::Draw(*dc, *context, *range, *selection, *rect, descent, style) : sipCpp->Draw(*dc, *context, *range, *selection, *rect, descent, style));
            Py_END_ALLOW_THREADS
            sipReleaseType(const_cast< ::wxRichTextRange *>(range), sipType_wxRichTextRange, rangeState);
            sipReleaseType(const_cast< ::wxRect *>(rect), sipType_wxRect, rectState);

            if (PyErr_Occurred())
                return 0;

            return PyBool_FromLong(sipRes);
        }
    }

    sipNoMethod(sipParseErr, sipName_RichTextCell, sipName_Draw, SIP_NULLPTR);

    return SIP_NULLPTR;
}


PyDoc_STRVAR(doc_wxRichTextCell_HitTest, "HitTest(dc, context, pt, flags=0) -> (int, textPosition, obj, contextObj)\n"
"\n"
"Hit-testing: returns a flag indicating hit test details, plus\n"
"information about position.");

extern "C" {static PyObject *meth_wxRichTextCell_HitTest(PyObject *, PyObject *, PyObject *);}
static PyObject *meth_wxRichTextCell_HitTest(PyObject *sipSelf, PyObject *sipArgs, PyObject *sipKwds)
{
    PyObject *sipParseErr = SIP_NULLPTR;
    bool sipSelfWasArg = (!sipSelf || sipIsDerivedClass((sipSimpleWrapper *)sipSelf));

    {
        ::wxDC* dc;
        ::wxRichTextDrawingContext* context;
        const ::wxPoint* pt;
        int ptState = 0;
        long textPosition;
        ::wxRichTextObject* obj;
        ::wxRichTextObject* contextObj;
        int flags = 0;
        ::wxRichTextCell *sipCpp;

        static const char *sipKwdList[] = {
            sipName_dc,
            sipName_context,
            sipName_pt,
            sipName_flags,
        };

        if (sipParseKwdArgs(&sipParseErr, sipArgs, sipKwds, sipKwdList, SIP_NULLPTR, "BJ9J9J1|i", &sipSelf, sipType_wxRichTextCell, &sipCpp, sipType_wxDC, &dc, sipType_wxRichTextDrawingContext, &context, sipType_wxPoint, &pt, &ptState, &flags))
        {
            int sipRes;

            PyErr_Clear();

            Py_BEGIN_ALLOW_THREADS
            sipRes = (sipSelfWasArg ? sipCpp->::wxRichTextCell::HitTest(*dc, *context, *pt, textPosition, &obj, &contextObj, flags) : sipCpp->HitTest(*dc, *context, *pt, textPosition, &obj, &contextObj, flags));
            Py_END_ALLOW_THREADS
            sipReleaseType(const_cast< ::wxPoint *>(pt), sipType_wxPoint, ptState);

            if (PyErr_Occurred())
                return 0;

            return sipBuildResult(0, "(ilDD)", sipRes, textPosition, obj, sipType_wxRichTextObject, SIP_NULLPTR, contextObj, sipType_wxRichTextObject, SIP_NULLPTR);
        }
    }

    sipNoMethod(sipParseErr, sipName_RichTextCell, sipName_HitTest, SIP_NULLPTR);

    return SIP_NULLPTR;
}


PyDoc_STRVAR(doc_wxRichTextCell_GetXMLNodeName, "GetXMLNodeName() -> String\n"
"\n"
"Returns the XML node name of this object.");

extern "C" {static PyObject *meth_wxRichTextCell_GetXMLNodeName(PyObject *, PyObject *);}
static PyObject *meth_wxRichTextCell_GetXMLNodeName(PyObject *sipSelf, PyObject *sipArgs)
{
    PyObject *sipParseErr = SIP_NULLPTR;
    bool sipSelfWasArg = (!sipSelf || sipIsDerivedClass((sipSimpleWrapper *)sipSelf));

    {
        const ::wxRichTextCell *sipCpp;

        if (sipParseArgs(&sipParseErr, sipArgs, "B", &sipSelf, sipType_wxRichTextCell, &sipCpp))
        {
            ::wxString*sipRes;

            PyErr_Clear();

            Py_BEGIN_ALLOW_THREADS
            sipRes = new ::wxString((sipSelfWasArg ? sipCpp->::wxRichTextCell::GetXMLNodeName() : sipCpp->GetXMLNodeName()));
            Py_END_ALLOW_THREADS

            if (PyErr_Occurred())
                return 0;

            return sipConvertFromNewType(sipRes, sipType_wxString, SIP_NULLPTR);
        }
    }

    sipNoMethod(sipParseErr, sipName_RichTextCell, sipName_GetXMLNodeName, SIP_NULLPTR);

    return SIP_NULLPTR;
}


PyDoc_STRVAR(doc_wxRichTextCell_CanEditProperties, "CanEditProperties() -> bool\n"
"\n"
"Returns true if we can edit the object's properties via a GUI.");

extern "C" {static PyObject *meth_wxRichTextCell_CanEditProperties(PyObject *, PyObject *);}
static PyObject *meth_wxRichTextCell_CanEditProperties(PyObject *sipSelf, PyObject *sipArgs)
{
    PyObject *sipParseErr = SIP_NULLPTR;
    bool sipSelfWasArg = (!sipSelf || sipIsDerivedClass((sipSimpleWrapper *)sipSelf));

    {
        const ::wxRichTextCell *sipCpp;

        if (sipParseArgs(&sipParseErr, sipArgs, "B", &sipSelf, sipType_wxRichTextCell, &sipCpp))
        {
            bool sipRes;

            PyErr_Clear();

            Py_BEGIN_ALLOW_THREADS
            sipRes = (sipSelfWasArg ? sipCpp->::wxRichTextCell::CanEditProperties() : sipCpp->CanEditProperties());
            Py_END_ALLOW_THREADS

            if (PyErr_Occurred())
                return 0;

            return PyBool_FromLong(sipRes);
        }
    }

    sipNoMethod(sipParseErr, sipName_RichTextCell, sipName_CanEditProperties, SIP_NULLPTR);

    return SIP_NULLPTR;
}


PyDoc_STRVAR(doc_wxRichTextCell_EditProperties, "EditProperties(parent, buffer) -> bool\n"
"\n"
"Edits the object's properties via a GUI.");

extern "C" {static PyObject *meth_wxRichTextCell_EditProperties(PyObject *, PyObject *, PyObject *);}
static PyObject *meth_wxRichTextCell_EditProperties(PyObject *sipSelf, PyObject *sipArgs, PyObject *sipKwds)
{
    PyObject *sipParseErr = SIP_NULLPTR;
    bool sipSelfWasArg = (!sipSelf || sipIsDerivedClass((sipSimpleWrapper *)sipSelf));

    {
        ::wxWindow* parent;
        ::wxRichTextBuffer* buffer;
        ::wxRichTextCell *sipCpp;

        static const char *sipKwdList[] = {
            sipName_parent,
            sipName_buffer,
        };

        if (sipParseKwdArgs(&sipParseErr, sipArgs, sipKwds, sipKwdList, SIP_NULLPTR, "BJ8J8", &sipSelf, sipType_wxRichTextCell, &sipCpp, sipType_wxWindow, &parent, sipType_wxRichTextBuffer, &buffer))
        {
            bool sipRes;

            PyErr_Clear();

            Py_BEGIN_ALLOW_THREADS
            sipRes = (sipSelfWasArg ? sipCpp->::wxRichTextCell::EditProperties(parent, buffer) : sipCpp->EditProperties(parent, buffer));
            Py_END_ALLOW_THREADS

            if (PyErr_Occurred())
                return 0;

            return PyBool_FromLong(sipRes);
        }
    }

    sipNoMethod(sipParseErr, sipName_RichTextCell, sipName_EditProperties, SIP_NULLPTR);

    return SIP_NULLPTR;
}


PyDoc_STRVAR(doc_wxRichTextCell_GetPropertiesMenuLabel, "GetPropertiesMenuLabel() -> String\n"
"\n"
"Returns the label to be used for the properties context menu item.");

extern "C" {static PyObject *meth_wxRichTextCell_GetPropertiesMenuLabel(PyObject *, PyObject *);}
static PyObject *meth_wxRichTextCell_GetPropertiesMenuLabel(PyObject *sipSelf, PyObject *sipArgs)
{
    PyObject *sipParseErr = SIP_NULLPTR;
    bool sipSelfWasArg = (!sipSelf || sipIsDerivedClass((sipSimpleWrapper *)sipSelf));

    {
        const ::wxRichTextCell *sipCpp;

        if (sipParseArgs(&sipParseErr, sipArgs, "B", &sipSelf, sipType_wxRichTextCell, &sipCpp))
        {
            ::wxString*sipRes;

            PyErr_Clear();

            Py_BEGIN_ALLOW_THREADS
            sipRes = new ::wxString((sipSelfWasArg ? sipCpp->::wxRichTextCell::GetPropertiesMenuLabel() : sipCpp->GetPropertiesMenuLabel()));
            Py_END_ALLOW_THREADS

            if (PyErr_Occurred())
                return 0;

            return sipConvertFromNewType(sipRes, sipType_wxString, SIP_NULLPTR);
        }
    }

    sipNoMethod(sipParseErr, sipName_RichTextCell, sipName_GetPropertiesMenuLabel, SIP_NULLPTR);

    return SIP_NULLPTR;
}


PyDoc_STRVAR(doc_wxRichTextCell_GetColSpan, "GetColSpan() -> int\n"
"\n"
"Returns the number of columns spanned by the cell.");

extern "C" {static PyObject *meth_wxRichTextCell_GetColSpan(PyObject *, PyObject *);}
static PyObject *meth_wxRichTextCell_GetColSpan(PyObject *sipSelf, PyObject *sipArgs)
{
    PyObject *sipParseErr = SIP_NULLPTR;

    {
        const ::wxRichTextCell *sipCpp;

        if (sipParseArgs(&sipParseErr, sipArgs, "B", &sipSelf, sipType_wxRichTextCell, &sipCpp))
        {
            int sipRes;

            PyErr_Clear();

            Py_BEGIN_ALLOW_THREADS
            sipRes = sipCpp->GetColSpan();
            Py_END_ALLOW_THREADS

            if (PyErr_Occurred())
                return 0;

            return PyLong_FromLong(sipRes);
        }
    }

    sipNoMethod(sipParseErr, sipName_RichTextCell, sipName_GetColSpan, SIP_NULLPTR);

    return SIP_NULLPTR;
}


PyDoc_STRVAR(doc_wxRichTextCell_SetColSpan, "SetColSpan(span)\n"
"\n"
"Set the number of columns spanned by the cell.");

extern "C" {static PyObject *meth_wxRichTextCell_SetColSpan(PyObject *, PyObject *, PyObject *);}
static PyObject *meth_wxRichTextCell_SetColSpan(PyObject *sipSelf, PyObject *sipArgs, PyObject *sipKwds)
{
    PyObject *sipParseErr = SIP_NULLPTR;

    {
        long span;
        ::wxRichTextCell *sipCpp;

        static const char *sipKwdList[] = {
            sipName_span,
        };

        if (sipParseKwdArgs(&sipParseErr, sipArgs, sipKwds, sipKwdList, SIP_NULLPTR, "Bl", &sipSelf, sipType_wxRichTextCell, &sipCpp, &span))
        {
            PyErr_Clear();

            Py_BEGIN_ALLOW_THREADS
            sipCpp->SetColSpan(span);
            Py_END_ALLOW_THREADS

            if (PyErr_Occurred())
                return 0;

            Py_INCREF(Py_None);
            return Py_None;
        }
    }

    sipNoMethod(sipParseErr, sipName_RichTextCell, sipName_SetColSpan, SIP_NULLPTR);

    return SIP_NULLPTR;
}


PyDoc_STRVAR(doc_wxRichTextCell_GetRowSpan, "GetRowSpan() -> int\n"
"\n"
"Returns the number of rows spanned by the cell.");

extern "C" {static PyObject *meth_wxRichTextCell_GetRowSpan(PyObject *, PyObject *);}
static PyObject *meth_wxRichTextCell_GetRowSpan(PyObject *sipSelf, PyObject *sipArgs)
{
    PyObject *sipParseErr = SIP_NULLPTR;

    {
        const ::wxRichTextCell *sipCpp;

        if (sipParseArgs(&sipParseErr, sipArgs, "B", &sipSelf, sipType_wxRichTextCell, &sipCpp))
        {
            int sipRes;

            PyErr_Clear();

            Py_BEGIN_ALLOW_THREADS
            sipRes = sipCpp->GetRowSpan();
            Py_END_ALLOW_THREADS

            if (PyErr_Occurred())
                return 0;

            return PyLong_FromLong(sipRes);
        }
    }

    sipNoMethod(sipParseErr, sipName_RichTextCell, sipName_GetRowSpan, SIP_NULLPTR);

    return SIP_NULLPTR;
}


PyDoc_STRVAR(doc_wxRichTextCell_SetRowSpan, "SetRowSpan(span)\n"
"\n"
"Set the number of rows spanned by the cell.");

extern "C" {static PyObject *meth_wxRichTextCell_SetRowSpan(PyObject *, PyObject *, PyObject *);}
static PyObject *meth_wxRichTextCell_SetRowSpan(PyObject *sipSelf, PyObject *sipArgs, PyObject *sipKwds)
{
    PyObject *sipParseErr = SIP_NULLPTR;

    {
        long span;
        ::wxRichTextCell *sipCpp;

        static const char *sipKwdList[] = {
            sipName_span,
        };

        if (sipParseKwdArgs(&sipParseErr, sipArgs, sipKwds, sipKwdList, SIP_NULLPTR, "Bl", &sipSelf, sipType_wxRichTextCell, &sipCpp, &span))
        {
            PyErr_Clear();

            Py_BEGIN_ALLOW_THREADS
            sipCpp->SetRowSpan(span);
            Py_END_ALLOW_THREADS

            if (PyErr_Occurred())
                return 0;

            Py_INCREF(Py_None);
            return Py_None;
        }
    }

    sipNoMethod(sipParseErr, sipName_RichTextCell, sipName_SetRowSpan, SIP_NULLPTR);

    return SIP_NULLPTR;
}


PyDoc_STRVAR(doc_wxRichTextCell_Clone, "Clone() -> RichTextObject\n"
"\n"
"Clones the object.");

extern "C" {static PyObject *meth_wxRichTextCell_Clone(PyObject *, PyObject *);}
static PyObject *meth_wxRichTextCell_Clone(PyObject *sipSelf, PyObject *sipArgs)
{
    PyObject *sipParseErr = SIP_NULLPTR;
    bool sipSelfWasArg = (!sipSelf || sipIsDerivedClass((sipSimpleWrapper *)sipSelf));

    {
        const ::wxRichTextCell *sipCpp;

        if (sipParseArgs(&sipParseErr, sipArgs, "B", &sipSelf, sipType_wxRichTextCell, &sipCpp))
        {
            ::wxRichTextObject*sipRes;

            PyErr_Clear();

            Py_BEGIN_ALLOW_THREADS
            sipRes = (sipSelfWasArg ? sipCpp->::wxRichTextCell::Clone() : sipCpp->Clone());
            Py_END_ALLOW_THREADS

            if (PyErr_Occurred())
                return 0;

            return sipConvertFromNewType(sipRes, sipType_wxRichTextObject, SIP_NULLPTR);
        }
    }

    sipNoMethod(sipParseErr, sipName_RichTextCell, sipName_Clone, SIP_NULLPTR);

    return SIP_NULLPTR;
}


PyDoc_STRVAR(doc_wxRichTextCell_Copy, "Copy(obj)");

extern "C" {static PyObject *meth_wxRichTextCell_Copy(PyObject *, PyObject *, PyObject *);}
static PyObject *meth_wxRichTextCell_Copy(PyObject *sipSelf, PyObject *sipArgs, PyObject *sipKwds)
{
    PyObject *sipParseErr = SIP_NULLPTR;

    {
        const ::wxRichTextCell* obj;
        ::wxRichTextCell *sipCpp;

        static const char *sipKwdList[] = {
            sipName_obj,
        };

        if (sipParseKwdArgs(&sipParseErr, sipArgs, sipKwds, sipKwdList, SIP_NULLPTR, "BJ9", &sipSelf, sipType_wxRichTextCell, &sipCpp, sipType_wxRichTextCell, &obj))
        {
            PyErr_Clear();

            Py_BEGIN_ALLOW_THREADS
            sipCpp->Copy(*obj);
            Py_END_ALLOW_THREADS

            if (PyErr_Occurred())
                return 0;

            Py_INCREF(Py_None);
            return Py_None;
        }
    }

    sipNoMethod(sipParseErr, sipName_RichTextCell, sipName_Copy, SIP_NULLPTR);

    return SIP_NULLPTR;
}


PyDoc_STRVAR(doc_wxRichTextCell_Layout, "Layout(self, dc: DC, context: RichTextDrawingContext, rect: Rect, parentRect: Rect, style: int) -> bool");

extern "C" {static PyObject *meth_wxRichTextCell_Layout(PyObject *, PyObject *, PyObject *);}
static PyObject *meth_wxRichTextCell_Layout(PyObject *sipSelf, PyObject *sipArgs, PyObject *sipKwds)
{
    PyObject *sipParseErr = SIP_NULLPTR;
    bool sipSelfWasArg = (!sipSelf || sipIsDerivedClass((sipSimpleWrapper *)sipSelf));

    {
        ::wxDC* dc;
        ::wxRichTextDrawingContext* context;
        const ::wxRect* rect;
        int rectState = 0;
        const ::wxRect* parentRect;
        int parentRectState = 0;
        int style;
        ::wxRichTextCell *sipCpp;

        static const char *sipKwdList[] = {
            sipName_dc,
            sipName_context,
            sipName_rect,
            sipName_parentRect,
            sipName_style,
        };

        if (sipParseKwdArgs(&sipParseErr, sipArgs, sipKwds, sipKwdList, SIP_NULLPTR, "BJ9J9J1J1i", &sipSelf, sipType_wxRichTextCell, &sipCpp, sipType_wxDC, &dc, sipType_wxRichTextDrawingContext, &context, sipType_wxRect, &rect, &rectState, sipType_wxRect, &parentRect, &parentRectState, &style))
        {
            bool sipRes;

            PyErr_Clear();

            Py_BEGIN_ALLOW_THREADS
            sipRes = (sipSelfWasArg ? sipCpp->::wxRichTextCell::Layout(*dc, *context, *rect, *parentRect, style) : sipCpp->Layout(*dc, *context, *rect, *parentRect, style));
            Py_END_ALLOW_THREADS
            sipReleaseType(const_cast< ::wxRect *>(rect), sipType_wxRect, rectState);
            sipReleaseType(const_cast< ::wxRect *>(parentRect), sipType_wxRect, parentRectState);

            if (PyErr_Occurred())
                return 0;

            return PyBool_FromLong(sipRes);
        }
    }

    sipNoMethod(sipParseErr, sipName_RichTextCell, sipName_Layout, doc_wxRichTextCell_Layout);

    return SIP_NULLPTR;
}


PyDoc_STRVAR(doc_wxRichTextCell_GetRangeSize, "GetRangeSize(self, range: RichTextRange, size: Size, dc: DC, context: RichTextDrawingContext, flags: int, position: Point = wxPoint(0, 0), parentSize: Size = wxDefaultSize, partialExtents: Any = None) -> (bool, int)");

extern "C" {static PyObject *meth_wxRichTextCell_GetRangeSize(PyObject *, PyObject *, PyObject *);}
static PyObject *meth_wxRichTextCell_GetRangeSize(PyObject *sipSelf, PyObject *sipArgs, PyObject *sipKwds)
{
    PyObject *sipParseErr = SIP_NULLPTR;
    bool sipSelfWasArg = (!sipSelf || sipIsDerivedClass((sipSimpleWrapper *)sipSelf));

    {
        const ::wxRichTextRange* range;
        int rangeState = 0;
        ::wxSize* size;
        int sizeState = 0;
        int descent;
        ::wxDC* dc;
        ::wxRichTextDrawingContext* context;
        int flags;
        const ::wxPoint& positiondef = wxPoint(0, 0);
        const ::wxPoint* position = &positiondef;
        int positionState = 0;
        const ::wxSize& parentSizedef = wxDefaultSize;
        const ::wxSize* parentSize = &parentSizedef;
        int parentSizeState = 0;
        ::wxArrayInt* partialExtents = 0;
        int partialExtentsState = 0;
        const ::wxRichTextCell *sipCpp;

        static const char *sipKwdList[] = {
            sipName_range,
            sipName_size,
            sipName_dc,
            sipName_context,
            sipName_flags,
            sipName_position,
            sipName_parentSize,
            sipName_partialExtents,
        };

        if (sipParseKwdArgs(&sipParseErr, sipArgs, sipKwds, sipKwdList, SIP_NULLPTR, "BJ1J1J9J9i|J1J1J0", &sipSelf, sipType_wxRichTextCell, &sipCpp, sipType_wxRichTextRange, &range, &rangeState, sipType_wxSize, &size, &sizeState, sipType_wxDC, &dc, sipType_wxRichTextDrawingContext, &context, &flags, sipType_wxPoint, &position, &positionState, sipType_wxSize, &parentSize, &parentSizeState, sipType_wxArrayInt, &partialExtents, &partialExtentsState))
        {
            bool sipRes;

            PyErr_Clear();

            Py_BEGIN_ALLOW_THREADS
            sipRes = (sipSelfWasArg ? sipCpp->::wxRichTextCell::GetRangeSize(*range, *size, descent, *dc, *context, flags, *position, *parentSize, partialExtents) : sipCpp->GetRangeSize(*range, *size, descent, *dc, *context, flags, *position, *parentSize, partialExtents));
            Py_END_ALLOW_THREADS
            sipReleaseType(const_cast< ::wxRichTextRange *>(range), sipType_wxRichTextRange, rangeState);
            sipReleaseType(size, sipType_wxSize, sizeState);
            sipReleaseType(const_cast< ::wxPoint *>(position), sipType_wxPoint, positionState);
            sipReleaseType(const_cast< ::wxSize *>(parentSize), sipType_wxSize, parentSizeState);
            sipReleaseType(partialExtents, sipType_wxArrayInt, partialExtentsState);

            if (PyErr_Occurred())
                return 0;

            return sipBuildResult(0, "(bi)", sipRes, descent);
        }
    }

    sipNoMethod(sipParseErr, sipName_RichTextCell, sipName_GetRangeSize, doc_wxRichTextCell_GetRangeSize);

    return SIP_NULLPTR;
}


/* Cast a pointer to a type somewhere in its inheritance hierarchy. */
extern "C" {static void *cast_wxRichTextCell(void *, const sipTypeDef *);}
static void *cast_wxRichTextCell(void *sipCppV, const sipTypeDef *targetType)
{
    ::wxRichTextCell *sipCpp = reinterpret_cast< ::wxRichTextCell *>(sipCppV);

    if (targetType == sipType_wxRichTextCell)
        return sipCppV;

    sipCppV = ((const sipClassTypeDef *)sipType_wxRichTextBox)->ctd_cast(static_cast< ::wxRichTextBox *>(sipCpp), targetType);
    if (sipCppV)
        return sipCppV;

    return SIP_NULLPTR;
}


/* Call the instance's destructor. */
extern "C" {static void release_wxRichTextCell(void *, int);}
static void release_wxRichTextCell(void *sipCppV, int sipState)
{
    Py_BEGIN_ALLOW_THREADS

    if (sipState & SIP_DERIVED_CLASS)
        delete reinterpret_cast<sipwxRichTextCell *>(sipCppV);
    else
        delete reinterpret_cast< ::wxRichTextCell *>(sipCppV);

    Py_END_ALLOW_THREADS
}


extern "C" {static void *array_wxRichTextCell(Py_ssize_t);}
static void *array_wxRichTextCell(Py_ssize_t sipNrElem)
{
    return new ::wxRichTextCell[sipNrElem];
}


extern "C" {static void array_delete_wxRichTextCell(void *);}
static void array_delete_wxRichTextCell(void *sipCpp)
{
    delete[] reinterpret_cast< ::wxRichTextCell *>(sipCpp);
}


extern "C" {static void assign_wxRichTextCell(void *, Py_ssize_t, void *);}
static void assign_wxRichTextCell(void *sipDst, Py_ssize_t sipDstIdx, void *sipSrc)
{
    reinterpret_cast< ::wxRichTextCell *>(sipDst)[sipDstIdx] = *reinterpret_cast< ::wxRichTextCell *>(sipSrc);
}


extern "C" {static void *copy_wxRichTextCell(const void *, Py_ssize_t);}
static void *copy_wxRichTextCell(const void *sipSrc, Py_ssize_t sipSrcIdx)
{
    return new ::wxRichTextCell(reinterpret_cast<const ::wxRichTextCell *>(sipSrc)[sipSrcIdx]);
}


extern "C" {static void dealloc_wxRichTextCell(sipSimpleWrapper *);}
static void dealloc_wxRichTextCell(sipSimpleWrapper *sipSelf)
{
    if (sipIsDerivedClass(sipSelf))
        reinterpret_cast<sipwxRichTextCell *>(sipGetAddress(sipSelf))->sipPySelf = SIP_NULLPTR;

    if (sipIsOwnedByPython(sipSelf))
    {
        release_wxRichTextCell(sipGetAddress(sipSelf), sipIsDerivedClass(sipSelf));
    }
}


extern "C" {static void *init_type_wxRichTextCell(sipSimpleWrapper *, PyObject *, PyObject *, PyObject **, PyObject **, PyObject **);}
static void *init_type_wxRichTextCell(sipSimpleWrapper *sipSelf, PyObject *sipArgs, PyObject *sipKwds, PyObject **sipUnused, PyObject **, PyObject **sipParseErr)
{
    sipwxRichTextCell *sipCpp = SIP_NULLPTR;

    {
        ::wxRichTextObject* parent = 0;

        static const char *sipKwdList[] = {
            sipName_parent,
        };

        if (sipParseKwdArgs(sipParseErr, sipArgs, sipKwds, sipKwdList, sipUnused, "|J8", sipType_wxRichTextObject, &parent))
        {
            PyErr_Clear();

            Py_BEGIN_ALLOW_THREADS
            sipCpp = new sipwxRichTextCell(parent);
            Py_END_ALLOW_THREADS

            if (PyErr_Occurred())
            {
                delete sipCpp;
                return SIP_NULLPTR;
            }

            sipCpp->sipPySelf = sipSelf;

            return sipCpp;
        }
    }

    {
        const ::wxRichTextCell* obj;

        static const char *sipKwdList[] = {
            sipName_obj,
        };

        if (sipParseKwdArgs(sipParseErr, sipArgs, sipKwds, sipKwdList, sipUnused, "J9", sipType_wxRichTextCell, &obj))
        {
            PyErr_Clear();

            Py_BEGIN_ALLOW_THREADS
            sipCpp = new sipwxRichTextCell(*obj);
            Py_END_ALLOW_THREADS

            if (PyErr_Occurred())
            {
                delete sipCpp;
                return SIP_NULLPTR;
            }

            sipCpp->sipPySelf = sipSelf;

            return sipCpp;
        }
    }

    return SIP_NULLPTR;
}


/* Define this type's super-types. */
static sipEncodedTypeDef supers_wxRichTextCell[] = {{5, 255, 1}};


static PyMethodDef methods_wxRichTextCell[] = {
    {sipName_CanEditProperties, meth_wxRichTextCell_CanEditProperties, METH_VARARGS, doc_wxRichTextCell_CanEditProperties},
    {sipName_Clone, meth_wxRichTextCell_Clone, METH_VARARGS, doc_wxRichTextCell_Clone},
    {sipName_Copy, SIP_MLMETH_CAST(meth_wxRichTextCell_Copy), METH_VARARGS|METH_KEYWORDS, doc_wxRichTextCell_Copy},
    {sipName_Draw, SIP_MLMETH_CAST(meth_wxRichTextCell_Draw), METH_VARARGS|METH_KEYWORDS, doc_wxRichTextCell_Draw},
    {sipName_EditProperties, SIP_MLMETH_CAST(meth_wxRichTextCell_EditProperties), METH_VARARGS|METH_KEYWORDS, doc_wxRichTextCell_EditProperties},
    {sipName_GetColSpan, meth_wxRichTextCell_GetColSpan, METH_VARARGS, doc_wxRichTextCell_GetColSpan},
    {sipName_GetPropertiesMenuLabel, meth_wxRichTextCell_GetPropertiesMenuLabel, METH_VARARGS, doc_wxRichTextCell_GetPropertiesMenuLabel},
    {sipName_GetRangeSize, SIP_MLMETH_CAST(meth_wxRichTextCell_GetRangeSize), METH_VARARGS|METH_KEYWORDS, doc_wxRichTextCell_GetRangeSize},
    {sipName_GetRowSpan, meth_wxRichTextCell_GetRowSpan, METH_VARARGS, doc_wxRichTextCell_GetRowSpan},
    {sipName_GetXMLNodeName, meth_wxRichTextCell_GetXMLNodeName, METH_VARARGS, doc_wxRichTextCell_GetXMLNodeName},
    {sipName_HitTest, SIP_MLMETH_CAST(meth_wxRichTextCell_HitTest), METH_VARARGS|METH_KEYWORDS, doc_wxRichTextCell_HitTest},
    {sipName_Layout, SIP_MLMETH_CAST(meth_wxRichTextCell_Layout), METH_VARARGS|METH_KEYWORDS, doc_wxRichTextCell_Layout},
    {sipName_SetColSpan, SIP_MLMETH_CAST(meth_wxRichTextCell_SetColSpan), METH_VARARGS|METH_KEYWORDS, doc_wxRichTextCell_SetColSpan},
    {sipName_SetRowSpan, SIP_MLMETH_CAST(meth_wxRichTextCell_SetRowSpan), METH_VARARGS|METH_KEYWORDS, doc_wxRichTextCell_SetRowSpan}
};

sipVariableDef variables_wxRichTextCell[] = {
    {PropertyVariable, sipName_XMLNodeName, &methods_wxRichTextCell[9], SIP_NULLPTR, SIP_NULLPTR, SIP_NULLPTR},
    {PropertyVariable, sipName_RowSpan, &methods_wxRichTextCell[8], &methods_wxRichTextCell[13], SIP_NULLPTR, SIP_NULLPTR},
    {PropertyVariable, sipName_PropertiesMenuLabel, &methods_wxRichTextCell[6], SIP_NULLPTR, SIP_NULLPTR, SIP_NULLPTR},
    {PropertyVariable, sipName_ColSpan, &methods_wxRichTextCell[5], &methods_wxRichTextCell[12], SIP_NULLPTR, SIP_NULLPTR},
};

PyDoc_STRVAR(doc_wxRichTextCell, "RichTextCell(parent=None)\n"
"RichTextCell(obj)\n"
"\n"
"wxRichTextCell is the cell in a table, in which the user can type.");


sipClassTypeDef sipTypeDef__richtext_wxRichTextCell = {
    {
        -1,
        SIP_NULLPTR,
        SIP_NULLPTR,
        SIP_TYPE_SCC|SIP_TYPE_CLASS,
        sipNameNr_wxRichTextCell,
        SIP_NULLPTR,
        SIP_NULLPTR,
    },
    {
        sipNameNr_RichTextCell,
        {0, 0, 1},
        14, methods_wxRichTextCell,
        0, SIP_NULLPTR,
        4, variables_wxRichTextCell,
        {SIP_NULLPTR, SIP_NULLPTR, SIP_NULLPTR, SIP_NULLPTR, SIP_NULLPTR, SIP_NULLPTR, SIP_NULLPTR, SIP_NULLPTR, SIP_NULLPTR, SIP_NULLPTR},
    },
    doc_wxRichTextCell,
    -1,
    -1,
    supers_wxRichTextCell,
    SIP_NULLPTR,
    init_type_wxRichTextCell,
    SIP_NULLPTR,
    SIP_NULLPTR,
    SIP_NULLPTR,
    SIP_NULLPTR,
    dealloc_wxRichTextCell,
    assign_wxRichTextCell,
    array_wxRichTextCell,
    copy_wxRichTextCell,
    release_wxRichTextCell,
    cast_wxRichTextCell,
    SIP_NULLPTR,
    SIP_NULLPTR,
    SIP_NULLPTR,
    SIP_NULLPTR,
    SIP_NULLPTR,
    SIP_NULLPTR,
    array_delete_wxRichTextCell,
    sizeof (::wxRichTextCell),
};
