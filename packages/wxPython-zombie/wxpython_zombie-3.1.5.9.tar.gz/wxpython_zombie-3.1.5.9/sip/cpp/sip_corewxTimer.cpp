/*
 * Interface wrapper code.
 *
 * Generated by SIP 6.15.1
 */

#include "sipAPI_core.h"

        #include <wx/timer.h>

        #include <wx/event.h>
        #include <wx/event.h>
        #include <wx/eventfilter.h>
        #include <wx/object.h>
        #include <wx/object.h>
        #include <wx/object.h>


class sipwxTimer : public ::wxTimer
{
public:
    sipwxTimer();
    sipwxTimer(::wxEvtHandler*, int);
    virtual ~sipwxTimer();

    /*
     * There is a public method for every protected method visible from
     * this class.
     */
    bool sipProtectVirt_TryBefore(bool, ::wxEvent&);
    bool sipProtectVirt_TryAfter(bool, ::wxEvent&);

    /*
     * There is a protected method for every virtual method visible from
     * this class.
     */
protected:
    void Stop() SIP_OVERRIDE;
    bool Start(int, bool) SIP_OVERRIDE;
    void Notify() SIP_OVERRIDE;
    bool ProcessEvent(::wxEvent&) SIP_OVERRIDE;
    bool TryBefore(::wxEvent&) SIP_OVERRIDE;
    bool TryAfter(::wxEvent&) SIP_OVERRIDE;

public:
    sipSimpleWrapper *sipPySelf;

private:
    sipwxTimer(const sipwxTimer &);
    sipwxTimer &operator = (const sipwxTimer &);

    char sipPyMethods[6];
};

sipwxTimer::sipwxTimer(): ::wxTimer(), sipPySelf(SIP_NULLPTR)
{
    memset(sipPyMethods, 0, sizeof (sipPyMethods));
}

sipwxTimer::sipwxTimer(::wxEvtHandler*owner, int id): ::wxTimer(owner, id), sipPySelf(SIP_NULLPTR)
{
    memset(sipPyMethods, 0, sizeof (sipPyMethods));
}

sipwxTimer::~sipwxTimer()
{
    sipInstanceDestroyedEx(&sipPySelf);
}

void sipwxTimer::Stop()
{
    sip_gilstate_t sipGILState;
    PyObject *sipMeth;

    sipMeth = sipIsPyMethod(&sipGILState, &sipPyMethods[0], &sipPySelf, SIP_NULLPTR, sipName_Stop);

    if (!sipMeth)
    {
        ::wxTimer::Stop();
        return;
    }

    extern void sipVH__core_53(sip_gilstate_t, sipVirtErrorHandlerFunc, sipSimpleWrapper *, PyObject *);

    sipVH__core_53(sipGILState, 0, sipPySelf, sipMeth);
}

bool sipwxTimer::Start(int milliseconds, bool oneShot)
{
    sip_gilstate_t sipGILState;
    PyObject *sipMeth;

    sipMeth = sipIsPyMethod(&sipGILState, &sipPyMethods[1], &sipPySelf, SIP_NULLPTR, sipName_Start);

    if (!sipMeth)
        return ::wxTimer::Start(milliseconds, oneShot);

    extern bool sipVH__core_120(sip_gilstate_t, sipVirtErrorHandlerFunc, sipSimpleWrapper *, PyObject *, int, bool);

    return sipVH__core_120(sipGILState, 0, sipPySelf, sipMeth, milliseconds, oneShot);
}

void sipwxTimer::Notify()
{
    sip_gilstate_t sipGILState;
    PyObject *sipMeth;

    sipMeth = sipIsPyMethod(&sipGILState, &sipPyMethods[2], &sipPySelf, SIP_NULLPTR, sipName_Notify);

    if (!sipMeth)
    {
        ::wxTimer::Notify();
        return;
    }

    extern void sipVH__core_53(sip_gilstate_t, sipVirtErrorHandlerFunc, sipSimpleWrapper *, PyObject *);

    sipVH__core_53(sipGILState, 0, sipPySelf, sipMeth);
}

bool sipwxTimer::ProcessEvent(::wxEvent& event)
{
    sip_gilstate_t sipGILState;
    PyObject *sipMeth;

    sipMeth = sipIsPyMethod(&sipGILState, &sipPyMethods[3], &sipPySelf, SIP_NULLPTR, sipName_ProcessEvent);

    if (!sipMeth)
        return ::wxTimer::ProcessEvent(event);

    extern bool sipVH__core_98(sip_gilstate_t, sipVirtErrorHandlerFunc, sipSimpleWrapper *, PyObject *, ::wxEvent&);

    return sipVH__core_98(sipGILState, 0, sipPySelf, sipMeth, event);
}

bool sipwxTimer::TryBefore(::wxEvent& event)
{
    sip_gilstate_t sipGILState;
    PyObject *sipMeth;

    sipMeth = sipIsPyMethod(&sipGILState, &sipPyMethods[4], &sipPySelf, SIP_NULLPTR, sipName_TryBefore);

    if (!sipMeth)
        return ::wxTimer::TryBefore(event);

    extern bool sipVH__core_98(sip_gilstate_t, sipVirtErrorHandlerFunc, sipSimpleWrapper *, PyObject *, ::wxEvent&);

    return sipVH__core_98(sipGILState, 0, sipPySelf, sipMeth, event);
}

bool sipwxTimer::TryAfter(::wxEvent& event)
{
    sip_gilstate_t sipGILState;
    PyObject *sipMeth;

    sipMeth = sipIsPyMethod(&sipGILState, &sipPyMethods[5], &sipPySelf, SIP_NULLPTR, sipName_TryAfter);

    if (!sipMeth)
        return ::wxTimer::TryAfter(event);

    extern bool sipVH__core_98(sip_gilstate_t, sipVirtErrorHandlerFunc, sipSimpleWrapper *, PyObject *, ::wxEvent&);

    return sipVH__core_98(sipGILState, 0, sipPySelf, sipMeth, event);
}

bool sipwxTimer::sipProtectVirt_TryBefore(bool sipSelfWasArg, ::wxEvent& event)
{
    return (sipSelfWasArg ? ::wxEvtHandler::TryBefore(event) : TryBefore(event));
}

bool sipwxTimer::sipProtectVirt_TryAfter(bool sipSelfWasArg, ::wxEvent& event)
{
    return (sipSelfWasArg ? ::wxEvtHandler::TryAfter(event) : TryAfter(event));
}


PyDoc_STRVAR(doc_wxTimer_TryBefore, "TryBefore(event) -> bool\n"
"\n"
"Method called by ProcessEvent() before examining this object event\n"
"tables.");

extern "C" {static PyObject *meth_wxTimer_TryBefore(PyObject *, PyObject *, PyObject *);}
static PyObject *meth_wxTimer_TryBefore(PyObject *sipSelf, PyObject *sipArgs, PyObject *sipKwds)
{
    PyObject *sipParseErr = SIP_NULLPTR;
    bool sipSelfWasArg = (!sipSelf || sipIsDerivedClass((sipSimpleWrapper *)sipSelf));

    {
        ::wxEvent* event;
        sipwxTimer *sipCpp;

        static const char *sipKwdList[] = {
            sipName_event,
        };

        if (sipParseKwdArgs(&sipParseErr, sipArgs, sipKwds, sipKwdList, SIP_NULLPTR, "BJ9", &sipSelf, sipType_wxTimer, &sipCpp, sipType_wxEvent, &event))
        {
            bool sipRes;

            PyErr_Clear();

            Py_BEGIN_ALLOW_THREADS
            sipRes = sipCpp->sipProtectVirt_TryBefore(sipSelfWasArg, *event);
            Py_END_ALLOW_THREADS

            if (PyErr_Occurred())
                return 0;

            return PyBool_FromLong(sipRes);
        }
    }

    sipNoMethod(sipParseErr, sipName_Timer, sipName_TryBefore, SIP_NULLPTR);

    return SIP_NULLPTR;
}


PyDoc_STRVAR(doc_wxTimer_TryAfter, "TryAfter(event) -> bool\n"
"\n"
"Method called by ProcessEvent() as last resort.");

extern "C" {static PyObject *meth_wxTimer_TryAfter(PyObject *, PyObject *, PyObject *);}
static PyObject *meth_wxTimer_TryAfter(PyObject *sipSelf, PyObject *sipArgs, PyObject *sipKwds)
{
    PyObject *sipParseErr = SIP_NULLPTR;
    bool sipSelfWasArg = (!sipSelf || sipIsDerivedClass((sipSimpleWrapper *)sipSelf));

    {
        ::wxEvent* event;
        sipwxTimer *sipCpp;

        static const char *sipKwdList[] = {
            sipName_event,
        };

        if (sipParseKwdArgs(&sipParseErr, sipArgs, sipKwds, sipKwdList, SIP_NULLPTR, "BJ9", &sipSelf, sipType_wxTimer, &sipCpp, sipType_wxEvent, &event))
        {
            bool sipRes;

            PyErr_Clear();

            Py_BEGIN_ALLOW_THREADS
            sipRes = sipCpp->sipProtectVirt_TryAfter(sipSelfWasArg, *event);
            Py_END_ALLOW_THREADS

            if (PyErr_Occurred())
                return 0;

            return PyBool_FromLong(sipRes);
        }
    }

    sipNoMethod(sipParseErr, sipName_Timer, sipName_TryAfter, SIP_NULLPTR);

    return SIP_NULLPTR;
}


PyDoc_STRVAR(doc_wxTimer_GetId, "GetId() -> int\n"
"\n"
"Returns the ID of the events generated by this timer.");

extern "C" {static PyObject *meth_wxTimer_GetId(PyObject *, PyObject *);}
static PyObject *meth_wxTimer_GetId(PyObject *sipSelf, PyObject *sipArgs)
{
    PyObject *sipParseErr = SIP_NULLPTR;

    {
        const ::wxTimer *sipCpp;

        if (sipParseArgs(&sipParseErr, sipArgs, "B", &sipSelf, sipType_wxTimer, &sipCpp))
        {
            int sipRes;

            PyErr_Clear();

            Py_BEGIN_ALLOW_THREADS
            sipRes = sipCpp->GetId();
            Py_END_ALLOW_THREADS

            if (PyErr_Occurred())
                return 0;

            return PyLong_FromLong(sipRes);
        }
    }

    sipNoMethod(sipParseErr, sipName_Timer, sipName_GetId, SIP_NULLPTR);

    return SIP_NULLPTR;
}


PyDoc_STRVAR(doc_wxTimer_GetInterval, "GetInterval() -> int\n"
"\n"
"Returns the current interval for the timer (in milliseconds).");

extern "C" {static PyObject *meth_wxTimer_GetInterval(PyObject *, PyObject *);}
static PyObject *meth_wxTimer_GetInterval(PyObject *sipSelf, PyObject *sipArgs)
{
    PyObject *sipParseErr = SIP_NULLPTR;

    {
        const ::wxTimer *sipCpp;

        if (sipParseArgs(&sipParseErr, sipArgs, "B", &sipSelf, sipType_wxTimer, &sipCpp))
        {
            int sipRes;

            PyErr_Clear();

            Py_BEGIN_ALLOW_THREADS
            sipRes = sipCpp->GetInterval();
            Py_END_ALLOW_THREADS

            if (PyErr_Occurred())
                return 0;

            return PyLong_FromLong(sipRes);
        }
    }

    sipNoMethod(sipParseErr, sipName_Timer, sipName_GetInterval, SIP_NULLPTR);

    return SIP_NULLPTR;
}


PyDoc_STRVAR(doc_wxTimer_GetOwner, "GetOwner() -> EvtHandler\n"
"\n"
"Returns the current owner of the timer.");

extern "C" {static PyObject *meth_wxTimer_GetOwner(PyObject *, PyObject *);}
static PyObject *meth_wxTimer_GetOwner(PyObject *sipSelf, PyObject *sipArgs)
{
    PyObject *sipParseErr = SIP_NULLPTR;

    {
        const ::wxTimer *sipCpp;

        if (sipParseArgs(&sipParseErr, sipArgs, "B", &sipSelf, sipType_wxTimer, &sipCpp))
        {
            ::wxEvtHandler*sipRes;

            PyErr_Clear();

            Py_BEGIN_ALLOW_THREADS
            sipRes = sipCpp->GetOwner();
            Py_END_ALLOW_THREADS

            if (PyErr_Occurred())
                return 0;

            return sipConvertFromType(sipRes, sipType_wxEvtHandler, SIP_NULLPTR);
        }
    }

    sipNoMethod(sipParseErr, sipName_Timer, sipName_GetOwner, SIP_NULLPTR);

    return SIP_NULLPTR;
}


PyDoc_STRVAR(doc_wxTimer_IsOneShot, "IsOneShot() -> bool\n"
"\n"
"Returns true if the timer is one shot, i.e. if it will stop after\n"
"firing the first notification automatically.");

extern "C" {static PyObject *meth_wxTimer_IsOneShot(PyObject *, PyObject *);}
static PyObject *meth_wxTimer_IsOneShot(PyObject *sipSelf, PyObject *sipArgs)
{
    PyObject *sipParseErr = SIP_NULLPTR;

    {
        const ::wxTimer *sipCpp;

        if (sipParseArgs(&sipParseErr, sipArgs, "B", &sipSelf, sipType_wxTimer, &sipCpp))
        {
            bool sipRes;

            PyErr_Clear();

            Py_BEGIN_ALLOW_THREADS
            sipRes = sipCpp->IsOneShot();
            Py_END_ALLOW_THREADS

            if (PyErr_Occurred())
                return 0;

            return PyBool_FromLong(sipRes);
        }
    }

    sipNoMethod(sipParseErr, sipName_Timer, sipName_IsOneShot, SIP_NULLPTR);

    return SIP_NULLPTR;
}


PyDoc_STRVAR(doc_wxTimer_IsRunning, "IsRunning() -> bool\n"
"\n"
"Returns true if the timer is running, false if it is stopped.");

extern "C" {static PyObject *meth_wxTimer_IsRunning(PyObject *, PyObject *);}
static PyObject *meth_wxTimer_IsRunning(PyObject *sipSelf, PyObject *sipArgs)
{
    PyObject *sipParseErr = SIP_NULLPTR;

    {
        const ::wxTimer *sipCpp;

        if (sipParseArgs(&sipParseErr, sipArgs, "B", &sipSelf, sipType_wxTimer, &sipCpp))
        {
            bool sipRes;

            PyErr_Clear();

            Py_BEGIN_ALLOW_THREADS
            sipRes = sipCpp->IsRunning();
            Py_END_ALLOW_THREADS

            if (PyErr_Occurred())
                return 0;

            return PyBool_FromLong(sipRes);
        }
    }

    sipNoMethod(sipParseErr, sipName_Timer, sipName_IsRunning, SIP_NULLPTR);

    return SIP_NULLPTR;
}


PyDoc_STRVAR(doc_wxTimer_Notify, "Notify()\n"
"\n"
"This member should be overridden by the user if the default\n"
"constructor was used and SetOwner() wasn't called.");

extern "C" {static PyObject *meth_wxTimer_Notify(PyObject *, PyObject *);}
static PyObject *meth_wxTimer_Notify(PyObject *sipSelf, PyObject *sipArgs)
{
    PyObject *sipParseErr = SIP_NULLPTR;
    bool sipSelfWasArg = (!sipSelf || sipIsDerivedClass((sipSimpleWrapper *)sipSelf));

    {
        ::wxTimer *sipCpp;

        if (sipParseArgs(&sipParseErr, sipArgs, "B", &sipSelf, sipType_wxTimer, &sipCpp))
        {
            PyErr_Clear();

            Py_BEGIN_ALLOW_THREADS
            (sipSelfWasArg ? sipCpp->::wxTimer::Notify() : sipCpp->Notify());
            Py_END_ALLOW_THREADS

            if (PyErr_Occurred())
                return 0;

            Py_INCREF(Py_None);
            return Py_None;
        }
    }

    sipNoMethod(sipParseErr, sipName_Timer, sipName_Notify, SIP_NULLPTR);

    return SIP_NULLPTR;
}


PyDoc_STRVAR(doc_wxTimer_SetOwner, "SetOwner(owner, id=-1)\n"
"\n"
"Associates the timer with the given owner object.");

extern "C" {static PyObject *meth_wxTimer_SetOwner(PyObject *, PyObject *, PyObject *);}
static PyObject *meth_wxTimer_SetOwner(PyObject *sipSelf, PyObject *sipArgs, PyObject *sipKwds)
{
    PyObject *sipParseErr = SIP_NULLPTR;

    {
        ::wxEvtHandler* owner;
        int id = -1;
        ::wxTimer *sipCpp;

        static const char *sipKwdList[] = {
            sipName_owner,
            sipName_id,
        };

        if (sipParseKwdArgs(&sipParseErr, sipArgs, sipKwds, sipKwdList, SIP_NULLPTR, "BJ8|i", &sipSelf, sipType_wxTimer, &sipCpp, sipType_wxEvtHandler, &owner, &id))
        {
            PyErr_Clear();

            Py_BEGIN_ALLOW_THREADS
            sipCpp->SetOwner(owner, id);
            Py_END_ALLOW_THREADS

            if (PyErr_Occurred())
                return 0;

            Py_INCREF(Py_None);
            return Py_None;
        }
    }

    sipNoMethod(sipParseErr, sipName_Timer, sipName_SetOwner, SIP_NULLPTR);

    return SIP_NULLPTR;
}


PyDoc_STRVAR(doc_wxTimer_Start, "Start(milliseconds=-1, oneShot=TIMER_CONTINUOUS) -> bool\n"
"\n"
"(Re)starts the timer.");

extern "C" {static PyObject *meth_wxTimer_Start(PyObject *, PyObject *, PyObject *);}
static PyObject *meth_wxTimer_Start(PyObject *sipSelf, PyObject *sipArgs, PyObject *sipKwds)
{
    PyObject *sipParseErr = SIP_NULLPTR;
    bool sipSelfWasArg = (!sipSelf || sipIsDerivedClass((sipSimpleWrapper *)sipSelf));

    {
        int milliseconds = -1;
        bool oneShot = wxTIMER_CONTINUOUS;
        ::wxTimer *sipCpp;

        static const char *sipKwdList[] = {
            sipName_milliseconds,
            sipName_oneShot,
        };

        if (sipParseKwdArgs(&sipParseErr, sipArgs, sipKwds, sipKwdList, SIP_NULLPTR, "B|ib", &sipSelf, sipType_wxTimer, &sipCpp, &milliseconds, &oneShot))
        {
            bool sipRes;

            PyErr_Clear();

            Py_BEGIN_ALLOW_THREADS
            sipRes = (sipSelfWasArg ? sipCpp->::wxTimer::Start(milliseconds, oneShot) : sipCpp->Start(milliseconds, oneShot));
            Py_END_ALLOW_THREADS

            if (PyErr_Occurred())
                return 0;

            return PyBool_FromLong(sipRes);
        }
    }

    sipNoMethod(sipParseErr, sipName_Timer, sipName_Start, SIP_NULLPTR);

    return SIP_NULLPTR;
}


PyDoc_STRVAR(doc_wxTimer_StartOnce, "StartOnce(milliseconds=-1) -> bool\n"
"\n"
"Starts the timer for a once-only notification.");

extern "C" {static PyObject *meth_wxTimer_StartOnce(PyObject *, PyObject *, PyObject *);}
static PyObject *meth_wxTimer_StartOnce(PyObject *sipSelf, PyObject *sipArgs, PyObject *sipKwds)
{
    PyObject *sipParseErr = SIP_NULLPTR;

    {
        int milliseconds = -1;
        ::wxTimer *sipCpp;

        static const char *sipKwdList[] = {
            sipName_milliseconds,
        };

        if (sipParseKwdArgs(&sipParseErr, sipArgs, sipKwds, sipKwdList, SIP_NULLPTR, "B|i", &sipSelf, sipType_wxTimer, &sipCpp, &milliseconds))
        {
            bool sipRes;

            PyErr_Clear();

            Py_BEGIN_ALLOW_THREADS
            sipRes = sipCpp->StartOnce(milliseconds);
            Py_END_ALLOW_THREADS

            if (PyErr_Occurred())
                return 0;

            return PyBool_FromLong(sipRes);
        }
    }

    sipNoMethod(sipParseErr, sipName_Timer, sipName_StartOnce, SIP_NULLPTR);

    return SIP_NULLPTR;
}


PyDoc_STRVAR(doc_wxTimer_Stop, "Stop()\n"
"\n"
"Stops the timer.");

extern "C" {static PyObject *meth_wxTimer_Stop(PyObject *, PyObject *);}
static PyObject *meth_wxTimer_Stop(PyObject *sipSelf, PyObject *sipArgs)
{
    PyObject *sipParseErr = SIP_NULLPTR;
    bool sipSelfWasArg = (!sipSelf || sipIsDerivedClass((sipSimpleWrapper *)sipSelf));

    {
        ::wxTimer *sipCpp;

        if (sipParseArgs(&sipParseErr, sipArgs, "B", &sipSelf, sipType_wxTimer, &sipCpp))
        {
            PyErr_Clear();

            Py_BEGIN_ALLOW_THREADS
            (sipSelfWasArg ? sipCpp->::wxTimer::Stop() : sipCpp->Stop());
            Py_END_ALLOW_THREADS

            if (PyErr_Occurred())
                return 0;

            Py_INCREF(Py_None);
            return Py_None;
        }
    }

    sipNoMethod(sipParseErr, sipName_Timer, sipName_Stop, SIP_NULLPTR);

    return SIP_NULLPTR;
}


/* Cast a pointer to a type somewhere in its inheritance hierarchy. */
extern "C" {static void *cast_wxTimer(void *, const sipTypeDef *);}
static void *cast_wxTimer(void *sipCppV, const sipTypeDef *targetType)
{
    ::wxTimer *sipCpp = reinterpret_cast< ::wxTimer *>(sipCppV);

    if (targetType == sipType_wxTimer)
        return sipCppV;

    sipCppV = ((const sipClassTypeDef *)sipType_wxEvtHandler)->ctd_cast(static_cast< ::wxEvtHandler *>(sipCpp), targetType);
    if (sipCppV)
        return sipCppV;

    return SIP_NULLPTR;
}


/* Call the instance's destructor. */
extern "C" {static void release_wxTimer(void *, int);}
static void release_wxTimer(void *sipCppV, int sipState)
{
    Py_BEGIN_ALLOW_THREADS

    if (sipState & SIP_DERIVED_CLASS)
        delete reinterpret_cast<sipwxTimer *>(sipCppV);
    else
        delete reinterpret_cast< ::wxTimer *>(sipCppV);

    Py_END_ALLOW_THREADS
}


extern "C" {static void *array_wxTimer(Py_ssize_t);}
static void *array_wxTimer(Py_ssize_t sipNrElem)
{
    return new ::wxTimer[sipNrElem];
}


extern "C" {static void array_delete_wxTimer(void *);}
static void array_delete_wxTimer(void *sipCpp)
{
    delete[] reinterpret_cast< ::wxTimer *>(sipCpp);
}


extern "C" {static void dealloc_wxTimer(sipSimpleWrapper *);}
static void dealloc_wxTimer(sipSimpleWrapper *sipSelf)
{
    if (sipIsDerivedClass(sipSelf))
        reinterpret_cast<sipwxTimer *>(sipGetAddress(sipSelf))->sipPySelf = SIP_NULLPTR;

    if (sipIsOwnedByPython(sipSelf))
    {
        release_wxTimer(sipGetAddress(sipSelf), sipIsDerivedClass(sipSelf));
    }
}


extern "C" {static void *init_type_wxTimer(sipSimpleWrapper *, PyObject *, PyObject *, PyObject **, PyObject **, PyObject **);}
static void *init_type_wxTimer(sipSimpleWrapper *sipSelf, PyObject *sipArgs, PyObject *sipKwds, PyObject **sipUnused, PyObject **, PyObject **sipParseErr)
{
    sipwxTimer *sipCpp = SIP_NULLPTR;

    {
        if (sipParseKwdArgs(sipParseErr, sipArgs, sipKwds, SIP_NULLPTR, sipUnused, ""))
        {

        if (!wxPyCheckForApp()) return NULL;

            PyErr_Clear();

            Py_BEGIN_ALLOW_THREADS
            sipCpp = new sipwxTimer();
            Py_END_ALLOW_THREADS

            if (PyErr_Occurred())
            {
                delete sipCpp;
                return SIP_NULLPTR;
            }

            sipCpp->sipPySelf = sipSelf;

            return sipCpp;
        }
    }

    {
        ::wxEvtHandler* owner;
        int id = -1;

        static const char *sipKwdList[] = {
            sipName_owner,
            sipName_id,
        };

        if (sipParseKwdArgs(sipParseErr, sipArgs, sipKwds, sipKwdList, sipUnused, "J8|i", sipType_wxEvtHandler, &owner, &id))
        {

        if (!wxPyCheckForApp()) return NULL;

            PyErr_Clear();

            Py_BEGIN_ALLOW_THREADS
            sipCpp = new sipwxTimer(owner, id);
            Py_END_ALLOW_THREADS

            if (PyErr_Occurred())
            {
                delete sipCpp;
                return SIP_NULLPTR;
            }

            sipCpp->sipPySelf = sipSelf;

            return sipCpp;
        }
    }

    return SIP_NULLPTR;
}


/* Define this type's super-types. */
static sipEncodedTypeDef supers_wxTimer[] = {{155, 255, 1}};


static PyMethodDef methods_wxTimer[] = {
    {sipName_GetId, meth_wxTimer_GetId, METH_VARARGS, doc_wxTimer_GetId},
    {sipName_GetInterval, meth_wxTimer_GetInterval, METH_VARARGS, doc_wxTimer_GetInterval},
    {sipName_GetOwner, meth_wxTimer_GetOwner, METH_VARARGS, doc_wxTimer_GetOwner},
    {sipName_IsOneShot, meth_wxTimer_IsOneShot, METH_VARARGS, doc_wxTimer_IsOneShot},
    {sipName_IsRunning, meth_wxTimer_IsRunning, METH_VARARGS, doc_wxTimer_IsRunning},
    {sipName_Notify, meth_wxTimer_Notify, METH_VARARGS, doc_wxTimer_Notify},
    {sipName_SetOwner, SIP_MLMETH_CAST(meth_wxTimer_SetOwner), METH_VARARGS|METH_KEYWORDS, doc_wxTimer_SetOwner},
    {sipName_Start, SIP_MLMETH_CAST(meth_wxTimer_Start), METH_VARARGS|METH_KEYWORDS, doc_wxTimer_Start},
    {sipName_StartOnce, SIP_MLMETH_CAST(meth_wxTimer_StartOnce), METH_VARARGS|METH_KEYWORDS, doc_wxTimer_StartOnce},
    {sipName_Stop, meth_wxTimer_Stop, METH_VARARGS, doc_wxTimer_Stop},
    {sipName_TryAfter, SIP_MLMETH_CAST(meth_wxTimer_TryAfter), METH_VARARGS|METH_KEYWORDS, SIP_NULLPTR},
    {sipName_TryBefore, SIP_MLMETH_CAST(meth_wxTimer_TryBefore), METH_VARARGS|METH_KEYWORDS, SIP_NULLPTR}
};

sipVariableDef variables_wxTimer[] = {
    {PropertyVariable, sipName_Owner, &methods_wxTimer[2], &methods_wxTimer[6], SIP_NULLPTR, SIP_NULLPTR},
    {PropertyVariable, sipName_Interval, &methods_wxTimer[1], SIP_NULLPTR, SIP_NULLPTR, SIP_NULLPTR},
    {PropertyVariable, sipName_Id, &methods_wxTimer[0], SIP_NULLPTR, SIP_NULLPTR, SIP_NULLPTR},
};

PyDoc_STRVAR(doc_wxTimer, "Timer()\n"
"Timer(owner, id=-1)\n"
"\n"
"The wxTimer class allows you to execute code at specified intervals.");


sipClassTypeDef sipTypeDef__core_wxTimer = {
    {
        -1,
        SIP_NULLPTR,
        SIP_NULLPTR,
        SIP_TYPE_SCC|SIP_TYPE_CLASS,
        sipNameNr_wxTimer,
        SIP_NULLPTR,
        SIP_NULLPTR,
    },
    {
        sipNameNr_Timer,
        {0, 0, 1},
        12, methods_wxTimer,
        0, SIP_NULLPTR,
        3, variables_wxTimer,
        {SIP_NULLPTR, SIP_NULLPTR, SIP_NULLPTR, SIP_NULLPTR, SIP_NULLPTR, SIP_NULLPTR, SIP_NULLPTR, SIP_NULLPTR, SIP_NULLPTR, SIP_NULLPTR},
    },
    doc_wxTimer,
    -1,
    -1,
    supers_wxTimer,
    SIP_NULLPTR,
    init_type_wxTimer,
    SIP_NULLPTR,
    SIP_NULLPTR,
    SIP_NULLPTR,
    SIP_NULLPTR,
    dealloc_wxTimer,
    SIP_NULLPTR,
    array_wxTimer,
    SIP_NULLPTR,
    release_wxTimer,
    cast_wxTimer,
    SIP_NULLPTR,
    SIP_NULLPTR,
    SIP_NULLPTR,
    SIP_NULLPTR,
    SIP_NULLPTR,
    SIP_NULLPTR,
    array_delete_wxTimer,
    sizeof (::wxTimer),
};
