/*
 * Interface wrapper code.
 *
 * Generated by SIP 6.15.1
 */

#include "sipAPI_core.h"

        #include <wx/dirctrl.h>

        #include <wx/dirctrl.h>
        #include <wx/gdicmn.h>
        #include <wx/gdicmn.h>
        #include <wx/window.h>
        #include <wx/event.h>
        #include <wx/validate.h>
        #include <wx/window.h>
        #include <wx/dc.h>
        #include <wx/event.h>
        #include <wx/event.h>
    #include <wx/setup.h>
    #include "wxpy_api.h"
        #include <wx/event.h>
        #include <wx/cursor.h>
        #include <wx/caret.h>
        #include <wx/layout.h>
        #include <wx/sizer.h>
        #include <wx/dnd.h>
        #include <wx/access.h>
        #include <wx/accel.h>
        #include <wx/menu.h>
        #include <wx/tooltip.h>
        #include <wx/event.h>
        #include <wx/gdicmn.h>
        #include <wx/event.h>
        #include <wx/event.h>
        #include <wx/palette.h>
        #include <wx/colour.h>
        #include <wx/font.h>
        #include <wx/region.h>
        
        
        #include <wx/eventfilter.h>
        #include <wx/object.h>
        #include <wx/object.h>
        #include <wx/object.h>


class sipwxDirFilterListCtrl : public ::wxDirFilterListCtrl
{
public:
    sipwxDirFilterListCtrl();
    sipwxDirFilterListCtrl(::wxGenericDirCtrl*, ::wxWindowID, const ::wxPoint&, const ::wxSize&, long);
    virtual ~sipwxDirFilterListCtrl();

    /*
     * There is a public method for every protected method visible from
     * this class.
     */
    void sipProtect_SendDestroyEvent();
    bool sipProtectVirt_ProcessEvent(bool, ::wxEvent&);
    void sipProtectVirt_DoEnable(bool, bool);
    void sipProtectVirt_DoGetPosition(bool, int*, int*) const;
    void sipProtectVirt_DoGetSize(bool, int*, int*) const;
    void sipProtectVirt_DoGetClientSize(bool, int*, int*) const;
    ::wxSize sipProtectVirt_DoGetBestSize(bool) const;
    ::wxSize sipProtectVirt_DoGetBestClientSize(bool) const;
    void sipProtectVirt_DoSetSize(bool, int, int, int, int, int);
    void sipProtectVirt_DoSetClientSize(bool, int, int);
    void sipProtectVirt_DoSetSizeHints(bool, int, int, int, int, int, int);
    ::wxSize sipProtectVirt_DoGetBorderSize(bool) const;
    void sipProtectVirt_DoMoveWindow(bool, int, int, int, int);
    void sipProtectVirt_DoSetWindowVariant(bool, ::wxWindowVariant);
    ::wxBorder sipProtectVirt_GetDefaultBorder(bool) const;
    ::wxBorder sipProtectVirt_GetDefaultBorderForControl(bool) const;
    void sipProtectVirt_DoFreeze(bool);
    void sipProtectVirt_DoThaw(bool);
    bool sipProtectVirt_HasTransparentBackground(bool);
    bool sipProtectVirt_TryBefore(bool, ::wxEvent&);
    bool sipProtectVirt_TryAfter(bool, ::wxEvent&);

    /*
     * There is a protected method for every virtual method visible from
     * this class.
     */
protected:
    void RemoveChild(::wxWindowBase*) SIP_OVERRIDE;
    void AddChild(::wxWindowBase*) SIP_OVERRIDE;
    bool ProcessEvent(::wxEvent&) SIP_OVERRIDE;
    bool TryBefore(::wxEvent&) SIP_OVERRIDE;
    bool TryAfter(::wxEvent&) SIP_OVERRIDE;
    bool AcceptsFocus() const SIP_OVERRIDE;
    bool AcceptsFocusFromKeyboard() const SIP_OVERRIDE;
    bool AcceptsFocusRecursively() const SIP_OVERRIDE;
    void SetCanFocus(bool) SIP_OVERRIDE;
    void EnableVisibleFocus(bool) SIP_OVERRIDE;
    bool InformFirstDirection(int, int, int) SIP_OVERRIDE;
    ::wxPoint GetClientAreaOrigin() const SIP_OVERRIDE;
    bool HasTransparentBackground() SIP_OVERRIDE;
    bool ShouldInheritColours() const SIP_OVERRIDE;
    ::wxValidator* GetValidator() SIP_OVERRIDE;
    void SetValidator(const ::wxValidator&) SIP_OVERRIDE;
    bool TransferDataFromWindow() SIP_OVERRIDE;
    bool TransferDataToWindow() SIP_OVERRIDE;
    bool Validate() SIP_OVERRIDE;
    bool Destroy() SIP_OVERRIDE;
    void InheritAttributes() SIP_OVERRIDE;
    void InitDialog() SIP_OVERRIDE;
    void OnInternalIdle() SIP_OVERRIDE;
    ::wxWindow* GetMainWindowOfCompositeControl() SIP_OVERRIDE;
    void DoEnable(bool) SIP_OVERRIDE;
    void DoGetPosition(int*, int*) const SIP_OVERRIDE;
    void DoGetSize(int*, int*) const SIP_OVERRIDE;
    void DoGetClientSize(int*, int*) const SIP_OVERRIDE;
    void DoSetSize(int, int, int, int, int) SIP_OVERRIDE;
    void DoSetClientSize(int, int) SIP_OVERRIDE;
    void DoSetSizeHints(int, int, int, int, int, int) SIP_OVERRIDE;
    ::wxSize DoGetBorderSize() const SIP_OVERRIDE;
    void DoMoveWindow(int, int, int, int) SIP_OVERRIDE;
    void DoSetWindowVariant(::wxWindowVariant) SIP_OVERRIDE;
    ::wxBorder GetDefaultBorder() const SIP_OVERRIDE;
    ::wxBorder GetDefaultBorderForControl() const SIP_OVERRIDE;
    void DoFreeze() SIP_OVERRIDE;
    void DoThaw() SIP_OVERRIDE;
    ::wxSize DoGetBestSize() const SIP_OVERRIDE;
    ::wxSize DoGetBestClientSize() const SIP_OVERRIDE;
    uint GetCount() const SIP_OVERRIDE;
    ::wxString GetString(uint) const SIP_OVERRIDE;
    void SetString(uint, const ::wxString&) SIP_OVERRIDE;
    int FindString(const ::wxString&, bool) const SIP_OVERRIDE;
    void SetSelection(int) SIP_OVERRIDE;
    int GetSelection() const SIP_OVERRIDE;
    ::wxString GetStringSelection() const SIP_OVERRIDE;

public:
    sipSimpleWrapper *sipPySelf;

private:
    sipwxDirFilterListCtrl(const sipwxDirFilterListCtrl &);
    sipwxDirFilterListCtrl &operator = (const sipwxDirFilterListCtrl &);

    char sipPyMethods[47];
};

sipwxDirFilterListCtrl::sipwxDirFilterListCtrl(): ::wxDirFilterListCtrl(), sipPySelf(SIP_NULLPTR)
{
    memset(sipPyMethods, 0, sizeof (sipPyMethods));
}

sipwxDirFilterListCtrl::sipwxDirFilterListCtrl(::wxGenericDirCtrl*parent, ::wxWindowID id, const ::wxPoint& pos, const ::wxSize& size, long style): ::wxDirFilterListCtrl(parent, id, pos, size, style), sipPySelf(SIP_NULLPTR)
{
    memset(sipPyMethods, 0, sizeof (sipPyMethods));
}

sipwxDirFilterListCtrl::~sipwxDirFilterListCtrl()
{
    sipInstanceDestroyedEx(&sipPySelf);
}

void sipwxDirFilterListCtrl::RemoveChild(::wxWindowBase*child)
{
    sip_gilstate_t sipGILState;
    PyObject *sipMeth;

    sipMeth = sipIsPyMethod(&sipGILState, &sipPyMethods[0], &sipPySelf, SIP_NULLPTR, sipName_RemoveChild);

    if (!sipMeth)
    {
        ::wxDirFilterListCtrl::RemoveChild(child);
        return;
    }

    extern void sipVH__core_121(sip_gilstate_t, sipVirtErrorHandlerFunc, sipSimpleWrapper *, PyObject *, ::wxWindowBase*);

    sipVH__core_121(sipGILState, 0, sipPySelf, sipMeth, child);
}

void sipwxDirFilterListCtrl::AddChild(::wxWindowBase*child)
{
    sip_gilstate_t sipGILState;
    PyObject *sipMeth;

    sipMeth = sipIsPyMethod(&sipGILState, &sipPyMethods[1], &sipPySelf, SIP_NULLPTR, sipName_AddChild);

    if (!sipMeth)
    {
        ::wxDirFilterListCtrl::AddChild(child);
        return;
    }

    extern void sipVH__core_121(sip_gilstate_t, sipVirtErrorHandlerFunc, sipSimpleWrapper *, PyObject *, ::wxWindowBase*);

    sipVH__core_121(sipGILState, 0, sipPySelf, sipMeth, child);
}

bool sipwxDirFilterListCtrl::ProcessEvent(::wxEvent& event)
{
    sip_gilstate_t sipGILState;
    PyObject *sipMeth;

    sipMeth = sipIsPyMethod(&sipGILState, &sipPyMethods[2], &sipPySelf, SIP_NULLPTR, sipName_ProcessEvent);

    if (!sipMeth)
        return ::wxDirFilterListCtrl::ProcessEvent(event);

    extern bool sipVH__core_98(sip_gilstate_t, sipVirtErrorHandlerFunc, sipSimpleWrapper *, PyObject *, ::wxEvent&);

    return sipVH__core_98(sipGILState, 0, sipPySelf, sipMeth, event);
}

bool sipwxDirFilterListCtrl::TryBefore(::wxEvent& event)
{
    sip_gilstate_t sipGILState;
    PyObject *sipMeth;

    sipMeth = sipIsPyMethod(&sipGILState, &sipPyMethods[3], &sipPySelf, SIP_NULLPTR, sipName_TryBefore);

    if (!sipMeth)
        return ::wxDirFilterListCtrl::TryBefore(event);

    extern bool sipVH__core_98(sip_gilstate_t, sipVirtErrorHandlerFunc, sipSimpleWrapper *, PyObject *, ::wxEvent&);

    return sipVH__core_98(sipGILState, 0, sipPySelf, sipMeth, event);
}

bool sipwxDirFilterListCtrl::TryAfter(::wxEvent& event)
{
    sip_gilstate_t sipGILState;
    PyObject *sipMeth;

    sipMeth = sipIsPyMethod(&sipGILState, &sipPyMethods[4], &sipPySelf, SIP_NULLPTR, sipName_TryAfter);

    if (!sipMeth)
        return ::wxDirFilterListCtrl::TryAfter(event);

    extern bool sipVH__core_98(sip_gilstate_t, sipVirtErrorHandlerFunc, sipSimpleWrapper *, PyObject *, ::wxEvent&);

    return sipVH__core_98(sipGILState, 0, sipPySelf, sipMeth, event);
}

bool sipwxDirFilterListCtrl::AcceptsFocus() const
{
    sip_gilstate_t sipGILState;
    PyObject *sipMeth;

    sipMeth = sipIsPyMethod(&sipGILState, const_cast<char *>(&sipPyMethods[5]), const_cast<sipSimpleWrapper **>(&sipPySelf), SIP_NULLPTR, sipName_AcceptsFocus);

    if (!sipMeth)
        return ::wxDirFilterListCtrl::AcceptsFocus();

    extern bool sipVH__core_6(sip_gilstate_t, sipVirtErrorHandlerFunc, sipSimpleWrapper *, PyObject *);

    return sipVH__core_6(sipGILState, 0, sipPySelf, sipMeth);
}

bool sipwxDirFilterListCtrl::AcceptsFocusFromKeyboard() const
{
    sip_gilstate_t sipGILState;
    PyObject *sipMeth;

    sipMeth = sipIsPyMethod(&sipGILState, const_cast<char *>(&sipPyMethods[6]), const_cast<sipSimpleWrapper **>(&sipPySelf), SIP_NULLPTR, sipName_AcceptsFocusFromKeyboard);

    if (!sipMeth)
        return ::wxDirFilterListCtrl::AcceptsFocusFromKeyboard();

    extern bool sipVH__core_6(sip_gilstate_t, sipVirtErrorHandlerFunc, sipSimpleWrapper *, PyObject *);

    return sipVH__core_6(sipGILState, 0, sipPySelf, sipMeth);
}

bool sipwxDirFilterListCtrl::AcceptsFocusRecursively() const
{
    sip_gilstate_t sipGILState;
    PyObject *sipMeth;

    sipMeth = sipIsPyMethod(&sipGILState, const_cast<char *>(&sipPyMethods[7]), const_cast<sipSimpleWrapper **>(&sipPySelf), SIP_NULLPTR, sipName_AcceptsFocusRecursively);

    if (!sipMeth)
        return ::wxDirFilterListCtrl::AcceptsFocusRecursively();

    extern bool sipVH__core_6(sip_gilstate_t, sipVirtErrorHandlerFunc, sipSimpleWrapper *, PyObject *);

    return sipVH__core_6(sipGILState, 0, sipPySelf, sipMeth);
}

void sipwxDirFilterListCtrl::SetCanFocus(bool canFocus)
{
    sip_gilstate_t sipGILState;
    PyObject *sipMeth;

    sipMeth = sipIsPyMethod(&sipGILState, &sipPyMethods[8], &sipPySelf, SIP_NULLPTR, sipName_SetCanFocus);

    if (!sipMeth)
    {
        ::wxDirFilterListCtrl::SetCanFocus(canFocus);
        return;
    }

    extern void sipVH__core_92(sip_gilstate_t, sipVirtErrorHandlerFunc, sipSimpleWrapper *, PyObject *, bool);

    sipVH__core_92(sipGILState, 0, sipPySelf, sipMeth, canFocus);
}

void sipwxDirFilterListCtrl::EnableVisibleFocus(bool enabled)
{
    sip_gilstate_t sipGILState;
    PyObject *sipMeth;

    sipMeth = sipIsPyMethod(&sipGILState, &sipPyMethods[9], &sipPySelf, SIP_NULLPTR, sipName_EnableVisibleFocus);

    if (!sipMeth)
    {
        ::wxDirFilterListCtrl::EnableVisibleFocus(enabled);
        return;
    }

    extern void sipVH__core_92(sip_gilstate_t, sipVirtErrorHandlerFunc, sipSimpleWrapper *, PyObject *, bool);

    sipVH__core_92(sipGILState, 0, sipPySelf, sipMeth, enabled);
}

bool sipwxDirFilterListCtrl::InformFirstDirection(int direction, int size, int availableOtherDir)
{
    sip_gilstate_t sipGILState;
    PyObject *sipMeth;

    sipMeth = sipIsPyMethod(&sipGILState, &sipPyMethods[10], &sipPySelf, SIP_NULLPTR, sipName_InformFirstDirection);

    if (!sipMeth)
        return ::wxDirFilterListCtrl::InformFirstDirection(direction, size, availableOtherDir);

    extern bool sipVH__core_122(sip_gilstate_t, sipVirtErrorHandlerFunc, sipSimpleWrapper *, PyObject *, int, int, int);

    return sipVH__core_122(sipGILState, 0, sipPySelf, sipMeth, direction, size, availableOtherDir);
}

::wxPoint sipwxDirFilterListCtrl::GetClientAreaOrigin() const
{
    sip_gilstate_t sipGILState;
    PyObject *sipMeth;

    sipMeth = sipIsPyMethod(&sipGILState, const_cast<char *>(&sipPyMethods[11]), const_cast<sipSimpleWrapper **>(&sipPySelf), SIP_NULLPTR, sipName_GetClientAreaOrigin);

    if (!sipMeth)
        return ::wxDirFilterListCtrl::GetClientAreaOrigin();

    extern ::wxPoint sipVH__core_123(sip_gilstate_t, sipVirtErrorHandlerFunc, sipSimpleWrapper *, PyObject *);

    return sipVH__core_123(sipGILState, 0, sipPySelf, sipMeth);
}

bool sipwxDirFilterListCtrl::HasTransparentBackground()
{
    sip_gilstate_t sipGILState;
    PyObject *sipMeth;

    sipMeth = sipIsPyMethod(&sipGILState, &sipPyMethods[12], &sipPySelf, SIP_NULLPTR, sipName_HasTransparentBackground);

    if (!sipMeth)
        return ::wxDirFilterListCtrl::HasTransparentBackground();

    extern bool sipVH__core_6(sip_gilstate_t, sipVirtErrorHandlerFunc, sipSimpleWrapper *, PyObject *);

    return sipVH__core_6(sipGILState, 0, sipPySelf, sipMeth);
}

bool sipwxDirFilterListCtrl::ShouldInheritColours() const
{
    sip_gilstate_t sipGILState;
    PyObject *sipMeth;

    sipMeth = sipIsPyMethod(&sipGILState, const_cast<char *>(&sipPyMethods[13]), const_cast<sipSimpleWrapper **>(&sipPySelf), SIP_NULLPTR, sipName_ShouldInheritColours);

    if (!sipMeth)
        return ::wxDirFilterListCtrl::ShouldInheritColours();

    extern bool sipVH__core_6(sip_gilstate_t, sipVirtErrorHandlerFunc, sipSimpleWrapper *, PyObject *);

    return sipVH__core_6(sipGILState, 0, sipPySelf, sipMeth);
}

::wxValidator* sipwxDirFilterListCtrl::GetValidator()
{
    sip_gilstate_t sipGILState;
    PyObject *sipMeth;

    sipMeth = sipIsPyMethod(&sipGILState, &sipPyMethods[14], &sipPySelf, SIP_NULLPTR, sipName_GetValidator);

    if (!sipMeth)
        return ::wxDirFilterListCtrl::GetValidator();

    extern ::wxValidator* sipVH__core_124(sip_gilstate_t, sipVirtErrorHandlerFunc, sipSimpleWrapper *, PyObject *);

    return sipVH__core_124(sipGILState, 0, sipPySelf, sipMeth);
}

void sipwxDirFilterListCtrl::SetValidator(const ::wxValidator& validator)
{
    sip_gilstate_t sipGILState;
    PyObject *sipMeth;

    sipMeth = sipIsPyMethod(&sipGILState, &sipPyMethods[15], &sipPySelf, SIP_NULLPTR, sipName_SetValidator);

    if (!sipMeth)
    {
        ::wxDirFilterListCtrl::SetValidator(validator);
        return;
    }

    extern void sipVH__core_125(sip_gilstate_t, sipVirtErrorHandlerFunc, sipSimpleWrapper *, PyObject *, const ::wxValidator&);

    sipVH__core_125(sipGILState, 0, sipPySelf, sipMeth, validator);
}

bool sipwxDirFilterListCtrl::TransferDataFromWindow()
{
    sip_gilstate_t sipGILState;
    PyObject *sipMeth;

    sipMeth = sipIsPyMethod(&sipGILState, &sipPyMethods[16], &sipPySelf, SIP_NULLPTR, sipName_TransferDataFromWindow);

    if (!sipMeth)
        return ::wxDirFilterListCtrl::TransferDataFromWindow();

    extern bool sipVH__core_6(sip_gilstate_t, sipVirtErrorHandlerFunc, sipSimpleWrapper *, PyObject *);

    return sipVH__core_6(sipGILState, 0, sipPySelf, sipMeth);
}

bool sipwxDirFilterListCtrl::TransferDataToWindow()
{
    sip_gilstate_t sipGILState;
    PyObject *sipMeth;

    sipMeth = sipIsPyMethod(&sipGILState, &sipPyMethods[17], &sipPySelf, SIP_NULLPTR, sipName_TransferDataToWindow);

    if (!sipMeth)
        return ::wxDirFilterListCtrl::TransferDataToWindow();

    extern bool sipVH__core_6(sip_gilstate_t, sipVirtErrorHandlerFunc, sipSimpleWrapper *, PyObject *);

    return sipVH__core_6(sipGILState, 0, sipPySelf, sipMeth);
}

bool sipwxDirFilterListCtrl::Validate()
{
    sip_gilstate_t sipGILState;
    PyObject *sipMeth;

    sipMeth = sipIsPyMethod(&sipGILState, &sipPyMethods[18], &sipPySelf, SIP_NULLPTR, sipName_Validate);

    if (!sipMeth)
        return ::wxDirFilterListCtrl::Validate();

    extern bool sipVH__core_6(sip_gilstate_t, sipVirtErrorHandlerFunc, sipSimpleWrapper *, PyObject *);

    return sipVH__core_6(sipGILState, 0, sipPySelf, sipMeth);
}

bool sipwxDirFilterListCtrl::Destroy()
{
    sip_gilstate_t sipGILState;
    PyObject *sipMeth;

    sipMeth = sipIsPyMethod(&sipGILState, &sipPyMethods[19], &sipPySelf, SIP_NULLPTR, sipName_Destroy);

    if (!sipMeth)
        return ::wxDirFilterListCtrl::Destroy();

    extern bool sipVH__core_6(sip_gilstate_t, sipVirtErrorHandlerFunc, sipSimpleWrapper *, PyObject *);

    return sipVH__core_6(sipGILState, 0, sipPySelf, sipMeth);
}

void sipwxDirFilterListCtrl::InheritAttributes()
{
    sip_gilstate_t sipGILState;
    PyObject *sipMeth;

    sipMeth = sipIsPyMethod(&sipGILState, &sipPyMethods[20], &sipPySelf, SIP_NULLPTR, sipName_InheritAttributes);

    if (!sipMeth)
    {
        ::wxDirFilterListCtrl::InheritAttributes();
        return;
    }

    extern void sipVH__core_53(sip_gilstate_t, sipVirtErrorHandlerFunc, sipSimpleWrapper *, PyObject *);

    sipVH__core_53(sipGILState, 0, sipPySelf, sipMeth);
}

void sipwxDirFilterListCtrl::InitDialog()
{
    sip_gilstate_t sipGILState;
    PyObject *sipMeth;

    sipMeth = sipIsPyMethod(&sipGILState, &sipPyMethods[21], &sipPySelf, SIP_NULLPTR, sipName_InitDialog);

    if (!sipMeth)
    {
        ::wxDirFilterListCtrl::InitDialog();
        return;
    }

    extern void sipVH__core_53(sip_gilstate_t, sipVirtErrorHandlerFunc, sipSimpleWrapper *, PyObject *);

    sipVH__core_53(sipGILState, 0, sipPySelf, sipMeth);
}

void sipwxDirFilterListCtrl::OnInternalIdle()
{
    sip_gilstate_t sipGILState;
    PyObject *sipMeth;

    sipMeth = sipIsPyMethod(&sipGILState, &sipPyMethods[22], &sipPySelf, SIP_NULLPTR, sipName_OnInternalIdle);

    if (!sipMeth)
    {
        ::wxDirFilterListCtrl::OnInternalIdle();
        return;
    }

    extern void sipVH__core_53(sip_gilstate_t, sipVirtErrorHandlerFunc, sipSimpleWrapper *, PyObject *);

    sipVH__core_53(sipGILState, 0, sipPySelf, sipMeth);
}

::wxWindow* sipwxDirFilterListCtrl::GetMainWindowOfCompositeControl()
{
    sip_gilstate_t sipGILState;
    PyObject *sipMeth;

    sipMeth = sipIsPyMethod(&sipGILState, &sipPyMethods[23], &sipPySelf, SIP_NULLPTR, sipName_GetMainWindowOfCompositeControl);

    if (!sipMeth)
        return ::wxDirFilterListCtrl::GetMainWindowOfCompositeControl();

    extern ::wxWindow* sipVH__core_126(sip_gilstate_t, sipVirtErrorHandlerFunc, sipSimpleWrapper *, PyObject *);

    return sipVH__core_126(sipGILState, 0, sipPySelf, sipMeth);
}

void sipwxDirFilterListCtrl::DoEnable(bool enable)
{
    sip_gilstate_t sipGILState;
    PyObject *sipMeth;

    sipMeth = sipIsPyMethod(&sipGILState, &sipPyMethods[24], &sipPySelf, SIP_NULLPTR, sipName_DoEnable);

    if (!sipMeth)
    {
        ::wxDirFilterListCtrl::DoEnable(enable);
        return;
    }

    extern void sipVH__core_92(sip_gilstate_t, sipVirtErrorHandlerFunc, sipSimpleWrapper *, PyObject *, bool);

    sipVH__core_92(sipGILState, 0, sipPySelf, sipMeth, enable);
}

void sipwxDirFilterListCtrl::DoGetPosition(int*x, int*y) const
{
    sip_gilstate_t sipGILState;
    PyObject *sipMeth;

    sipMeth = sipIsPyMethod(&sipGILState, const_cast<char *>(&sipPyMethods[25]), const_cast<sipSimpleWrapper **>(&sipPySelf), SIP_NULLPTR, sipName_DoGetPosition);

    if (!sipMeth)
    {
        ::wxDirFilterListCtrl::DoGetPosition(x, y);
        return;
    }

    extern void sipVH__core_127(sip_gilstate_t, sipVirtErrorHandlerFunc, sipSimpleWrapper *, PyObject *, int*, int*);

    sipVH__core_127(sipGILState, 0, sipPySelf, sipMeth, x, y);
}

void sipwxDirFilterListCtrl::DoGetSize(int*width, int*height) const
{
    sip_gilstate_t sipGILState;
    PyObject *sipMeth;

    sipMeth = sipIsPyMethod(&sipGILState, const_cast<char *>(&sipPyMethods[26]), const_cast<sipSimpleWrapper **>(&sipPySelf), SIP_NULLPTR, sipName_DoGetSize);

    if (!sipMeth)
    {
        ::wxDirFilterListCtrl::DoGetSize(width, height);
        return;
    }

    extern void sipVH__core_127(sip_gilstate_t, sipVirtErrorHandlerFunc, sipSimpleWrapper *, PyObject *, int*, int*);

    sipVH__core_127(sipGILState, 0, sipPySelf, sipMeth, width, height);
}

void sipwxDirFilterListCtrl::DoGetClientSize(int*width, int*height) const
{
    sip_gilstate_t sipGILState;
    PyObject *sipMeth;

    sipMeth = sipIsPyMethod(&sipGILState, const_cast<char *>(&sipPyMethods[27]), const_cast<sipSimpleWrapper **>(&sipPySelf), SIP_NULLPTR, sipName_DoGetClientSize);

    if (!sipMeth)
    {
        ::wxDirFilterListCtrl::DoGetClientSize(width, height);
        return;
    }

    extern void sipVH__core_127(sip_gilstate_t, sipVirtErrorHandlerFunc, sipSimpleWrapper *, PyObject *, int*, int*);

    sipVH__core_127(sipGILState, 0, sipPySelf, sipMeth, width, height);
}

void sipwxDirFilterListCtrl::DoSetSize(int x, int y, int width, int height, int sizeFlags)
{
    sip_gilstate_t sipGILState;
    PyObject *sipMeth;

    sipMeth = sipIsPyMethod(&sipGILState, &sipPyMethods[28], &sipPySelf, SIP_NULLPTR, sipName_DoSetSize);

    if (!sipMeth)
    {
        ::wxDirFilterListCtrl::DoSetSize(x, y, width, height, sizeFlags);
        return;
    }

    extern void sipVH__core_128(sip_gilstate_t, sipVirtErrorHandlerFunc, sipSimpleWrapper *, PyObject *, int, int, int, int, int);

    sipVH__core_128(sipGILState, 0, sipPySelf, sipMeth, x, y, width, height, sizeFlags);
}

void sipwxDirFilterListCtrl::DoSetClientSize(int width, int height)
{
    sip_gilstate_t sipGILState;
    PyObject *sipMeth;

    sipMeth = sipIsPyMethod(&sipGILState, &sipPyMethods[29], &sipPySelf, SIP_NULLPTR, sipName_DoSetClientSize);

    if (!sipMeth)
    {
        ::wxDirFilterListCtrl::DoSetClientSize(width, height);
        return;
    }

    extern void sipVH__core_129(sip_gilstate_t, sipVirtErrorHandlerFunc, sipSimpleWrapper *, PyObject *, int, int);

    sipVH__core_129(sipGILState, 0, sipPySelf, sipMeth, width, height);
}

void sipwxDirFilterListCtrl::DoSetSizeHints(int minW, int minH, int maxW, int maxH, int incW, int incH)
{
    sip_gilstate_t sipGILState;
    PyObject *sipMeth;

    sipMeth = sipIsPyMethod(&sipGILState, &sipPyMethods[30], &sipPySelf, SIP_NULLPTR, sipName_DoSetSizeHints);

    if (!sipMeth)
    {
        ::wxDirFilterListCtrl::DoSetSizeHints(minW, minH, maxW, maxH, incW, incH);
        return;
    }

    extern void sipVH__core_130(sip_gilstate_t, sipVirtErrorHandlerFunc, sipSimpleWrapper *, PyObject *, int, int, int, int, int, int);

    sipVH__core_130(sipGILState, 0, sipPySelf, sipMeth, minW, minH, maxW, maxH, incW, incH);
}

::wxSize sipwxDirFilterListCtrl::DoGetBorderSize() const
{
    sip_gilstate_t sipGILState;
    PyObject *sipMeth;

    sipMeth = sipIsPyMethod(&sipGILState, const_cast<char *>(&sipPyMethods[31]), const_cast<sipSimpleWrapper **>(&sipPySelf), SIP_NULLPTR, sipName_DoGetBorderSize);

    if (!sipMeth)
        return ::wxDirFilterListCtrl::DoGetBorderSize();

    extern ::wxSize sipVH__core_101(sip_gilstate_t, sipVirtErrorHandlerFunc, sipSimpleWrapper *, PyObject *);

    return sipVH__core_101(sipGILState, 0, sipPySelf, sipMeth);
}

void sipwxDirFilterListCtrl::DoMoveWindow(int x, int y, int width, int height)
{
    sip_gilstate_t sipGILState;
    PyObject *sipMeth;

    sipMeth = sipIsPyMethod(&sipGILState, &sipPyMethods[32], &sipPySelf, SIP_NULLPTR, sipName_DoMoveWindow);

    if (!sipMeth)
    {
        ::wxDirFilterListCtrl::DoMoveWindow(x, y, width, height);
        return;
    }

    extern void sipVH__core_131(sip_gilstate_t, sipVirtErrorHandlerFunc, sipSimpleWrapper *, PyObject *, int, int, int, int);

    sipVH__core_131(sipGILState, 0, sipPySelf, sipMeth, x, y, width, height);
}

void sipwxDirFilterListCtrl::DoSetWindowVariant(::wxWindowVariant variant)
{
    sip_gilstate_t sipGILState;
    PyObject *sipMeth;

    sipMeth = sipIsPyMethod(&sipGILState, &sipPyMethods[33], &sipPySelf, SIP_NULLPTR, sipName_DoSetWindowVariant);

    if (!sipMeth)
    {
        ::wxDirFilterListCtrl::DoSetWindowVariant(variant);
        return;
    }

    extern void sipVH__core_132(sip_gilstate_t, sipVirtErrorHandlerFunc, sipSimpleWrapper *, PyObject *, ::wxWindowVariant);

    sipVH__core_132(sipGILState, 0, sipPySelf, sipMeth, variant);
}

::wxBorder sipwxDirFilterListCtrl::GetDefaultBorder() const
{
    sip_gilstate_t sipGILState;
    PyObject *sipMeth;

    sipMeth = sipIsPyMethod(&sipGILState, const_cast<char *>(&sipPyMethods[34]), const_cast<sipSimpleWrapper **>(&sipPySelf), SIP_NULLPTR, sipName_GetDefaultBorder);

    if (!sipMeth)
        return ::wxDirFilterListCtrl::GetDefaultBorder();

    extern ::wxBorder sipVH__core_133(sip_gilstate_t, sipVirtErrorHandlerFunc, sipSimpleWrapper *, PyObject *);

    return sipVH__core_133(sipGILState, 0, sipPySelf, sipMeth);
}

::wxBorder sipwxDirFilterListCtrl::GetDefaultBorderForControl() const
{
    sip_gilstate_t sipGILState;
    PyObject *sipMeth;

    sipMeth = sipIsPyMethod(&sipGILState, const_cast<char *>(&sipPyMethods[35]), const_cast<sipSimpleWrapper **>(&sipPySelf), SIP_NULLPTR, sipName_GetDefaultBorderForControl);

    if (!sipMeth)
        return ::wxDirFilterListCtrl::GetDefaultBorderForControl();

    extern ::wxBorder sipVH__core_133(sip_gilstate_t, sipVirtErrorHandlerFunc, sipSimpleWrapper *, PyObject *);

    return sipVH__core_133(sipGILState, 0, sipPySelf, sipMeth);
}

void sipwxDirFilterListCtrl::DoFreeze()
{
    sip_gilstate_t sipGILState;
    PyObject *sipMeth;

    sipMeth = sipIsPyMethod(&sipGILState, &sipPyMethods[36], &sipPySelf, SIP_NULLPTR, sipName_DoFreeze);

    if (!sipMeth)
    {
        ::wxDirFilterListCtrl::DoFreeze();
        return;
    }

    extern void sipVH__core_53(sip_gilstate_t, sipVirtErrorHandlerFunc, sipSimpleWrapper *, PyObject *);

    sipVH__core_53(sipGILState, 0, sipPySelf, sipMeth);
}

void sipwxDirFilterListCtrl::DoThaw()
{
    sip_gilstate_t sipGILState;
    PyObject *sipMeth;

    sipMeth = sipIsPyMethod(&sipGILState, &sipPyMethods[37], &sipPySelf, SIP_NULLPTR, sipName_DoThaw);

    if (!sipMeth)
    {
        ::wxDirFilterListCtrl::DoThaw();
        return;
    }

    extern void sipVH__core_53(sip_gilstate_t, sipVirtErrorHandlerFunc, sipSimpleWrapper *, PyObject *);

    sipVH__core_53(sipGILState, 0, sipPySelf, sipMeth);
}

::wxSize sipwxDirFilterListCtrl::DoGetBestSize() const
{
    sip_gilstate_t sipGILState;
    PyObject *sipMeth;

    sipMeth = sipIsPyMethod(&sipGILState, const_cast<char *>(&sipPyMethods[38]), const_cast<sipSimpleWrapper **>(&sipPySelf), SIP_NULLPTR, sipName_DoGetBestSize);

    if (!sipMeth)
        return ::wxDirFilterListCtrl::DoGetBestSize();

    extern ::wxSize sipVH__core_101(sip_gilstate_t, sipVirtErrorHandlerFunc, sipSimpleWrapper *, PyObject *);

    return sipVH__core_101(sipGILState, 0, sipPySelf, sipMeth);
}

::wxSize sipwxDirFilterListCtrl::DoGetBestClientSize() const
{
    sip_gilstate_t sipGILState;
    PyObject *sipMeth;

    sipMeth = sipIsPyMethod(&sipGILState, const_cast<char *>(&sipPyMethods[39]), const_cast<sipSimpleWrapper **>(&sipPySelf), SIP_NULLPTR, sipName_DoGetBestClientSize);

    if (!sipMeth)
        return ::wxDirFilterListCtrl::DoGetBestClientSize();

    extern ::wxSize sipVH__core_101(sip_gilstate_t, sipVirtErrorHandlerFunc, sipSimpleWrapper *, PyObject *);

    return sipVH__core_101(sipGILState, 0, sipPySelf, sipMeth);
}

uint sipwxDirFilterListCtrl::GetCount() const
{
    sip_gilstate_t sipGILState;
    PyObject *sipMeth;

    sipMeth = sipIsPyMethod(&sipGILState, const_cast<char *>(&sipPyMethods[40]), const_cast<sipSimpleWrapper **>(&sipPySelf), SIP_NULLPTR, sipName_GetCount);

    if (!sipMeth)
        return ::wxDirFilterListCtrl::GetCount();

    extern uint sipVH__core_148(sip_gilstate_t, sipVirtErrorHandlerFunc, sipSimpleWrapper *, PyObject *);

    return sipVH__core_148(sipGILState, 0, sipPySelf, sipMeth);
}

::wxString sipwxDirFilterListCtrl::GetString(uint n) const
{
    sip_gilstate_t sipGILState;
    PyObject *sipMeth;

    sipMeth = sipIsPyMethod(&sipGILState, const_cast<char *>(&sipPyMethods[41]), const_cast<sipSimpleWrapper **>(&sipPySelf), SIP_NULLPTR, sipName_GetString);

    if (!sipMeth)
        return ::wxDirFilterListCtrl::GetString(n);

    extern ::wxString sipVH__core_149(sip_gilstate_t, sipVirtErrorHandlerFunc, sipSimpleWrapper *, PyObject *, uint);

    return sipVH__core_149(sipGILState, 0, sipPySelf, sipMeth, n);
}

void sipwxDirFilterListCtrl::SetString(uint n, const ::wxString& string)
{
    sip_gilstate_t sipGILState;
    PyObject *sipMeth;

    sipMeth = sipIsPyMethod(&sipGILState, &sipPyMethods[42], &sipPySelf, SIP_NULLPTR, sipName_SetString);

    if (!sipMeth)
    {
        ::wxDirFilterListCtrl::SetString(n, string);
        return;
    }

    extern void sipVH__core_150(sip_gilstate_t, sipVirtErrorHandlerFunc, sipSimpleWrapper *, PyObject *, uint, const ::wxString&);

    sipVH__core_150(sipGILState, 0, sipPySelf, sipMeth, n, string);
}

int sipwxDirFilterListCtrl::FindString(const ::wxString& string, bool caseSensitive) const
{
    sip_gilstate_t sipGILState;
    PyObject *sipMeth;

    sipMeth = sipIsPyMethod(&sipGILState, const_cast<char *>(&sipPyMethods[43]), const_cast<sipSimpleWrapper **>(&sipPySelf), SIP_NULLPTR, sipName_FindString);

    if (!sipMeth)
        return ::wxDirFilterListCtrl::FindString(string, caseSensitive);

    extern int sipVH__core_151(sip_gilstate_t, sipVirtErrorHandlerFunc, sipSimpleWrapper *, PyObject *, const ::wxString&, bool);

    return sipVH__core_151(sipGILState, 0, sipPySelf, sipMeth, string, caseSensitive);
}

void sipwxDirFilterListCtrl::SetSelection(int n)
{
    sip_gilstate_t sipGILState;
    PyObject *sipMeth;

    sipMeth = sipIsPyMethod(&sipGILState, &sipPyMethods[44], &sipPySelf, SIP_NULLPTR, sipName_SetSelection);

    if (!sipMeth)
    {
        ::wxDirFilterListCtrl::SetSelection(n);
        return;
    }

    extern void sipVH__core_109(sip_gilstate_t, sipVirtErrorHandlerFunc, sipSimpleWrapper *, PyObject *, int);

    sipVH__core_109(sipGILState, 0, sipPySelf, sipMeth, n);
}

int sipwxDirFilterListCtrl::GetSelection() const
{
    sip_gilstate_t sipGILState;
    PyObject *sipMeth;

    sipMeth = sipIsPyMethod(&sipGILState, const_cast<char *>(&sipPyMethods[45]), const_cast<sipSimpleWrapper **>(&sipPySelf), SIP_NULLPTR, sipName_GetSelection);

    if (!sipMeth)
        return ::wxDirFilterListCtrl::GetSelection();

    extern int sipVH__core_108(sip_gilstate_t, sipVirtErrorHandlerFunc, sipSimpleWrapper *, PyObject *);

    return sipVH__core_108(sipGILState, 0, sipPySelf, sipMeth);
}

::wxString sipwxDirFilterListCtrl::GetStringSelection() const
{
    sip_gilstate_t sipGILState;
    PyObject *sipMeth;

    sipMeth = sipIsPyMethod(&sipGILState, const_cast<char *>(&sipPyMethods[46]), const_cast<sipSimpleWrapper **>(&sipPySelf), SIP_NULLPTR, sipName_GetStringSelection);

    if (!sipMeth)
        return ::wxDirFilterListCtrl::GetStringSelection();

    extern ::wxString sipVH__core_11(sip_gilstate_t, sipVirtErrorHandlerFunc, sipSimpleWrapper *, PyObject *);

    return sipVH__core_11(sipGILState, 0, sipPySelf, sipMeth);
}

void sipwxDirFilterListCtrl::sipProtect_SendDestroyEvent()
{
    ::wxWindow::SendDestroyEvent();
}

bool sipwxDirFilterListCtrl::sipProtectVirt_ProcessEvent(bool sipSelfWasArg, ::wxEvent& event)
{
    return (sipSelfWasArg ? ::wxChoice::ProcessEvent(event) : ProcessEvent(event));
}

void sipwxDirFilterListCtrl::sipProtectVirt_DoEnable(bool sipSelfWasArg, bool enable)
{
    (sipSelfWasArg ? ::wxChoice::DoEnable(enable) : DoEnable(enable));
}

void sipwxDirFilterListCtrl::sipProtectVirt_DoGetPosition(bool sipSelfWasArg, int*x, int*y) const
{
    (sipSelfWasArg ? ::wxChoice::DoGetPosition(x, y) : DoGetPosition(x, y));
}

void sipwxDirFilterListCtrl::sipProtectVirt_DoGetSize(bool sipSelfWasArg, int*width, int*height) const
{
    (sipSelfWasArg ? ::wxChoice::DoGetSize(width, height) : DoGetSize(width, height));
}

void sipwxDirFilterListCtrl::sipProtectVirt_DoGetClientSize(bool sipSelfWasArg, int*width, int*height) const
{
    (sipSelfWasArg ? ::wxChoice::DoGetClientSize(width, height) : DoGetClientSize(width, height));
}

::wxSize sipwxDirFilterListCtrl::sipProtectVirt_DoGetBestSize(bool sipSelfWasArg) const
{
    return (sipSelfWasArg ? ::wxChoice::DoGetBestSize() : DoGetBestSize());
}

::wxSize sipwxDirFilterListCtrl::sipProtectVirt_DoGetBestClientSize(bool sipSelfWasArg) const
{
    return (sipSelfWasArg ? ::wxChoice::DoGetBestClientSize() : DoGetBestClientSize());
}

void sipwxDirFilterListCtrl::sipProtectVirt_DoSetSize(bool sipSelfWasArg, int x, int y, int width, int height, int sizeFlags)
{
    (sipSelfWasArg ? ::wxChoice::DoSetSize(x, y, width, height, sizeFlags) : DoSetSize(x, y, width, height, sizeFlags));
}

void sipwxDirFilterListCtrl::sipProtectVirt_DoSetClientSize(bool sipSelfWasArg, int width, int height)
{
    (sipSelfWasArg ? ::wxChoice::DoSetClientSize(width, height) : DoSetClientSize(width, height));
}

void sipwxDirFilterListCtrl::sipProtectVirt_DoSetSizeHints(bool sipSelfWasArg, int minW, int minH, int maxW, int maxH, int incW, int incH)
{
    (sipSelfWasArg ? ::wxChoice::DoSetSizeHints(minW, minH, maxW, maxH, incW, incH) : DoSetSizeHints(minW, minH, maxW, maxH, incW, incH));
}

::wxSize sipwxDirFilterListCtrl::sipProtectVirt_DoGetBorderSize(bool sipSelfWasArg) const
{
    return (sipSelfWasArg ? ::wxChoice::DoGetBorderSize() : DoGetBorderSize());
}

void sipwxDirFilterListCtrl::sipProtectVirt_DoMoveWindow(bool sipSelfWasArg, int x, int y, int width, int height)
{
    (sipSelfWasArg ? ::wxChoice::DoMoveWindow(x, y, width, height) : DoMoveWindow(x, y, width, height));
}

void sipwxDirFilterListCtrl::sipProtectVirt_DoSetWindowVariant(bool sipSelfWasArg, ::wxWindowVariant variant)
{
    (sipSelfWasArg ? ::wxChoice::DoSetWindowVariant(variant) : DoSetWindowVariant(variant));
}

::wxBorder sipwxDirFilterListCtrl::sipProtectVirt_GetDefaultBorder(bool sipSelfWasArg) const
{
    return (sipSelfWasArg ? ::wxChoice::GetDefaultBorder() : GetDefaultBorder());
}

::wxBorder sipwxDirFilterListCtrl::sipProtectVirt_GetDefaultBorderForControl(bool sipSelfWasArg) const
{
    return (sipSelfWasArg ? ::wxChoice::GetDefaultBorderForControl() : GetDefaultBorderForControl());
}

void sipwxDirFilterListCtrl::sipProtectVirt_DoFreeze(bool sipSelfWasArg)
{
    (sipSelfWasArg ? ::wxChoice::DoFreeze() : DoFreeze());
}

void sipwxDirFilterListCtrl::sipProtectVirt_DoThaw(bool sipSelfWasArg)
{
    (sipSelfWasArg ? ::wxChoice::DoThaw() : DoThaw());
}

bool sipwxDirFilterListCtrl::sipProtectVirt_HasTransparentBackground(bool sipSelfWasArg)
{
    return (sipSelfWasArg ? ::wxChoice::HasTransparentBackground() : HasTransparentBackground());
}

bool sipwxDirFilterListCtrl::sipProtectVirt_TryBefore(bool sipSelfWasArg, ::wxEvent& event)
{
    return (sipSelfWasArg ? ::wxChoice::TryBefore(event) : TryBefore(event));
}

bool sipwxDirFilterListCtrl::sipProtectVirt_TryAfter(bool sipSelfWasArg, ::wxEvent& event)
{
    return (sipSelfWasArg ? ::wxChoice::TryAfter(event) : TryAfter(event));
}


PyDoc_STRVAR(doc_wxDirFilterListCtrl_SendDestroyEvent, "SendDestroyEvent()\n"
"\n"
"Generate wxWindowDestroyEvent for this window.");

extern "C" {static PyObject *meth_wxDirFilterListCtrl_SendDestroyEvent(PyObject *, PyObject *);}
static PyObject *meth_wxDirFilterListCtrl_SendDestroyEvent(PyObject *sipSelf, PyObject *sipArgs)
{
    PyObject *sipParseErr = SIP_NULLPTR;

    {
        sipwxDirFilterListCtrl *sipCpp;

        if (sipParseArgs(&sipParseErr, sipArgs, "B", &sipSelf, sipType_wxDirFilterListCtrl, &sipCpp))
        {
            PyErr_Clear();

            Py_BEGIN_ALLOW_THREADS
            sipCpp->sipProtect_SendDestroyEvent();
            Py_END_ALLOW_THREADS

            if (PyErr_Occurred())
                return 0;

            Py_INCREF(Py_None);
            return Py_None;
        }
    }

    sipNoMethod(sipParseErr, sipName_DirFilterListCtrl, sipName_SendDestroyEvent, SIP_NULLPTR);

    return SIP_NULLPTR;
}


PyDoc_STRVAR(doc_wxDirFilterListCtrl_ProcessEvent, "ProcessEvent(self, event: Event) -> bool");

extern "C" {static PyObject *meth_wxDirFilterListCtrl_ProcessEvent(PyObject *, PyObject *, PyObject *);}
static PyObject *meth_wxDirFilterListCtrl_ProcessEvent(PyObject *sipSelf, PyObject *sipArgs, PyObject *sipKwds)
{
    PyObject *sipParseErr = SIP_NULLPTR;
    bool sipSelfWasArg = (!sipSelf || sipIsDerivedClass((sipSimpleWrapper *)sipSelf));

    {
        ::wxEvent* event;
        sipwxDirFilterListCtrl *sipCpp;

        static const char *sipKwdList[] = {
            sipName_event,
        };

        if (sipParseKwdArgs(&sipParseErr, sipArgs, sipKwds, sipKwdList, SIP_NULLPTR, "BJ9", &sipSelf, sipType_wxDirFilterListCtrl, &sipCpp, sipType_wxEvent, &event))
        {
            bool sipRes;

            PyErr_Clear();

            Py_BEGIN_ALLOW_THREADS
            sipRes = sipCpp->sipProtectVirt_ProcessEvent(sipSelfWasArg, *event);
            Py_END_ALLOW_THREADS

            if (PyErr_Occurred())
                return 0;

            return PyBool_FromLong(sipRes);
        }
    }

    sipNoMethod(sipParseErr, sipName_DirFilterListCtrl, sipName_ProcessEvent, doc_wxDirFilterListCtrl_ProcessEvent);

    return SIP_NULLPTR;
}


PyDoc_STRVAR(doc_wxDirFilterListCtrl_DoEnable, "DoEnable(self, enable: bool)");

extern "C" {static PyObject *meth_wxDirFilterListCtrl_DoEnable(PyObject *, PyObject *, PyObject *);}
static PyObject *meth_wxDirFilterListCtrl_DoEnable(PyObject *sipSelf, PyObject *sipArgs, PyObject *sipKwds)
{
    PyObject *sipParseErr = SIP_NULLPTR;
    bool sipSelfWasArg = (!sipSelf || sipIsDerivedClass((sipSimpleWrapper *)sipSelf));

    {
        bool enable;
        sipwxDirFilterListCtrl *sipCpp;

        static const char *sipKwdList[] = {
            sipName_enable,
        };

        if (sipParseKwdArgs(&sipParseErr, sipArgs, sipKwds, sipKwdList, SIP_NULLPTR, "Bb", &sipSelf, sipType_wxDirFilterListCtrl, &sipCpp, &enable))
        {
            PyErr_Clear();

            Py_BEGIN_ALLOW_THREADS
            sipCpp->sipProtectVirt_DoEnable(sipSelfWasArg, enable);
            Py_END_ALLOW_THREADS

            if (PyErr_Occurred())
                return 0;

            Py_INCREF(Py_None);
            return Py_None;
        }
    }

    sipNoMethod(sipParseErr, sipName_DirFilterListCtrl, sipName_DoEnable, doc_wxDirFilterListCtrl_DoEnable);

    return SIP_NULLPTR;
}


PyDoc_STRVAR(doc_wxDirFilterListCtrl_DoGetPosition, "DoGetPosition(self) -> (int, int)");

extern "C" {static PyObject *meth_wxDirFilterListCtrl_DoGetPosition(PyObject *, PyObject *, PyObject *);}
static PyObject *meth_wxDirFilterListCtrl_DoGetPosition(PyObject *sipSelf, PyObject *sipArgs, PyObject *sipKwds)
{
    PyObject *sipParseErr = SIP_NULLPTR;
    bool sipSelfWasArg = (!sipSelf || sipIsDerivedClass((sipSimpleWrapper *)sipSelf));

    {
        int x;
        int y;
        const sipwxDirFilterListCtrl *sipCpp;

        if (sipParseKwdArgs(&sipParseErr, sipArgs, sipKwds, SIP_NULLPTR, SIP_NULLPTR, "B", &sipSelf, sipType_wxDirFilterListCtrl, &sipCpp))
        {
            PyErr_Clear();

            Py_BEGIN_ALLOW_THREADS
            sipCpp->sipProtectVirt_DoGetPosition(sipSelfWasArg, &x, &y);
            Py_END_ALLOW_THREADS

            if (PyErr_Occurred())
                return 0;

            return sipBuildResult(0, "(ii)", x, y);
        }
    }

    sipNoMethod(sipParseErr, sipName_DirFilterListCtrl, sipName_DoGetPosition, doc_wxDirFilterListCtrl_DoGetPosition);

    return SIP_NULLPTR;
}


PyDoc_STRVAR(doc_wxDirFilterListCtrl_DoGetSize, "DoGetSize(self) -> (int, int)");

extern "C" {static PyObject *meth_wxDirFilterListCtrl_DoGetSize(PyObject *, PyObject *, PyObject *);}
static PyObject *meth_wxDirFilterListCtrl_DoGetSize(PyObject *sipSelf, PyObject *sipArgs, PyObject *sipKwds)
{
    PyObject *sipParseErr = SIP_NULLPTR;
    bool sipSelfWasArg = (!sipSelf || sipIsDerivedClass((sipSimpleWrapper *)sipSelf));

    {
        int width;
        int height;
        const sipwxDirFilterListCtrl *sipCpp;

        if (sipParseKwdArgs(&sipParseErr, sipArgs, sipKwds, SIP_NULLPTR, SIP_NULLPTR, "B", &sipSelf, sipType_wxDirFilterListCtrl, &sipCpp))
        {
            PyErr_Clear();

            Py_BEGIN_ALLOW_THREADS
            sipCpp->sipProtectVirt_DoGetSize(sipSelfWasArg, &width, &height);
            Py_END_ALLOW_THREADS

            if (PyErr_Occurred())
                return 0;

            return sipBuildResult(0, "(ii)", width, height);
        }
    }

    sipNoMethod(sipParseErr, sipName_DirFilterListCtrl, sipName_DoGetSize, doc_wxDirFilterListCtrl_DoGetSize);

    return SIP_NULLPTR;
}


PyDoc_STRVAR(doc_wxDirFilterListCtrl_DoGetClientSize, "DoGetClientSize(self) -> (int, int)");

extern "C" {static PyObject *meth_wxDirFilterListCtrl_DoGetClientSize(PyObject *, PyObject *, PyObject *);}
static PyObject *meth_wxDirFilterListCtrl_DoGetClientSize(PyObject *sipSelf, PyObject *sipArgs, PyObject *sipKwds)
{
    PyObject *sipParseErr = SIP_NULLPTR;
    bool sipSelfWasArg = (!sipSelf || sipIsDerivedClass((sipSimpleWrapper *)sipSelf));

    {
        int width;
        int height;
        const sipwxDirFilterListCtrl *sipCpp;

        if (sipParseKwdArgs(&sipParseErr, sipArgs, sipKwds, SIP_NULLPTR, SIP_NULLPTR, "B", &sipSelf, sipType_wxDirFilterListCtrl, &sipCpp))
        {
            PyErr_Clear();

            Py_BEGIN_ALLOW_THREADS
            sipCpp->sipProtectVirt_DoGetClientSize(sipSelfWasArg, &width, &height);
            Py_END_ALLOW_THREADS

            if (PyErr_Occurred())
                return 0;

            return sipBuildResult(0, "(ii)", width, height);
        }
    }

    sipNoMethod(sipParseErr, sipName_DirFilterListCtrl, sipName_DoGetClientSize, doc_wxDirFilterListCtrl_DoGetClientSize);

    return SIP_NULLPTR;
}


PyDoc_STRVAR(doc_wxDirFilterListCtrl_DoGetBestSize, "DoGetBestSize(self) -> Size");

extern "C" {static PyObject *meth_wxDirFilterListCtrl_DoGetBestSize(PyObject *, PyObject *);}
static PyObject *meth_wxDirFilterListCtrl_DoGetBestSize(PyObject *sipSelf, PyObject *sipArgs)
{
    PyObject *sipParseErr = SIP_NULLPTR;
    bool sipSelfWasArg = (!sipSelf || sipIsDerivedClass((sipSimpleWrapper *)sipSelf));

    {
        const sipwxDirFilterListCtrl *sipCpp;

        if (sipParseArgs(&sipParseErr, sipArgs, "B", &sipSelf, sipType_wxDirFilterListCtrl, &sipCpp))
        {
            ::wxSize*sipRes;

            PyErr_Clear();

            Py_BEGIN_ALLOW_THREADS
            sipRes = new ::wxSize(sipCpp->sipProtectVirt_DoGetBestSize(sipSelfWasArg));
            Py_END_ALLOW_THREADS

            if (PyErr_Occurred())
                return 0;

            return sipConvertFromNewType(sipRes, sipType_wxSize, SIP_NULLPTR);
        }
    }

    sipNoMethod(sipParseErr, sipName_DirFilterListCtrl, sipName_DoGetBestSize, doc_wxDirFilterListCtrl_DoGetBestSize);

    return SIP_NULLPTR;
}


PyDoc_STRVAR(doc_wxDirFilterListCtrl_DoGetBestClientSize, "DoGetBestClientSize(self) -> Size");

extern "C" {static PyObject *meth_wxDirFilterListCtrl_DoGetBestClientSize(PyObject *, PyObject *);}
static PyObject *meth_wxDirFilterListCtrl_DoGetBestClientSize(PyObject *sipSelf, PyObject *sipArgs)
{
    PyObject *sipParseErr = SIP_NULLPTR;
    bool sipSelfWasArg = (!sipSelf || sipIsDerivedClass((sipSimpleWrapper *)sipSelf));

    {
        const sipwxDirFilterListCtrl *sipCpp;

        if (sipParseArgs(&sipParseErr, sipArgs, "B", &sipSelf, sipType_wxDirFilterListCtrl, &sipCpp))
        {
            ::wxSize*sipRes;

            PyErr_Clear();

            Py_BEGIN_ALLOW_THREADS
            sipRes = new ::wxSize(sipCpp->sipProtectVirt_DoGetBestClientSize(sipSelfWasArg));
            Py_END_ALLOW_THREADS

            if (PyErr_Occurred())
                return 0;

            return sipConvertFromNewType(sipRes, sipType_wxSize, SIP_NULLPTR);
        }
    }

    sipNoMethod(sipParseErr, sipName_DirFilterListCtrl, sipName_DoGetBestClientSize, doc_wxDirFilterListCtrl_DoGetBestClientSize);

    return SIP_NULLPTR;
}


PyDoc_STRVAR(doc_wxDirFilterListCtrl_DoSetSize, "DoSetSize(self, x: int, y: int, width: int, height: int, sizeFlags: int)");

extern "C" {static PyObject *meth_wxDirFilterListCtrl_DoSetSize(PyObject *, PyObject *, PyObject *);}
static PyObject *meth_wxDirFilterListCtrl_DoSetSize(PyObject *sipSelf, PyObject *sipArgs, PyObject *sipKwds)
{
    PyObject *sipParseErr = SIP_NULLPTR;
    bool sipSelfWasArg = (!sipSelf || sipIsDerivedClass((sipSimpleWrapper *)sipSelf));

    {
        int x;
        int y;
        int width;
        int height;
        int sizeFlags;
        sipwxDirFilterListCtrl *sipCpp;

        static const char *sipKwdList[] = {
            sipName_x,
            sipName_y,
            sipName_width,
            sipName_height,
            sipName_sizeFlags,
        };

        if (sipParseKwdArgs(&sipParseErr, sipArgs, sipKwds, sipKwdList, SIP_NULLPTR, "Biiiii", &sipSelf, sipType_wxDirFilterListCtrl, &sipCpp, &x, &y, &width, &height, &sizeFlags))
        {
            PyErr_Clear();

            Py_BEGIN_ALLOW_THREADS
            sipCpp->sipProtectVirt_DoSetSize(sipSelfWasArg, x, y, width, height, sizeFlags);
            Py_END_ALLOW_THREADS

            if (PyErr_Occurred())
                return 0;

            Py_INCREF(Py_None);
            return Py_None;
        }
    }

    sipNoMethod(sipParseErr, sipName_DirFilterListCtrl, sipName_DoSetSize, doc_wxDirFilterListCtrl_DoSetSize);

    return SIP_NULLPTR;
}


PyDoc_STRVAR(doc_wxDirFilterListCtrl_DoSetClientSize, "DoSetClientSize(self, width: int, height: int)");

extern "C" {static PyObject *meth_wxDirFilterListCtrl_DoSetClientSize(PyObject *, PyObject *, PyObject *);}
static PyObject *meth_wxDirFilterListCtrl_DoSetClientSize(PyObject *sipSelf, PyObject *sipArgs, PyObject *sipKwds)
{
    PyObject *sipParseErr = SIP_NULLPTR;
    bool sipSelfWasArg = (!sipSelf || sipIsDerivedClass((sipSimpleWrapper *)sipSelf));

    {
        int width;
        int height;
        sipwxDirFilterListCtrl *sipCpp;

        static const char *sipKwdList[] = {
            sipName_width,
            sipName_height,
        };

        if (sipParseKwdArgs(&sipParseErr, sipArgs, sipKwds, sipKwdList, SIP_NULLPTR, "Bii", &sipSelf, sipType_wxDirFilterListCtrl, &sipCpp, &width, &height))
        {
            PyErr_Clear();

            Py_BEGIN_ALLOW_THREADS
            sipCpp->sipProtectVirt_DoSetClientSize(sipSelfWasArg, width, height);
            Py_END_ALLOW_THREADS

            if (PyErr_Occurred())
                return 0;

            Py_INCREF(Py_None);
            return Py_None;
        }
    }

    sipNoMethod(sipParseErr, sipName_DirFilterListCtrl, sipName_DoSetClientSize, doc_wxDirFilterListCtrl_DoSetClientSize);

    return SIP_NULLPTR;
}


PyDoc_STRVAR(doc_wxDirFilterListCtrl_DoSetSizeHints, "DoSetSizeHints(self, minW: int, minH: int, maxW: int, maxH: int, incW: int, incH: int)");

extern "C" {static PyObject *meth_wxDirFilterListCtrl_DoSetSizeHints(PyObject *, PyObject *, PyObject *);}
static PyObject *meth_wxDirFilterListCtrl_DoSetSizeHints(PyObject *sipSelf, PyObject *sipArgs, PyObject *sipKwds)
{
    PyObject *sipParseErr = SIP_NULLPTR;
    bool sipSelfWasArg = (!sipSelf || sipIsDerivedClass((sipSimpleWrapper *)sipSelf));

    {
        int minW;
        int minH;
        int maxW;
        int maxH;
        int incW;
        int incH;
        sipwxDirFilterListCtrl *sipCpp;

        static const char *sipKwdList[] = {
            sipName_minW,
            sipName_minH,
            sipName_maxW,
            sipName_maxH,
            sipName_incW,
            sipName_incH,
        };

        if (sipParseKwdArgs(&sipParseErr, sipArgs, sipKwds, sipKwdList, SIP_NULLPTR, "Biiiiii", &sipSelf, sipType_wxDirFilterListCtrl, &sipCpp, &minW, &minH, &maxW, &maxH, &incW, &incH))
        {
            PyErr_Clear();

            Py_BEGIN_ALLOW_THREADS
            sipCpp->sipProtectVirt_DoSetSizeHints(sipSelfWasArg, minW, minH, maxW, maxH, incW, incH);
            Py_END_ALLOW_THREADS

            if (PyErr_Occurred())
                return 0;

            Py_INCREF(Py_None);
            return Py_None;
        }
    }

    sipNoMethod(sipParseErr, sipName_DirFilterListCtrl, sipName_DoSetSizeHints, doc_wxDirFilterListCtrl_DoSetSizeHints);

    return SIP_NULLPTR;
}


PyDoc_STRVAR(doc_wxDirFilterListCtrl_DoGetBorderSize, "DoGetBorderSize(self) -> Size");

extern "C" {static PyObject *meth_wxDirFilterListCtrl_DoGetBorderSize(PyObject *, PyObject *);}
static PyObject *meth_wxDirFilterListCtrl_DoGetBorderSize(PyObject *sipSelf, PyObject *sipArgs)
{
    PyObject *sipParseErr = SIP_NULLPTR;
    bool sipSelfWasArg = (!sipSelf || sipIsDerivedClass((sipSimpleWrapper *)sipSelf));

    {
        const sipwxDirFilterListCtrl *sipCpp;

        if (sipParseArgs(&sipParseErr, sipArgs, "B", &sipSelf, sipType_wxDirFilterListCtrl, &sipCpp))
        {
            ::wxSize*sipRes;

            PyErr_Clear();

            Py_BEGIN_ALLOW_THREADS
            sipRes = new ::wxSize(sipCpp->sipProtectVirt_DoGetBorderSize(sipSelfWasArg));
            Py_END_ALLOW_THREADS

            if (PyErr_Occurred())
                return 0;

            return sipConvertFromNewType(sipRes, sipType_wxSize, SIP_NULLPTR);
        }
    }

    sipNoMethod(sipParseErr, sipName_DirFilterListCtrl, sipName_DoGetBorderSize, doc_wxDirFilterListCtrl_DoGetBorderSize);

    return SIP_NULLPTR;
}


PyDoc_STRVAR(doc_wxDirFilterListCtrl_DoMoveWindow, "DoMoveWindow(self, x: int, y: int, width: int, height: int)");

extern "C" {static PyObject *meth_wxDirFilterListCtrl_DoMoveWindow(PyObject *, PyObject *, PyObject *);}
static PyObject *meth_wxDirFilterListCtrl_DoMoveWindow(PyObject *sipSelf, PyObject *sipArgs, PyObject *sipKwds)
{
    PyObject *sipParseErr = SIP_NULLPTR;
    bool sipSelfWasArg = (!sipSelf || sipIsDerivedClass((sipSimpleWrapper *)sipSelf));

    {
        int x;
        int y;
        int width;
        int height;
        sipwxDirFilterListCtrl *sipCpp;

        static const char *sipKwdList[] = {
            sipName_x,
            sipName_y,
            sipName_width,
            sipName_height,
        };

        if (sipParseKwdArgs(&sipParseErr, sipArgs, sipKwds, sipKwdList, SIP_NULLPTR, "Biiii", &sipSelf, sipType_wxDirFilterListCtrl, &sipCpp, &x, &y, &width, &height))
        {
            PyErr_Clear();

            Py_BEGIN_ALLOW_THREADS
            sipCpp->sipProtectVirt_DoMoveWindow(sipSelfWasArg, x, y, width, height);
            Py_END_ALLOW_THREADS

            if (PyErr_Occurred())
                return 0;

            Py_INCREF(Py_None);
            return Py_None;
        }
    }

    sipNoMethod(sipParseErr, sipName_DirFilterListCtrl, sipName_DoMoveWindow, doc_wxDirFilterListCtrl_DoMoveWindow);

    return SIP_NULLPTR;
}


PyDoc_STRVAR(doc_wxDirFilterListCtrl_DoSetWindowVariant, "DoSetWindowVariant(self, variant: WindowVariant)");

extern "C" {static PyObject *meth_wxDirFilterListCtrl_DoSetWindowVariant(PyObject *, PyObject *, PyObject *);}
static PyObject *meth_wxDirFilterListCtrl_DoSetWindowVariant(PyObject *sipSelf, PyObject *sipArgs, PyObject *sipKwds)
{
    PyObject *sipParseErr = SIP_NULLPTR;
    bool sipSelfWasArg = (!sipSelf || sipIsDerivedClass((sipSimpleWrapper *)sipSelf));

    {
        ::wxWindowVariant variant;
        sipwxDirFilterListCtrl *sipCpp;

        static const char *sipKwdList[] = {
            sipName_variant,
        };

        if (sipParseKwdArgs(&sipParseErr, sipArgs, sipKwds, sipKwdList, SIP_NULLPTR, "BE", &sipSelf, sipType_wxDirFilterListCtrl, &sipCpp, sipType_wxWindowVariant, &variant))
        {
            PyErr_Clear();

            Py_BEGIN_ALLOW_THREADS
            sipCpp->sipProtectVirt_DoSetWindowVariant(sipSelfWasArg, variant);
            Py_END_ALLOW_THREADS

            if (PyErr_Occurred())
                return 0;

            Py_INCREF(Py_None);
            return Py_None;
        }
    }

    sipNoMethod(sipParseErr, sipName_DirFilterListCtrl, sipName_DoSetWindowVariant, doc_wxDirFilterListCtrl_DoSetWindowVariant);

    return SIP_NULLPTR;
}


PyDoc_STRVAR(doc_wxDirFilterListCtrl_GetDefaultBorder, "GetDefaultBorder(self) -> Border");

extern "C" {static PyObject *meth_wxDirFilterListCtrl_GetDefaultBorder(PyObject *, PyObject *);}
static PyObject *meth_wxDirFilterListCtrl_GetDefaultBorder(PyObject *sipSelf, PyObject *sipArgs)
{
    PyObject *sipParseErr = SIP_NULLPTR;
    bool sipSelfWasArg = (!sipSelf || sipIsDerivedClass((sipSimpleWrapper *)sipSelf));

    {
        const sipwxDirFilterListCtrl *sipCpp;

        if (sipParseArgs(&sipParseErr, sipArgs, "B", &sipSelf, sipType_wxDirFilterListCtrl, &sipCpp))
        {
            ::wxBorder sipRes;

            PyErr_Clear();

            Py_BEGIN_ALLOW_THREADS
            sipRes = sipCpp->sipProtectVirt_GetDefaultBorder(sipSelfWasArg);
            Py_END_ALLOW_THREADS

            if (PyErr_Occurred())
                return 0;

            return sipConvertFromEnum(static_cast<int>(sipRes), sipType_wxBorder);
        }
    }

    sipNoMethod(sipParseErr, sipName_DirFilterListCtrl, sipName_GetDefaultBorder, doc_wxDirFilterListCtrl_GetDefaultBorder);

    return SIP_NULLPTR;
}


PyDoc_STRVAR(doc_wxDirFilterListCtrl_GetDefaultBorderForControl, "GetDefaultBorderForControl(self) -> Border");

extern "C" {static PyObject *meth_wxDirFilterListCtrl_GetDefaultBorderForControl(PyObject *, PyObject *);}
static PyObject *meth_wxDirFilterListCtrl_GetDefaultBorderForControl(PyObject *sipSelf, PyObject *sipArgs)
{
    PyObject *sipParseErr = SIP_NULLPTR;
    bool sipSelfWasArg = (!sipSelf || sipIsDerivedClass((sipSimpleWrapper *)sipSelf));

    {
        const sipwxDirFilterListCtrl *sipCpp;

        if (sipParseArgs(&sipParseErr, sipArgs, "B", &sipSelf, sipType_wxDirFilterListCtrl, &sipCpp))
        {
            ::wxBorder sipRes;

            PyErr_Clear();

            Py_BEGIN_ALLOW_THREADS
            sipRes = sipCpp->sipProtectVirt_GetDefaultBorderForControl(sipSelfWasArg);
            Py_END_ALLOW_THREADS

            if (PyErr_Occurred())
                return 0;

            return sipConvertFromEnum(static_cast<int>(sipRes), sipType_wxBorder);
        }
    }

    sipNoMethod(sipParseErr, sipName_DirFilterListCtrl, sipName_GetDefaultBorderForControl, doc_wxDirFilterListCtrl_GetDefaultBorderForControl);

    return SIP_NULLPTR;
}


PyDoc_STRVAR(doc_wxDirFilterListCtrl_DoFreeze, "DoFreeze(self)");

extern "C" {static PyObject *meth_wxDirFilterListCtrl_DoFreeze(PyObject *, PyObject *);}
static PyObject *meth_wxDirFilterListCtrl_DoFreeze(PyObject *sipSelf, PyObject *sipArgs)
{
    PyObject *sipParseErr = SIP_NULLPTR;
    bool sipSelfWasArg = (!sipSelf || sipIsDerivedClass((sipSimpleWrapper *)sipSelf));

    {
        sipwxDirFilterListCtrl *sipCpp;

        if (sipParseArgs(&sipParseErr, sipArgs, "B", &sipSelf, sipType_wxDirFilterListCtrl, &sipCpp))
        {
            PyErr_Clear();

            Py_BEGIN_ALLOW_THREADS
            sipCpp->sipProtectVirt_DoFreeze(sipSelfWasArg);
            Py_END_ALLOW_THREADS

            if (PyErr_Occurred())
                return 0;

            Py_INCREF(Py_None);
            return Py_None;
        }
    }

    sipNoMethod(sipParseErr, sipName_DirFilterListCtrl, sipName_DoFreeze, doc_wxDirFilterListCtrl_DoFreeze);

    return SIP_NULLPTR;
}


PyDoc_STRVAR(doc_wxDirFilterListCtrl_DoThaw, "DoThaw(self)");

extern "C" {static PyObject *meth_wxDirFilterListCtrl_DoThaw(PyObject *, PyObject *);}
static PyObject *meth_wxDirFilterListCtrl_DoThaw(PyObject *sipSelf, PyObject *sipArgs)
{
    PyObject *sipParseErr = SIP_NULLPTR;
    bool sipSelfWasArg = (!sipSelf || sipIsDerivedClass((sipSimpleWrapper *)sipSelf));

    {
        sipwxDirFilterListCtrl *sipCpp;

        if (sipParseArgs(&sipParseErr, sipArgs, "B", &sipSelf, sipType_wxDirFilterListCtrl, &sipCpp))
        {
            PyErr_Clear();

            Py_BEGIN_ALLOW_THREADS
            sipCpp->sipProtectVirt_DoThaw(sipSelfWasArg);
            Py_END_ALLOW_THREADS

            if (PyErr_Occurred())
                return 0;

            Py_INCREF(Py_None);
            return Py_None;
        }
    }

    sipNoMethod(sipParseErr, sipName_DirFilterListCtrl, sipName_DoThaw, doc_wxDirFilterListCtrl_DoThaw);

    return SIP_NULLPTR;
}


PyDoc_STRVAR(doc_wxDirFilterListCtrl_HasTransparentBackground, "HasTransparentBackground(self) -> bool");

extern "C" {static PyObject *meth_wxDirFilterListCtrl_HasTransparentBackground(PyObject *, PyObject *);}
static PyObject *meth_wxDirFilterListCtrl_HasTransparentBackground(PyObject *sipSelf, PyObject *sipArgs)
{
    PyObject *sipParseErr = SIP_NULLPTR;
    bool sipSelfWasArg = (!sipSelf || sipIsDerivedClass((sipSimpleWrapper *)sipSelf));

    {
        sipwxDirFilterListCtrl *sipCpp;

        if (sipParseArgs(&sipParseErr, sipArgs, "B", &sipSelf, sipType_wxDirFilterListCtrl, &sipCpp))
        {
            bool sipRes;

            PyErr_Clear();

            Py_BEGIN_ALLOW_THREADS
            sipRes = sipCpp->sipProtectVirt_HasTransparentBackground(sipSelfWasArg);
            Py_END_ALLOW_THREADS

            if (PyErr_Occurred())
                return 0;

            return PyBool_FromLong(sipRes);
        }
    }

    sipNoMethod(sipParseErr, sipName_DirFilterListCtrl, sipName_HasTransparentBackground, doc_wxDirFilterListCtrl_HasTransparentBackground);

    return SIP_NULLPTR;
}


PyDoc_STRVAR(doc_wxDirFilterListCtrl_TryBefore, "TryBefore(self, event: Event) -> bool");

extern "C" {static PyObject *meth_wxDirFilterListCtrl_TryBefore(PyObject *, PyObject *, PyObject *);}
static PyObject *meth_wxDirFilterListCtrl_TryBefore(PyObject *sipSelf, PyObject *sipArgs, PyObject *sipKwds)
{
    PyObject *sipParseErr = SIP_NULLPTR;
    bool sipSelfWasArg = (!sipSelf || sipIsDerivedClass((sipSimpleWrapper *)sipSelf));

    {
        ::wxEvent* event;
        sipwxDirFilterListCtrl *sipCpp;

        static const char *sipKwdList[] = {
            sipName_event,
        };

        if (sipParseKwdArgs(&sipParseErr, sipArgs, sipKwds, sipKwdList, SIP_NULLPTR, "BJ9", &sipSelf, sipType_wxDirFilterListCtrl, &sipCpp, sipType_wxEvent, &event))
        {
            bool sipRes;

            PyErr_Clear();

            Py_BEGIN_ALLOW_THREADS
            sipRes = sipCpp->sipProtectVirt_TryBefore(sipSelfWasArg, *event);
            Py_END_ALLOW_THREADS

            if (PyErr_Occurred())
                return 0;

            return PyBool_FromLong(sipRes);
        }
    }

    sipNoMethod(sipParseErr, sipName_DirFilterListCtrl, sipName_TryBefore, doc_wxDirFilterListCtrl_TryBefore);

    return SIP_NULLPTR;
}


PyDoc_STRVAR(doc_wxDirFilterListCtrl_TryAfter, "TryAfter(self, event: Event) -> bool");

extern "C" {static PyObject *meth_wxDirFilterListCtrl_TryAfter(PyObject *, PyObject *, PyObject *);}
static PyObject *meth_wxDirFilterListCtrl_TryAfter(PyObject *sipSelf, PyObject *sipArgs, PyObject *sipKwds)
{
    PyObject *sipParseErr = SIP_NULLPTR;
    bool sipSelfWasArg = (!sipSelf || sipIsDerivedClass((sipSimpleWrapper *)sipSelf));

    {
        ::wxEvent* event;
        sipwxDirFilterListCtrl *sipCpp;

        static const char *sipKwdList[] = {
            sipName_event,
        };

        if (sipParseKwdArgs(&sipParseErr, sipArgs, sipKwds, sipKwdList, SIP_NULLPTR, "BJ9", &sipSelf, sipType_wxDirFilterListCtrl, &sipCpp, sipType_wxEvent, &event))
        {
            bool sipRes;

            PyErr_Clear();

            Py_BEGIN_ALLOW_THREADS
            sipRes = sipCpp->sipProtectVirt_TryAfter(sipSelfWasArg, *event);
            Py_END_ALLOW_THREADS

            if (PyErr_Occurred())
                return 0;

            return PyBool_FromLong(sipRes);
        }
    }

    sipNoMethod(sipParseErr, sipName_DirFilterListCtrl, sipName_TryAfter, doc_wxDirFilterListCtrl_TryAfter);

    return SIP_NULLPTR;
}


PyDoc_STRVAR(doc_wxDirFilterListCtrl_Create, "Create(parent, id=ID_ANY, pos=DefaultPosition, size=DefaultSize, style=0) -> bool");

extern "C" {static PyObject *meth_wxDirFilterListCtrl_Create(PyObject *, PyObject *, PyObject *);}
static PyObject *meth_wxDirFilterListCtrl_Create(PyObject *sipSelf, PyObject *sipArgs, PyObject *sipKwds)
{
    PyObject *sipParseErr = SIP_NULLPTR;

    {
        ::wxGenericDirCtrl* parent;
        ::wxWindowID id = wxID_ANY;
        const ::wxPoint& posdef = wxDefaultPosition;
        const ::wxPoint* pos = &posdef;
        int posState = 0;
        const ::wxSize& sizedef = wxDefaultSize;
        const ::wxSize* size = &sizedef;
        int sizeState = 0;
        long style = 0;
        ::wxDirFilterListCtrl *sipCpp;

        static const char *sipKwdList[] = {
            sipName_parent,
            sipName_id,
            sipName_pos,
            sipName_size,
            sipName_style,
        };

        if (sipParseKwdArgs(&sipParseErr, sipArgs, sipKwds, sipKwdList, SIP_NULLPTR, "BJ8|iJ1J1l", &sipSelf, sipType_wxDirFilterListCtrl, &sipCpp, sipType_wxGenericDirCtrl, &parent, &id, sipType_wxPoint, &pos, &posState, sipType_wxSize, &size, &sizeState, &style))
        {
            bool sipRes;

            PyErr_Clear();

            Py_BEGIN_ALLOW_THREADS
            sipRes = sipCpp->Create(parent, id, *pos, *size, style);
            Py_END_ALLOW_THREADS
            sipReleaseType(const_cast< ::wxPoint *>(pos), sipType_wxPoint, posState);
            sipReleaseType(const_cast< ::wxSize *>(size), sipType_wxSize, sizeState);

            if (PyErr_Occurred())
                return 0;

            return PyBool_FromLong(sipRes);
        }
    }

    sipNoMethod(sipParseErr, sipName_DirFilterListCtrl, sipName_Create, SIP_NULLPTR);

    return SIP_NULLPTR;
}


PyDoc_STRVAR(doc_wxDirFilterListCtrl_Init, "Init()");

extern "C" {static PyObject *meth_wxDirFilterListCtrl_Init(PyObject *, PyObject *);}
static PyObject *meth_wxDirFilterListCtrl_Init(PyObject *sipSelf, PyObject *sipArgs)
{
    PyObject *sipParseErr = SIP_NULLPTR;

    {
        ::wxDirFilterListCtrl *sipCpp;

        if (sipParseArgs(&sipParseErr, sipArgs, "B", &sipSelf, sipType_wxDirFilterListCtrl, &sipCpp))
        {
            PyErr_Clear();

            Py_BEGIN_ALLOW_THREADS
            sipCpp->Init();
            Py_END_ALLOW_THREADS

            if (PyErr_Occurred())
                return 0;

            Py_INCREF(Py_None);
            return Py_None;
        }
    }

    sipNoMethod(sipParseErr, sipName_DirFilterListCtrl, sipName_Init, SIP_NULLPTR);

    return SIP_NULLPTR;
}


PyDoc_STRVAR(doc_wxDirFilterListCtrl_FillFilterList, "FillFilterList(filter, defaultFilter)");

extern "C" {static PyObject *meth_wxDirFilterListCtrl_FillFilterList(PyObject *, PyObject *, PyObject *);}
static PyObject *meth_wxDirFilterListCtrl_FillFilterList(PyObject *sipSelf, PyObject *sipArgs, PyObject *sipKwds)
{
    PyObject *sipParseErr = SIP_NULLPTR;

    {
        const ::wxString* filter;
        int filterState = 0;
        int defaultFilter;
        ::wxDirFilterListCtrl *sipCpp;

        static const char *sipKwdList[] = {
            sipName_filter,
            sipName_defaultFilter,
        };

        if (sipParseKwdArgs(&sipParseErr, sipArgs, sipKwds, sipKwdList, SIP_NULLPTR, "BJ1i", &sipSelf, sipType_wxDirFilterListCtrl, &sipCpp, sipType_wxString, &filter, &filterState, &defaultFilter))
        {
            PyErr_Clear();

            Py_BEGIN_ALLOW_THREADS
            sipCpp->FillFilterList(*filter, defaultFilter);
            Py_END_ALLOW_THREADS
            sipReleaseType(const_cast< ::wxString *>(filter), sipType_wxString, filterState);

            if (PyErr_Occurred())
                return 0;

            Py_INCREF(Py_None);
            return Py_None;
        }
    }

    sipNoMethod(sipParseErr, sipName_DirFilterListCtrl, sipName_FillFilterList, SIP_NULLPTR);

    return SIP_NULLPTR;
}


/* Cast a pointer to a type somewhere in its inheritance hierarchy. */
extern "C" {static void *cast_wxDirFilterListCtrl(void *, const sipTypeDef *);}
static void *cast_wxDirFilterListCtrl(void *sipCppV, const sipTypeDef *targetType)
{
    ::wxDirFilterListCtrl *sipCpp = reinterpret_cast< ::wxDirFilterListCtrl *>(sipCppV);

    if (targetType == sipType_wxDirFilterListCtrl)
        return sipCppV;

    sipCppV = ((const sipClassTypeDef *)sipType_wxChoice)->ctd_cast(static_cast< ::wxChoice *>(sipCpp), targetType);
    if (sipCppV)
        return sipCppV;

    return SIP_NULLPTR;
}


/* Call the instance's destructor. */
extern "C" {static void release_wxDirFilterListCtrl(void *, int);}
static void release_wxDirFilterListCtrl(void *sipCppV, int sipState)
{
    Py_BEGIN_ALLOW_THREADS

    if (sipState & SIP_DERIVED_CLASS)
        delete reinterpret_cast<sipwxDirFilterListCtrl *>(sipCppV);
    else
        delete reinterpret_cast< ::wxDirFilterListCtrl *>(sipCppV);

    Py_END_ALLOW_THREADS
}


extern "C" {static void *array_wxDirFilterListCtrl(Py_ssize_t);}
static void *array_wxDirFilterListCtrl(Py_ssize_t sipNrElem)
{
    return new ::wxDirFilterListCtrl[sipNrElem];
}


extern "C" {static void array_delete_wxDirFilterListCtrl(void *);}
static void array_delete_wxDirFilterListCtrl(void *sipCpp)
{
    delete[] reinterpret_cast< ::wxDirFilterListCtrl *>(sipCpp);
}


extern "C" {static void dealloc_wxDirFilterListCtrl(sipSimpleWrapper *);}
static void dealloc_wxDirFilterListCtrl(sipSimpleWrapper *sipSelf)
{
    if (sipIsDerivedClass(sipSelf))
        reinterpret_cast<sipwxDirFilterListCtrl *>(sipGetAddress(sipSelf))->sipPySelf = SIP_NULLPTR;

    if (sipIsOwnedByPython(sipSelf))
    {
        release_wxDirFilterListCtrl(sipGetAddress(sipSelf), sipIsDerivedClass(sipSelf));
    }
}


extern "C" {static void *init_type_wxDirFilterListCtrl(sipSimpleWrapper *, PyObject *, PyObject *, PyObject **, PyObject **, PyObject **);}
static void *init_type_wxDirFilterListCtrl(sipSimpleWrapper *sipSelf, PyObject *sipArgs, PyObject *sipKwds, PyObject **sipUnused, PyObject **, PyObject **sipParseErr)
{
    sipwxDirFilterListCtrl *sipCpp = SIP_NULLPTR;

    {
        if (sipParseKwdArgs(sipParseErr, sipArgs, sipKwds, SIP_NULLPTR, sipUnused, ""))
        {
            PyErr_Clear();

            Py_BEGIN_ALLOW_THREADS
            sipCpp = new sipwxDirFilterListCtrl();
            Py_END_ALLOW_THREADS

            if (PyErr_Occurred())
            {
                delete sipCpp;
                return SIP_NULLPTR;
            }

            sipCpp->sipPySelf = sipSelf;

            return sipCpp;
        }
    }

    {
        ::wxGenericDirCtrl* parent;
        ::wxWindowID id = wxID_ANY;
        const ::wxPoint& posdef = wxDefaultPosition;
        const ::wxPoint* pos = &posdef;
        int posState = 0;
        const ::wxSize& sizedef = wxDefaultSize;
        const ::wxSize* size = &sizedef;
        int sizeState = 0;
        long style = 0;

        static const char *sipKwdList[] = {
            sipName_parent,
            sipName_id,
            sipName_pos,
            sipName_size,
            sipName_style,
        };

        if (sipParseKwdArgs(sipParseErr, sipArgs, sipKwds, sipKwdList, sipUnused, "J8|iJ1J1l", sipType_wxGenericDirCtrl, &parent, &id, sipType_wxPoint, &pos, &posState, sipType_wxSize, &size, &sizeState, &style))
        {
            PyErr_Clear();

            Py_BEGIN_ALLOW_THREADS
            sipCpp = new sipwxDirFilterListCtrl(parent, id, *pos, *size, style);
            Py_END_ALLOW_THREADS
            sipReleaseType(const_cast< ::wxPoint *>(pos), sipType_wxPoint, posState);
            sipReleaseType(const_cast< ::wxSize *>(size), sipType_wxSize, sizeState);

            if (PyErr_Occurred())
            {
                delete sipCpp;
                return SIP_NULLPTR;
            }

            sipCpp->sipPySelf = sipSelf;

            return sipCpp;
        }
    }

    return SIP_NULLPTR;
}


/* Define this type's super-types. */
static sipEncodedTypeDef supers_wxDirFilterListCtrl[] = {{58, 255, 1}};


static PyMethodDef methods_wxDirFilterListCtrl[] = {
    {sipName_Create, SIP_MLMETH_CAST(meth_wxDirFilterListCtrl_Create), METH_VARARGS|METH_KEYWORDS, doc_wxDirFilterListCtrl_Create},
    {sipName_DoEnable, SIP_MLMETH_CAST(meth_wxDirFilterListCtrl_DoEnable), METH_VARARGS|METH_KEYWORDS, SIP_NULLPTR},
    {sipName_DoFreeze, meth_wxDirFilterListCtrl_DoFreeze, METH_VARARGS, SIP_NULLPTR},
    {sipName_DoGetBestClientSize, meth_wxDirFilterListCtrl_DoGetBestClientSize, METH_VARARGS, SIP_NULLPTR},
    {sipName_DoGetBestSize, meth_wxDirFilterListCtrl_DoGetBestSize, METH_VARARGS, SIP_NULLPTR},
    {sipName_DoGetBorderSize, meth_wxDirFilterListCtrl_DoGetBorderSize, METH_VARARGS, SIP_NULLPTR},
    {sipName_DoGetClientSize, SIP_MLMETH_CAST(meth_wxDirFilterListCtrl_DoGetClientSize), METH_VARARGS|METH_KEYWORDS, SIP_NULLPTR},
    {sipName_DoGetPosition, SIP_MLMETH_CAST(meth_wxDirFilterListCtrl_DoGetPosition), METH_VARARGS|METH_KEYWORDS, SIP_NULLPTR},
    {sipName_DoGetSize, SIP_MLMETH_CAST(meth_wxDirFilterListCtrl_DoGetSize), METH_VARARGS|METH_KEYWORDS, SIP_NULLPTR},
    {sipName_DoMoveWindow, SIP_MLMETH_CAST(meth_wxDirFilterListCtrl_DoMoveWindow), METH_VARARGS|METH_KEYWORDS, SIP_NULLPTR},
    {sipName_DoSetClientSize, SIP_MLMETH_CAST(meth_wxDirFilterListCtrl_DoSetClientSize), METH_VARARGS|METH_KEYWORDS, SIP_NULLPTR},
    {sipName_DoSetSize, SIP_MLMETH_CAST(meth_wxDirFilterListCtrl_DoSetSize), METH_VARARGS|METH_KEYWORDS, SIP_NULLPTR},
    {sipName_DoSetSizeHints, SIP_MLMETH_CAST(meth_wxDirFilterListCtrl_DoSetSizeHints), METH_VARARGS|METH_KEYWORDS, SIP_NULLPTR},
    {sipName_DoSetWindowVariant, SIP_MLMETH_CAST(meth_wxDirFilterListCtrl_DoSetWindowVariant), METH_VARARGS|METH_KEYWORDS, SIP_NULLPTR},
    {sipName_DoThaw, meth_wxDirFilterListCtrl_DoThaw, METH_VARARGS, SIP_NULLPTR},
    {sipName_FillFilterList, SIP_MLMETH_CAST(meth_wxDirFilterListCtrl_FillFilterList), METH_VARARGS|METH_KEYWORDS, doc_wxDirFilterListCtrl_FillFilterList},
    {sipName_GetDefaultBorder, meth_wxDirFilterListCtrl_GetDefaultBorder, METH_VARARGS, SIP_NULLPTR},
    {sipName_GetDefaultBorderForControl, meth_wxDirFilterListCtrl_GetDefaultBorderForControl, METH_VARARGS, SIP_NULLPTR},
    {sipName_HasTransparentBackground, meth_wxDirFilterListCtrl_HasTransparentBackground, METH_VARARGS, SIP_NULLPTR},
    {sipName_Init, meth_wxDirFilterListCtrl_Init, METH_VARARGS, doc_wxDirFilterListCtrl_Init},
    {sipName_ProcessEvent, SIP_MLMETH_CAST(meth_wxDirFilterListCtrl_ProcessEvent), METH_VARARGS|METH_KEYWORDS, SIP_NULLPTR},
    {sipName_SendDestroyEvent, meth_wxDirFilterListCtrl_SendDestroyEvent, METH_VARARGS, SIP_NULLPTR},
    {sipName_TryAfter, SIP_MLMETH_CAST(meth_wxDirFilterListCtrl_TryAfter), METH_VARARGS|METH_KEYWORDS, SIP_NULLPTR},
    {sipName_TryBefore, SIP_MLMETH_CAST(meth_wxDirFilterListCtrl_TryBefore), METH_VARARGS|METH_KEYWORDS, SIP_NULLPTR}
};

PyDoc_STRVAR(doc_wxDirFilterListCtrl, "DirFilterListCtrl()\n"
"DirFilterListCtrl(parent, id=ID_ANY, pos=DefaultPosition, size=DefaultSize, style=0)");


sipClassTypeDef sipTypeDef__core_wxDirFilterListCtrl = {
    {
        -1,
        SIP_NULLPTR,
        SIP_NULLPTR,
        SIP_TYPE_SCC|SIP_TYPE_CLASS,
        sipNameNr_wxDirFilterListCtrl,
        SIP_NULLPTR,
        SIP_NULLPTR,
    },
    {
        sipNameNr_DirFilterListCtrl,
        {0, 0, 1},
        24, methods_wxDirFilterListCtrl,
        0, SIP_NULLPTR,
        0, SIP_NULLPTR,
        {SIP_NULLPTR, SIP_NULLPTR, SIP_NULLPTR, SIP_NULLPTR, SIP_NULLPTR, SIP_NULLPTR, SIP_NULLPTR, SIP_NULLPTR, SIP_NULLPTR, SIP_NULLPTR},
    },
    doc_wxDirFilterListCtrl,
    -1,
    -1,
    supers_wxDirFilterListCtrl,
    SIP_NULLPTR,
    init_type_wxDirFilterListCtrl,
    SIP_NULLPTR,
    SIP_NULLPTR,
    SIP_NULLPTR,
    SIP_NULLPTR,
    dealloc_wxDirFilterListCtrl,
    SIP_NULLPTR,
    array_wxDirFilterListCtrl,
    SIP_NULLPTR,
    release_wxDirFilterListCtrl,
    cast_wxDirFilterListCtrl,
    SIP_NULLPTR,
    SIP_NULLPTR,
    SIP_NULLPTR,
    SIP_NULLPTR,
    SIP_NULLPTR,
    SIP_NULLPTR,
    array_delete_wxDirFilterListCtrl,
    sizeof (::wxDirFilterListCtrl),
};
