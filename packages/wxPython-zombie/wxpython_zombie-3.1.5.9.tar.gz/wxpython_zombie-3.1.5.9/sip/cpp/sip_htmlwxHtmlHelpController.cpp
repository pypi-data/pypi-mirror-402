/*
 * Interface wrapper code.
 *
 * Generated by SIP 6.15.1
 */

#include "sipAPI_html.h"

        #include <wx/html/helpctrl.h>

        #include <wx/window.h>
        #include <wx/html/helpfrm.h>
        #include <wx/html/helpdata.h>
        #include <wx/html/helpdlg.h>
        #include <wx/gdicmn.h>
        #include <wx/gdicmn.h>
        #include <wx/html/helpwnd.h>
        #include <wx/config.h>
        #include <wx/frame.h>
        #include <wx/object.h>
        #include <wx/object.h>
        #include <wx/object.h>


class sipwxHtmlHelpController : public ::wxHtmlHelpController
{
public:
    sipwxHtmlHelpController(int, ::wxWindow*);
    sipwxHtmlHelpController(::wxWindow*, int);
    virtual ~sipwxHtmlHelpController();

    /*
     * There is a public method for every protected method visible from
     * this class.
     */
    ::wxHtmlHelpDialog* sipProtectVirt_CreateHelpDialog(bool, ::wxHtmlHelpData*);
    ::wxHtmlHelpFrame* sipProtectVirt_CreateHelpFrame(bool, ::wxHtmlHelpData*);

    /*
     * There is a protected method for every virtual method visible from
     * this class.
     */
protected:
    ::wxHtmlHelpFrame* CreateHelpFrame(::wxHtmlHelpData*) SIP_OVERRIDE;
    ::wxHtmlHelpDialog* CreateHelpDialog(::wxHtmlHelpData*) SIP_OVERRIDE;
    bool Initialize(const ::wxString&, int) SIP_OVERRIDE;
    void WriteCustomization(::wxConfigBase*, const ::wxString&) SIP_OVERRIDE;
    void ReadCustomization(::wxConfigBase*, const ::wxString&) SIP_OVERRIDE;
    bool DisplayBlock(long) SIP_OVERRIDE;
    bool DisplayContents() SIP_OVERRIDE;
    bool DisplayContextPopup(int) SIP_OVERRIDE;
    bool DisplaySection(const ::wxString&) SIP_OVERRIDE;
    bool DisplaySection(int) SIP_OVERRIDE;
    bool DisplayTextPopup(const ::wxString&, const ::wxPoint&) SIP_OVERRIDE;
    ::wxFrame* GetFrameParameters(::wxSize*, ::wxPoint*, bool*) SIP_OVERRIDE;
    ::wxWindow* GetParentWindow() const SIP_OVERRIDE;
    bool Initialize(const ::wxString&) SIP_OVERRIDE;
    bool KeywordSearch(const ::wxString&, ::wxHelpSearchMode) SIP_OVERRIDE;
    bool LoadFile(const ::wxString&) SIP_OVERRIDE;
    void OnQuit() SIP_OVERRIDE;
    bool Quit() SIP_OVERRIDE;
    void SetFrameParameters(const ::wxString&, const ::wxSize&, const ::wxPoint&, bool) SIP_OVERRIDE;
    void SetParentWindow(::wxWindow*) SIP_OVERRIDE;
    void SetViewer(const ::wxString&, long) SIP_OVERRIDE;

public:
    sipSimpleWrapper *sipPySelf;

private:
    sipwxHtmlHelpController(const sipwxHtmlHelpController &);
    sipwxHtmlHelpController &operator = (const sipwxHtmlHelpController &);

    char sipPyMethods[21];
};

sipwxHtmlHelpController::sipwxHtmlHelpController(int style, ::wxWindow*parentWindow): ::wxHtmlHelpController(style, parentWindow), sipPySelf(SIP_NULLPTR)
{
    memset(sipPyMethods, 0, sizeof (sipPyMethods));
}

sipwxHtmlHelpController::sipwxHtmlHelpController(::wxWindow*parentWindow, int style): ::wxHtmlHelpController(parentWindow, style), sipPySelf(SIP_NULLPTR)
{
    memset(sipPyMethods, 0, sizeof (sipPyMethods));
}

sipwxHtmlHelpController::~sipwxHtmlHelpController()
{
    sipInstanceDestroyedEx(&sipPySelf);
}

::wxHtmlHelpFrame* sipwxHtmlHelpController::CreateHelpFrame(::wxHtmlHelpData*data)
{
    sip_gilstate_t sipGILState;
    PyObject *sipMeth;

    sipMeth = sipIsPyMethod(&sipGILState, &sipPyMethods[0], &sipPySelf, SIP_NULLPTR, sipName_CreateHelpFrame);

    if (!sipMeth)
        return ::wxHtmlHelpController::CreateHelpFrame(data);

    extern ::wxHtmlHelpFrame* sipVH__html_75(sip_gilstate_t, sipVirtErrorHandlerFunc, sipSimpleWrapper *, PyObject *, ::wxHtmlHelpData*);

    return sipVH__html_75(sipGILState, 0, sipPySelf, sipMeth, data);
}

::wxHtmlHelpDialog* sipwxHtmlHelpController::CreateHelpDialog(::wxHtmlHelpData*data)
{
    sip_gilstate_t sipGILState;
    PyObject *sipMeth;

    sipMeth = sipIsPyMethod(&sipGILState, &sipPyMethods[1], &sipPySelf, SIP_NULLPTR, sipName_CreateHelpDialog);

    if (!sipMeth)
        return ::wxHtmlHelpController::CreateHelpDialog(data);

    extern ::wxHtmlHelpDialog* sipVH__html_74(sip_gilstate_t, sipVirtErrorHandlerFunc, sipSimpleWrapper *, PyObject *, ::wxHtmlHelpData*);

    return sipVH__html_74(sipGILState, 0, sipPySelf, sipMeth, data);
}

bool sipwxHtmlHelpController::Initialize(const ::wxString& file, int server)
{
    sip_gilstate_t sipGILState;
    PyObject *sipMeth;

    sipMeth = sipIsPyMethod(&sipGILState, &sipPyMethods[2], &sipPySelf, SIP_NULLPTR, sipName_Initialize);

    if (!sipMeth)
        return ::wxHtmlHelpController::Initialize(file, server);

    extern bool sipVH__html_73(sip_gilstate_t, sipVirtErrorHandlerFunc, sipSimpleWrapper *, PyObject *, const ::wxString&, int);

    return sipVH__html_73(sipGILState, 0, sipPySelf, sipMeth, file, server);
}

void sipwxHtmlHelpController::WriteCustomization(::wxConfigBase*cfg, const ::wxString& path)
{
    sip_gilstate_t sipGILState;
    PyObject *sipMeth;

    sipMeth = sipIsPyMethod(&sipGILState, &sipPyMethods[3], &sipPySelf, SIP_NULLPTR, sipName_WriteCustomization);

    if (!sipMeth)
    {
        ::wxHtmlHelpController::WriteCustomization(cfg, path);
        return;
    }

    extern void sipVH__html_72(sip_gilstate_t, sipVirtErrorHandlerFunc, sipSimpleWrapper *, PyObject *, ::wxConfigBase*, const ::wxString&);

    sipVH__html_72(sipGILState, 0, sipPySelf, sipMeth, cfg, path);
}

void sipwxHtmlHelpController::ReadCustomization(::wxConfigBase*cfg, const ::wxString& path)
{
    sip_gilstate_t sipGILState;
    PyObject *sipMeth;

    sipMeth = sipIsPyMethod(&sipGILState, &sipPyMethods[4], &sipPySelf, SIP_NULLPTR, sipName_ReadCustomization);

    if (!sipMeth)
    {
        ::wxHtmlHelpController::ReadCustomization(cfg, path);
        return;
    }

    extern void sipVH__html_72(sip_gilstate_t, sipVirtErrorHandlerFunc, sipSimpleWrapper *, PyObject *, ::wxConfigBase*, const ::wxString&);

    sipVH__html_72(sipGILState, 0, sipPySelf, sipMeth, cfg, path);
}

bool sipwxHtmlHelpController::DisplayBlock(long blockNo)
{
    sip_gilstate_t sipGILState;
    PyObject *sipMeth;

    sipMeth = sipIsPyMethod(&sipGILState, &sipPyMethods[5], &sipPySelf, SIP_NULLPTR, sipName_DisplayBlock);

    if (!sipMeth)
        return ::wxHtmlHelpController::DisplayBlock(blockNo);

    extern bool sipVH__html_71(sip_gilstate_t, sipVirtErrorHandlerFunc, sipSimpleWrapper *, PyObject *, long);

    return sipVH__html_71(sipGILState, 0, sipPySelf, sipMeth, blockNo);
}

bool sipwxHtmlHelpController::DisplayContents()
{
    sip_gilstate_t sipGILState;
    PyObject *sipMeth;

    sipMeth = sipIsPyMethod(&sipGILState, &sipPyMethods[6], &sipPySelf, SIP_NULLPTR, sipName_DisplayContents);

    if (!sipMeth)
        return ::wxHtmlHelpController::DisplayContents();

    extern bool sipVH__html_35(sip_gilstate_t, sipVirtErrorHandlerFunc, sipSimpleWrapper *, PyObject *);

    return sipVH__html_35(sipGILState, 0, sipPySelf, sipMeth);
}

bool sipwxHtmlHelpController::DisplayContextPopup(int contextId)
{
    sip_gilstate_t sipGILState;
    PyObject *sipMeth;

    sipMeth = sipIsPyMethod(&sipGILState, &sipPyMethods[7], &sipPySelf, SIP_NULLPTR, sipName_DisplayContextPopup);

    if (!sipMeth)
        return ::wxHtmlHelpController::DisplayContextPopup(contextId);

    extern bool sipVH__html_56(sip_gilstate_t, sipVirtErrorHandlerFunc, sipSimpleWrapper *, PyObject *, int);

    return sipVH__html_56(sipGILState, 0, sipPySelf, sipMeth, contextId);
}

bool sipwxHtmlHelpController::DisplaySection(const ::wxString& section)
{
    sip_gilstate_t sipGILState;
    PyObject *sipMeth;

    sipMeth = sipIsPyMethod(&sipGILState, &sipPyMethods[8], &sipPySelf, SIP_NULLPTR, sipName_DisplaySection);

    if (!sipMeth)
        return ::wxHtmlHelpController::DisplaySection(section);

    extern bool sipVH__html_67(sip_gilstate_t, sipVirtErrorHandlerFunc, sipSimpleWrapper *, PyObject *, const ::wxString&);

    return sipVH__html_67(sipGILState, 0, sipPySelf, sipMeth, section);
}

bool sipwxHtmlHelpController::DisplaySection(int sectionNo)
{
    sip_gilstate_t sipGILState;
    PyObject *sipMeth;

    sipMeth = sipIsPyMethod(&sipGILState, &sipPyMethods[9], &sipPySelf, SIP_NULLPTR, sipName_DisplaySection);

    if (!sipMeth)
        return ::wxHtmlHelpController::DisplaySection(sectionNo);

    extern bool sipVH__html_56(sip_gilstate_t, sipVirtErrorHandlerFunc, sipSimpleWrapper *, PyObject *, int);

    return sipVH__html_56(sipGILState, 0, sipPySelf, sipMeth, sectionNo);
}

bool sipwxHtmlHelpController::DisplayTextPopup(const ::wxString& text, const ::wxPoint& pos)
{
    sip_gilstate_t sipGILState;
    PyObject *sipMeth;

    sipMeth = sipIsPyMethod(&sipGILState, &sipPyMethods[10], &sipPySelf, SIP_NULLPTR, sipName_DisplayTextPopup);

    if (!sipMeth)
        return ::wxHtmlHelpController::DisplayTextPopup(text, pos);

    extern bool sipVH__html_70(sip_gilstate_t, sipVirtErrorHandlerFunc, sipSimpleWrapper *, PyObject *, const ::wxString&, const ::wxPoint&);

    return sipVH__html_70(sipGILState, 0, sipPySelf, sipMeth, text, pos);
}

::wxFrame* sipwxHtmlHelpController::GetFrameParameters(::wxSize*size, ::wxPoint*pos, bool*newFrameEachTime)
{
    sip_gilstate_t sipGILState;
    PyObject *sipMeth;

    sipMeth = sipIsPyMethod(&sipGILState, &sipPyMethods[11], &sipPySelf, SIP_NULLPTR, sipName_GetFrameParameters);

    if (!sipMeth)
        return ::wxHtmlHelpController::GetFrameParameters(size, pos, newFrameEachTime);

    extern ::wxFrame* sipVH__html_69(sip_gilstate_t, sipVirtErrorHandlerFunc, sipSimpleWrapper *, PyObject *, ::wxSize*, ::wxPoint*, bool*);

    return sipVH__html_69(sipGILState, 0, sipPySelf, sipMeth, size, pos, newFrameEachTime);
}

::wxWindow* sipwxHtmlHelpController::GetParentWindow() const
{
    sip_gilstate_t sipGILState;
    PyObject *sipMeth;

    sipMeth = sipIsPyMethod(&sipGILState, const_cast<char *>(&sipPyMethods[12]), const_cast<sipSimpleWrapper **>(&sipPySelf), SIP_NULLPTR, sipName_GetParentWindow);

    if (!sipMeth)
        return ::wxHtmlHelpController::GetParentWindow();

    extern ::wxWindow* sipVH__html_28(sip_gilstate_t, sipVirtErrorHandlerFunc, sipSimpleWrapper *, PyObject *);

    return sipVH__html_28(sipGILState, 0, sipPySelf, sipMeth);
}

bool sipwxHtmlHelpController::Initialize(const ::wxString& file)
{
    sip_gilstate_t sipGILState;
    PyObject *sipMeth;

    sipMeth = sipIsPyMethod(&sipGILState, &sipPyMethods[13], &sipPySelf, SIP_NULLPTR, sipName_Initialize);

    if (!sipMeth)
        return ::wxHtmlHelpController::Initialize(file);

    extern bool sipVH__html_67(sip_gilstate_t, sipVirtErrorHandlerFunc, sipSimpleWrapper *, PyObject *, const ::wxString&);

    return sipVH__html_67(sipGILState, 0, sipPySelf, sipMeth, file);
}

bool sipwxHtmlHelpController::KeywordSearch(const ::wxString& keyword, ::wxHelpSearchMode mode)
{
    sip_gilstate_t sipGILState;
    PyObject *sipMeth;

    sipMeth = sipIsPyMethod(&sipGILState, &sipPyMethods[14], &sipPySelf, SIP_NULLPTR, sipName_KeywordSearch);

    if (!sipMeth)
        return ::wxHtmlHelpController::KeywordSearch(keyword, mode);

    extern bool sipVH__html_68(sip_gilstate_t, sipVirtErrorHandlerFunc, sipSimpleWrapper *, PyObject *, const ::wxString&, ::wxHelpSearchMode);

    return sipVH__html_68(sipGILState, 0, sipPySelf, sipMeth, keyword, mode);
}

bool sipwxHtmlHelpController::LoadFile(const ::wxString& file)
{
    sip_gilstate_t sipGILState;
    PyObject *sipMeth;

    sipMeth = sipIsPyMethod(&sipGILState, &sipPyMethods[15], &sipPySelf, SIP_NULLPTR, sipName_LoadFile);

    if (!sipMeth)
        return ::wxHtmlHelpController::LoadFile(file);

    extern bool sipVH__html_67(sip_gilstate_t, sipVirtErrorHandlerFunc, sipSimpleWrapper *, PyObject *, const ::wxString&);

    return sipVH__html_67(sipGILState, 0, sipPySelf, sipMeth, file);
}

void sipwxHtmlHelpController::OnQuit()
{
    sip_gilstate_t sipGILState;
    PyObject *sipMeth;

    sipMeth = sipIsPyMethod(&sipGILState, &sipPyMethods[16], &sipPySelf, SIP_NULLPTR, sipName_OnQuit);

    if (!sipMeth)
    {
        ::wxHtmlHelpController::OnQuit();
        return;
    }

    extern void sipVH__html_20(sip_gilstate_t, sipVirtErrorHandlerFunc, sipSimpleWrapper *, PyObject *);

    sipVH__html_20(sipGILState, 0, sipPySelf, sipMeth);
}

bool sipwxHtmlHelpController::Quit()
{
    sip_gilstate_t sipGILState;
    PyObject *sipMeth;

    sipMeth = sipIsPyMethod(&sipGILState, &sipPyMethods[17], &sipPySelf, SIP_NULLPTR, sipName_Quit);

    if (!sipMeth)
        return ::wxHtmlHelpController::Quit();

    extern bool sipVH__html_35(sip_gilstate_t, sipVirtErrorHandlerFunc, sipSimpleWrapper *, PyObject *);

    return sipVH__html_35(sipGILState, 0, sipPySelf, sipMeth);
}

void sipwxHtmlHelpController::SetFrameParameters(const ::wxString& titleFormat, const ::wxSize& size, const ::wxPoint& pos, bool newFrameEachTime)
{
    sip_gilstate_t sipGILState;
    PyObject *sipMeth;

    sipMeth = sipIsPyMethod(&sipGILState, &sipPyMethods[18], &sipPySelf, SIP_NULLPTR, sipName_SetFrameParameters);

    if (!sipMeth)
    {
        ::wxHtmlHelpController::SetFrameParameters(titleFormat, size, pos, newFrameEachTime);
        return;
    }

    extern void sipVH__html_66(sip_gilstate_t, sipVirtErrorHandlerFunc, sipSimpleWrapper *, PyObject *, const ::wxString&, const ::wxSize&, const ::wxPoint&, bool);

    sipVH__html_66(sipGILState, 0, sipPySelf, sipMeth, titleFormat, size, pos, newFrameEachTime);
}

void sipwxHtmlHelpController::SetParentWindow(::wxWindow*parentWindow)
{
    sip_gilstate_t sipGILState;
    PyObject *sipMeth;

    sipMeth = sipIsPyMethod(&sipGILState, &sipPyMethods[19], &sipPySelf, SIP_NULLPTR, sipName_SetParentWindow);

    if (!sipMeth)
    {
        ::wxHtmlHelpController::SetParentWindow(parentWindow);
        return;
    }

    extern void sipVH__html_65(sip_gilstate_t, sipVirtErrorHandlerFunc, sipSimpleWrapper *, PyObject *, ::wxWindow*);

    sipVH__html_65(sipGILState, 0, sipPySelf, sipMeth, parentWindow);
}

void sipwxHtmlHelpController::SetViewer(const ::wxString& viewer, long flags)
{
    sip_gilstate_t sipGILState;
    PyObject *sipMeth;

    sipMeth = sipIsPyMethod(&sipGILState, &sipPyMethods[20], &sipPySelf, SIP_NULLPTR, sipName_SetViewer);

    if (!sipMeth)
    {
        ::wxHtmlHelpController::SetViewer(viewer, flags);
        return;
    }

    extern void sipVH__html_64(sip_gilstate_t, sipVirtErrorHandlerFunc, sipSimpleWrapper *, PyObject *, const ::wxString&, long);

    sipVH__html_64(sipGILState, 0, sipPySelf, sipMeth, viewer, flags);
}

::wxHtmlHelpDialog* sipwxHtmlHelpController::sipProtectVirt_CreateHelpDialog(bool sipSelfWasArg, ::wxHtmlHelpData*data)
{
    return (sipSelfWasArg ? ::wxHtmlHelpController::CreateHelpDialog(data) : CreateHelpDialog(data));
}

::wxHtmlHelpFrame* sipwxHtmlHelpController::sipProtectVirt_CreateHelpFrame(bool sipSelfWasArg, ::wxHtmlHelpData*data)
{
    return (sipSelfWasArg ? ::wxHtmlHelpController::CreateHelpFrame(data) : CreateHelpFrame(data));
}


PyDoc_STRVAR(doc_wxHtmlHelpController_AddBook, "AddBook(bookFile, showWaitMsg=False) -> bool\n"
"AddBook(bookUrl, showWaitMsg=False) -> bool\n"
"\n"
"Adds a book (i.e.\n"
"");

extern "C" {static PyObject *meth_wxHtmlHelpController_AddBook(PyObject *, PyObject *, PyObject *);}
static PyObject *meth_wxHtmlHelpController_AddBook(PyObject *sipSelf, PyObject *sipArgs, PyObject *sipKwds)
{
    PyObject *sipParseErr = SIP_NULLPTR;

    {
        const ::wxFileName* bookFile;
        int bookFileState = 0;
        bool showWaitMsg = 0;
        ::wxHtmlHelpController *sipCpp;

        static const char *sipKwdList[] = {
            sipName_bookFile,
            sipName_showWaitMsg,
        };

        if (sipParseKwdArgs(&sipParseErr, sipArgs, sipKwds, sipKwdList, SIP_NULLPTR, "BJ1|b", &sipSelf, sipType_wxHtmlHelpController, &sipCpp, sipType_wxFileName, &bookFile, &bookFileState, &showWaitMsg))
        {
            bool sipRes;

            PyErr_Clear();

            Py_BEGIN_ALLOW_THREADS
            sipRes = sipCpp->AddBook(*bookFile, showWaitMsg);
            Py_END_ALLOW_THREADS
            sipReleaseType(const_cast< ::wxFileName *>(bookFile), sipType_wxFileName, bookFileState);

            if (PyErr_Occurred())
                return 0;

            return PyBool_FromLong(sipRes);
        }
    }

    {
        const ::wxString* bookUrl;
        int bookUrlState = 0;
        bool showWaitMsg = 0;
        ::wxHtmlHelpController *sipCpp;

        static const char *sipKwdList[] = {
            sipName_bookUrl,
            sipName_showWaitMsg,
        };

        if (sipParseKwdArgs(&sipParseErr, sipArgs, sipKwds, sipKwdList, SIP_NULLPTR, "BJ1|b", &sipSelf, sipType_wxHtmlHelpController, &sipCpp, sipType_wxString, &bookUrl, &bookUrlState, &showWaitMsg))
        {
            bool sipRes;

            PyErr_Clear();

            Py_BEGIN_ALLOW_THREADS
            sipRes = sipCpp->AddBook(*bookUrl, showWaitMsg);
            Py_END_ALLOW_THREADS
            sipReleaseType(const_cast< ::wxString *>(bookUrl), sipType_wxString, bookUrlState);

            if (PyErr_Occurred())
                return 0;

            return PyBool_FromLong(sipRes);
        }
    }

    sipNoMethod(sipParseErr, sipName_HtmlHelpController, sipName_AddBook, SIP_NULLPTR);

    return SIP_NULLPTR;
}


PyDoc_STRVAR(doc_wxHtmlHelpController_Display, "Display(x) -> bool\n"
"Display(id) -> bool\n"
"\n"
"Displays page x.\n"
"");

extern "C" {static PyObject *meth_wxHtmlHelpController_Display(PyObject *, PyObject *, PyObject *);}
static PyObject *meth_wxHtmlHelpController_Display(PyObject *sipSelf, PyObject *sipArgs, PyObject *sipKwds)
{
    PyObject *sipParseErr = SIP_NULLPTR;

    {
        const ::wxString* x;
        int xState = 0;
        ::wxHtmlHelpController *sipCpp;

        static const char *sipKwdList[] = {
            sipName_x,
        };

        if (sipParseKwdArgs(&sipParseErr, sipArgs, sipKwds, sipKwdList, SIP_NULLPTR, "BJ1", &sipSelf, sipType_wxHtmlHelpController, &sipCpp, sipType_wxString, &x, &xState))
        {
            bool sipRes;

            PyErr_Clear();

            Py_BEGIN_ALLOW_THREADS
            sipRes = sipCpp->Display(*x);
            Py_END_ALLOW_THREADS
            sipReleaseType(const_cast< ::wxString *>(x), sipType_wxString, xState);

            if (PyErr_Occurred())
                return 0;

            return PyBool_FromLong(sipRes);
        }
    }

    {
        int id;
        ::wxHtmlHelpController *sipCpp;

        static const char *sipKwdList[] = {
            sipName_id,
        };

        if (sipParseKwdArgs(&sipParseErr, sipArgs, sipKwds, sipKwdList, SIP_NULLPTR, "Bi", &sipSelf, sipType_wxHtmlHelpController, &sipCpp, &id))
        {
            bool sipRes;

            PyErr_Clear();

            Py_BEGIN_ALLOW_THREADS
            sipRes = sipCpp->Display(id);
            Py_END_ALLOW_THREADS

            if (PyErr_Occurred())
                return 0;

            return PyBool_FromLong(sipRes);
        }
    }

    sipNoMethod(sipParseErr, sipName_HtmlHelpController, sipName_Display, SIP_NULLPTR);

    return SIP_NULLPTR;
}


PyDoc_STRVAR(doc_wxHtmlHelpController_DisplayContents, "DisplayContents() -> bool\n"
"\n"
"Displays help window and focuses contents panel.");

extern "C" {static PyObject *meth_wxHtmlHelpController_DisplayContents(PyObject *, PyObject *);}
static PyObject *meth_wxHtmlHelpController_DisplayContents(PyObject *sipSelf, PyObject *sipArgs)
{
    PyObject *sipParseErr = SIP_NULLPTR;
    bool sipSelfWasArg = (!sipSelf || sipIsDerivedClass((sipSimpleWrapper *)sipSelf));

    {
        ::wxHtmlHelpController *sipCpp;

        if (sipParseArgs(&sipParseErr, sipArgs, "B", &sipSelf, sipType_wxHtmlHelpController, &sipCpp))
        {
            bool sipRes;

            PyErr_Clear();

            Py_BEGIN_ALLOW_THREADS
            sipRes = (sipSelfWasArg ? sipCpp->::wxHtmlHelpController::DisplayContents() : sipCpp->DisplayContents());
            Py_END_ALLOW_THREADS

            if (PyErr_Occurred())
                return 0;

            return PyBool_FromLong(sipRes);
        }
    }

    sipNoMethod(sipParseErr, sipName_HtmlHelpController, sipName_DisplayContents, SIP_NULLPTR);

    return SIP_NULLPTR;
}


PyDoc_STRVAR(doc_wxHtmlHelpController_DisplayIndex, "DisplayIndex() -> bool\n"
"\n"
"Displays help window and focuses index panel.");

extern "C" {static PyObject *meth_wxHtmlHelpController_DisplayIndex(PyObject *, PyObject *);}
static PyObject *meth_wxHtmlHelpController_DisplayIndex(PyObject *sipSelf, PyObject *sipArgs)
{
    PyObject *sipParseErr = SIP_NULLPTR;

    {
        ::wxHtmlHelpController *sipCpp;

        if (sipParseArgs(&sipParseErr, sipArgs, "B", &sipSelf, sipType_wxHtmlHelpController, &sipCpp))
        {
            bool sipRes;

            PyErr_Clear();

            Py_BEGIN_ALLOW_THREADS
            sipRes = sipCpp->DisplayIndex();
            Py_END_ALLOW_THREADS

            if (PyErr_Occurred())
                return 0;

            return PyBool_FromLong(sipRes);
        }
    }

    sipNoMethod(sipParseErr, sipName_HtmlHelpController, sipName_DisplayIndex, SIP_NULLPTR);

    return SIP_NULLPTR;
}


PyDoc_STRVAR(doc_wxHtmlHelpController_KeywordSearch, "KeywordSearch(keyword, mode=wx.HELP_SEARCH_ALL) -> bool\n"
"\n"
"Displays the help window, focuses search panel and starts searching.");

extern "C" {static PyObject *meth_wxHtmlHelpController_KeywordSearch(PyObject *, PyObject *, PyObject *);}
static PyObject *meth_wxHtmlHelpController_KeywordSearch(PyObject *sipSelf, PyObject *sipArgs, PyObject *sipKwds)
{
    PyObject *sipParseErr = SIP_NULLPTR;
    bool sipSelfWasArg = (!sipSelf || sipIsDerivedClass((sipSimpleWrapper *)sipSelf));

    {
        const ::wxString* keyword;
        int keywordState = 0;
        ::wxHelpSearchMode mode = wxHELP_SEARCH_ALL;
        ::wxHtmlHelpController *sipCpp;

        static const char *sipKwdList[] = {
            sipName_keyword,
            sipName_mode,
        };

        if (sipParseKwdArgs(&sipParseErr, sipArgs, sipKwds, sipKwdList, SIP_NULLPTR, "BJ1|E", &sipSelf, sipType_wxHtmlHelpController, &sipCpp, sipType_wxString, &keyword, &keywordState, sipType_wxHelpSearchMode, &mode))
        {
            bool sipRes;

            PyErr_Clear();

            Py_BEGIN_ALLOW_THREADS
            sipRes = (sipSelfWasArg ? sipCpp->::wxHtmlHelpController::KeywordSearch(*keyword, mode) : sipCpp->KeywordSearch(*keyword, mode));
            Py_END_ALLOW_THREADS
            sipReleaseType(const_cast< ::wxString *>(keyword), sipType_wxString, keywordState);

            if (PyErr_Occurred())
                return 0;

            return PyBool_FromLong(sipRes);
        }
    }

    sipNoMethod(sipParseErr, sipName_HtmlHelpController, sipName_KeywordSearch, SIP_NULLPTR);

    return SIP_NULLPTR;
}


PyDoc_STRVAR(doc_wxHtmlHelpController_ReadCustomization, "ReadCustomization(cfg, path=wx.EmptyString)\n"
"\n"
"Reads the controller's setting (position of window, etc.)");

extern "C" {static PyObject *meth_wxHtmlHelpController_ReadCustomization(PyObject *, PyObject *, PyObject *);}
static PyObject *meth_wxHtmlHelpController_ReadCustomization(PyObject *sipSelf, PyObject *sipArgs, PyObject *sipKwds)
{
    PyObject *sipParseErr = SIP_NULLPTR;
    bool sipSelfWasArg = (!sipSelf || sipIsDerivedClass((sipSimpleWrapper *)sipSelf));

    {
        ::wxConfigBase* cfg;
        const ::wxString& pathdef = wxEmptyString;
        const ::wxString* path = &pathdef;
        int pathState = 0;
        ::wxHtmlHelpController *sipCpp;

        static const char *sipKwdList[] = {
            sipName_cfg,
            sipName_path,
        };

        if (sipParseKwdArgs(&sipParseErr, sipArgs, sipKwds, sipKwdList, SIP_NULLPTR, "BJ8|J1", &sipSelf, sipType_wxHtmlHelpController, &sipCpp, sipType_wxConfigBase, &cfg, sipType_wxString, &path, &pathState))
        {
            PyErr_Clear();

            Py_BEGIN_ALLOW_THREADS
            (sipSelfWasArg ? sipCpp->::wxHtmlHelpController::ReadCustomization(cfg, *path) : sipCpp->ReadCustomization(cfg, *path));
            Py_END_ALLOW_THREADS
            sipReleaseType(const_cast< ::wxString *>(path), sipType_wxString, pathState);

            if (PyErr_Occurred())
                return 0;

            Py_INCREF(Py_None);
            return Py_None;
        }
    }

    sipNoMethod(sipParseErr, sipName_HtmlHelpController, sipName_ReadCustomization, SIP_NULLPTR);

    return SIP_NULLPTR;
}


PyDoc_STRVAR(doc_wxHtmlHelpController_SetShouldPreventAppExit, "SetShouldPreventAppExit(enable)\n"
"\n"
"Sets whether the help frame should prevent application from exiting if\n"
"it's the only remaining top level window.");

extern "C" {static PyObject *meth_wxHtmlHelpController_SetShouldPreventAppExit(PyObject *, PyObject *, PyObject *);}
static PyObject *meth_wxHtmlHelpController_SetShouldPreventAppExit(PyObject *sipSelf, PyObject *sipArgs, PyObject *sipKwds)
{
    PyObject *sipParseErr = SIP_NULLPTR;

    {
        bool enable;
        ::wxHtmlHelpController *sipCpp;

        static const char *sipKwdList[] = {
            sipName_enable,
        };

        if (sipParseKwdArgs(&sipParseErr, sipArgs, sipKwds, sipKwdList, SIP_NULLPTR, "Bb", &sipSelf, sipType_wxHtmlHelpController, &sipCpp, &enable))
        {
            PyErr_Clear();

            Py_BEGIN_ALLOW_THREADS
            sipCpp->SetShouldPreventAppExit(enable);
            Py_END_ALLOW_THREADS

            if (PyErr_Occurred())
                return 0;

            Py_INCREF(Py_None);
            return Py_None;
        }
    }

    sipNoMethod(sipParseErr, sipName_HtmlHelpController, sipName_SetShouldPreventAppExit, SIP_NULLPTR);

    return SIP_NULLPTR;
}


PyDoc_STRVAR(doc_wxHtmlHelpController_SetTempDir, "SetTempDir(path)\n"
"\n"
"Sets the path for storing temporary files - cached binary versions of\n"
"index and contents files.");

extern "C" {static PyObject *meth_wxHtmlHelpController_SetTempDir(PyObject *, PyObject *, PyObject *);}
static PyObject *meth_wxHtmlHelpController_SetTempDir(PyObject *sipSelf, PyObject *sipArgs, PyObject *sipKwds)
{
    PyObject *sipParseErr = SIP_NULLPTR;

    {
        const ::wxString* path;
        int pathState = 0;
        ::wxHtmlHelpController *sipCpp;

        static const char *sipKwdList[] = {
            sipName_path,
        };

        if (sipParseKwdArgs(&sipParseErr, sipArgs, sipKwds, sipKwdList, SIP_NULLPTR, "BJ1", &sipSelf, sipType_wxHtmlHelpController, &sipCpp, sipType_wxString, &path, &pathState))
        {
            PyErr_Clear();

            Py_BEGIN_ALLOW_THREADS
            sipCpp->SetTempDir(*path);
            Py_END_ALLOW_THREADS
            sipReleaseType(const_cast< ::wxString *>(path), sipType_wxString, pathState);

            if (PyErr_Occurred())
                return 0;

            Py_INCREF(Py_None);
            return Py_None;
        }
    }

    sipNoMethod(sipParseErr, sipName_HtmlHelpController, sipName_SetTempDir, SIP_NULLPTR);

    return SIP_NULLPTR;
}


PyDoc_STRVAR(doc_wxHtmlHelpController_SetTitleFormat, "SetTitleFormat(format)\n"
"\n"
"Sets format of title of the frame.");

extern "C" {static PyObject *meth_wxHtmlHelpController_SetTitleFormat(PyObject *, PyObject *, PyObject *);}
static PyObject *meth_wxHtmlHelpController_SetTitleFormat(PyObject *sipSelf, PyObject *sipArgs, PyObject *sipKwds)
{
    PyObject *sipParseErr = SIP_NULLPTR;

    {
        const ::wxString* format;
        int formatState = 0;
        ::wxHtmlHelpController *sipCpp;

        static const char *sipKwdList[] = {
            sipName_format,
        };

        if (sipParseKwdArgs(&sipParseErr, sipArgs, sipKwds, sipKwdList, SIP_NULLPTR, "BJ1", &sipSelf, sipType_wxHtmlHelpController, &sipCpp, sipType_wxString, &format, &formatState))
        {
            PyErr_Clear();

            Py_BEGIN_ALLOW_THREADS
            sipCpp->SetTitleFormat(*format);
            Py_END_ALLOW_THREADS
            sipReleaseType(const_cast< ::wxString *>(format), sipType_wxString, formatState);

            if (PyErr_Occurred())
                return 0;

            Py_INCREF(Py_None);
            return Py_None;
        }
    }

    sipNoMethod(sipParseErr, sipName_HtmlHelpController, sipName_SetTitleFormat, SIP_NULLPTR);

    return SIP_NULLPTR;
}


PyDoc_STRVAR(doc_wxHtmlHelpController_UseConfig, "UseConfig(config, rootpath=wx.EmptyString)\n"
"\n"
"Associates the config object with the controller.");

extern "C" {static PyObject *meth_wxHtmlHelpController_UseConfig(PyObject *, PyObject *, PyObject *);}
static PyObject *meth_wxHtmlHelpController_UseConfig(PyObject *sipSelf, PyObject *sipArgs, PyObject *sipKwds)
{
    PyObject *sipParseErr = SIP_NULLPTR;

    {
        ::wxConfigBase* config;
        const ::wxString& rootpathdef = wxEmptyString;
        const ::wxString* rootpath = &rootpathdef;
        int rootpathState = 0;
        ::wxHtmlHelpController *sipCpp;

        static const char *sipKwdList[] = {
            sipName_config,
            sipName_rootpath,
        };

        if (sipParseKwdArgs(&sipParseErr, sipArgs, sipKwds, sipKwdList, SIP_NULLPTR, "BJ8|J1", &sipSelf, sipType_wxHtmlHelpController, &sipCpp, sipType_wxConfigBase, &config, sipType_wxString, &rootpath, &rootpathState))
        {
            PyErr_Clear();

            Py_BEGIN_ALLOW_THREADS
            sipCpp->UseConfig(config, *rootpath);
            Py_END_ALLOW_THREADS
            sipReleaseType(const_cast< ::wxString *>(rootpath), sipType_wxString, rootpathState);

            if (PyErr_Occurred())
                return 0;

            Py_INCREF(Py_None);
            return Py_None;
        }
    }

    sipNoMethod(sipParseErr, sipName_HtmlHelpController, sipName_UseConfig, SIP_NULLPTR);

    return SIP_NULLPTR;
}


PyDoc_STRVAR(doc_wxHtmlHelpController_WriteCustomization, "WriteCustomization(cfg, path=wx.EmptyString)\n"
"\n"
"Stores controllers setting (position of window etc.)");

extern "C" {static PyObject *meth_wxHtmlHelpController_WriteCustomization(PyObject *, PyObject *, PyObject *);}
static PyObject *meth_wxHtmlHelpController_WriteCustomization(PyObject *sipSelf, PyObject *sipArgs, PyObject *sipKwds)
{
    PyObject *sipParseErr = SIP_NULLPTR;
    bool sipSelfWasArg = (!sipSelf || sipIsDerivedClass((sipSimpleWrapper *)sipSelf));

    {
        ::wxConfigBase* cfg;
        const ::wxString& pathdef = wxEmptyString;
        const ::wxString* path = &pathdef;
        int pathState = 0;
        ::wxHtmlHelpController *sipCpp;

        static const char *sipKwdList[] = {
            sipName_cfg,
            sipName_path,
        };

        if (sipParseKwdArgs(&sipParseErr, sipArgs, sipKwds, sipKwdList, SIP_NULLPTR, "BJ8|J1", &sipSelf, sipType_wxHtmlHelpController, &sipCpp, sipType_wxConfigBase, &cfg, sipType_wxString, &path, &pathState))
        {
            PyErr_Clear();

            Py_BEGIN_ALLOW_THREADS
            (sipSelfWasArg ? sipCpp->::wxHtmlHelpController::WriteCustomization(cfg, *path) : sipCpp->WriteCustomization(cfg, *path));
            Py_END_ALLOW_THREADS
            sipReleaseType(const_cast< ::wxString *>(path), sipType_wxString, pathState);

            if (PyErr_Occurred())
                return 0;

            Py_INCREF(Py_None);
            return Py_None;
        }
    }

    sipNoMethod(sipParseErr, sipName_HtmlHelpController, sipName_WriteCustomization, SIP_NULLPTR);

    return SIP_NULLPTR;
}


PyDoc_STRVAR(doc_wxHtmlHelpController_GetHelpWindow, "GetHelpWindow() -> HtmlHelpWindow\n"
"\n"
"Get the current help window.");

extern "C" {static PyObject *meth_wxHtmlHelpController_GetHelpWindow(PyObject *, PyObject *);}
static PyObject *meth_wxHtmlHelpController_GetHelpWindow(PyObject *sipSelf, PyObject *sipArgs)
{
    PyObject *sipParseErr = SIP_NULLPTR;

    {
        ::wxHtmlHelpController *sipCpp;

        if (sipParseArgs(&sipParseErr, sipArgs, "B", &sipSelf, sipType_wxHtmlHelpController, &sipCpp))
        {
            ::wxHtmlHelpWindow*sipRes;

            PyErr_Clear();

            Py_BEGIN_ALLOW_THREADS
            sipRes = sipCpp->GetHelpWindow();
            Py_END_ALLOW_THREADS

            if (PyErr_Occurred())
                return 0;

            return sipConvertFromType(sipRes, sipType_wxHtmlHelpWindow, SIP_NULLPTR);
        }
    }

    sipNoMethod(sipParseErr, sipName_HtmlHelpController, sipName_GetHelpWindow, SIP_NULLPTR);

    return SIP_NULLPTR;
}


PyDoc_STRVAR(doc_wxHtmlHelpController_SetHelpWindow, "SetHelpWindow(helpWindow)\n"
"\n"
"Set the help window to be managed by this controller.");

extern "C" {static PyObject *meth_wxHtmlHelpController_SetHelpWindow(PyObject *, PyObject *, PyObject *);}
static PyObject *meth_wxHtmlHelpController_SetHelpWindow(PyObject *sipSelf, PyObject *sipArgs, PyObject *sipKwds)
{
    PyObject *sipParseErr = SIP_NULLPTR;

    {
        ::wxHtmlHelpWindow* helpWindow;
        ::wxHtmlHelpController *sipCpp;

        static const char *sipKwdList[] = {
            sipName_helpWindow,
        };

        if (sipParseKwdArgs(&sipParseErr, sipArgs, sipKwds, sipKwdList, SIP_NULLPTR, "BJ8", &sipSelf, sipType_wxHtmlHelpController, &sipCpp, sipType_wxHtmlHelpWindow, &helpWindow))
        {
            PyErr_Clear();

            Py_BEGIN_ALLOW_THREADS
            sipCpp->SetHelpWindow(helpWindow);
            Py_END_ALLOW_THREADS

            if (PyErr_Occurred())
                return 0;

            Py_INCREF(Py_None);
            return Py_None;
        }
    }

    sipNoMethod(sipParseErr, sipName_HtmlHelpController, sipName_SetHelpWindow, SIP_NULLPTR);

    return SIP_NULLPTR;
}


PyDoc_STRVAR(doc_wxHtmlHelpController_GetFrame, "GetFrame() -> HtmlHelpFrame\n"
"\n"
"Returns the current help frame.");

extern "C" {static PyObject *meth_wxHtmlHelpController_GetFrame(PyObject *, PyObject *);}
static PyObject *meth_wxHtmlHelpController_GetFrame(PyObject *sipSelf, PyObject *sipArgs)
{
    PyObject *sipParseErr = SIP_NULLPTR;

    {
        ::wxHtmlHelpController *sipCpp;

        if (sipParseArgs(&sipParseErr, sipArgs, "B", &sipSelf, sipType_wxHtmlHelpController, &sipCpp))
        {
            ::wxHtmlHelpFrame*sipRes;

            PyErr_Clear();

            Py_BEGIN_ALLOW_THREADS
            sipRes = sipCpp->GetFrame();
            Py_END_ALLOW_THREADS

            if (PyErr_Occurred())
                return 0;

            return sipConvertFromType(sipRes, sipType_wxHtmlHelpFrame, SIP_NULLPTR);
        }
    }

    sipNoMethod(sipParseErr, sipName_HtmlHelpController, sipName_GetFrame, SIP_NULLPTR);

    return SIP_NULLPTR;
}


PyDoc_STRVAR(doc_wxHtmlHelpController_GetDialog, "GetDialog() -> HtmlHelpDialog\n"
"\n"
"Returns the current help dialog.");

extern "C" {static PyObject *meth_wxHtmlHelpController_GetDialog(PyObject *, PyObject *);}
static PyObject *meth_wxHtmlHelpController_GetDialog(PyObject *sipSelf, PyObject *sipArgs)
{
    PyObject *sipParseErr = SIP_NULLPTR;

    {
        ::wxHtmlHelpController *sipCpp;

        if (sipParseArgs(&sipParseErr, sipArgs, "B", &sipSelf, sipType_wxHtmlHelpController, &sipCpp))
        {
            ::wxHtmlHelpDialog*sipRes;

            PyErr_Clear();

            Py_BEGIN_ALLOW_THREADS
            sipRes = sipCpp->GetDialog();
            Py_END_ALLOW_THREADS

            if (PyErr_Occurred())
                return 0;

            return sipConvertFromType(sipRes, sipType_wxHtmlHelpDialog, SIP_NULLPTR);
        }
    }

    sipNoMethod(sipParseErr, sipName_HtmlHelpController, sipName_GetDialog, SIP_NULLPTR);

    return SIP_NULLPTR;
}


PyDoc_STRVAR(doc_wxHtmlHelpController_Initialize, "Initialize(self, file: Any, server: int) -> bool\n"
"Initialize(self, file: Any) -> bool");

extern "C" {static PyObject *meth_wxHtmlHelpController_Initialize(PyObject *, PyObject *, PyObject *);}
static PyObject *meth_wxHtmlHelpController_Initialize(PyObject *sipSelf, PyObject *sipArgs, PyObject *sipKwds)
{
    PyObject *sipParseErr = SIP_NULLPTR;
    bool sipSelfWasArg = (!sipSelf || sipIsDerivedClass((sipSimpleWrapper *)sipSelf));

    {
        const ::wxString* file;
        int fileState = 0;
        int server;
        ::wxHtmlHelpController *sipCpp;

        static const char *sipKwdList[] = {
            sipName_file,
            sipName_server,
        };

        if (sipParseKwdArgs(&sipParseErr, sipArgs, sipKwds, sipKwdList, SIP_NULLPTR, "BJ1i", &sipSelf, sipType_wxHtmlHelpController, &sipCpp, sipType_wxString, &file, &fileState, &server))
        {
            bool sipRes;

            PyErr_Clear();

            Py_BEGIN_ALLOW_THREADS
            sipRes = (sipSelfWasArg ? sipCpp->::wxHtmlHelpController::Initialize(*file, server) : sipCpp->Initialize(*file, server));
            Py_END_ALLOW_THREADS
            sipReleaseType(const_cast< ::wxString *>(file), sipType_wxString, fileState);

            if (PyErr_Occurred())
                return 0;

            return PyBool_FromLong(sipRes);
        }
    }

    {
        const ::wxString* file;
        int fileState = 0;
        ::wxHtmlHelpController *sipCpp;

        static const char *sipKwdList[] = {
            sipName_file,
        };

        if (sipParseKwdArgs(&sipParseErr, sipArgs, sipKwds, sipKwdList, SIP_NULLPTR, "BJ1", &sipSelf, sipType_wxHtmlHelpController, &sipCpp, sipType_wxString, &file, &fileState))
        {
            bool sipRes;

            PyErr_Clear();

            Py_BEGIN_ALLOW_THREADS
            sipRes = (sipSelfWasArg ? sipCpp->::wxHtmlHelpController::Initialize(*file) : sipCpp->Initialize(*file));
            Py_END_ALLOW_THREADS
            sipReleaseType(const_cast< ::wxString *>(file), sipType_wxString, fileState);

            if (PyErr_Occurred())
                return 0;

            return PyBool_FromLong(sipRes);
        }
    }

    sipNoMethod(sipParseErr, sipName_HtmlHelpController, sipName_Initialize, doc_wxHtmlHelpController_Initialize);

    return SIP_NULLPTR;
}


PyDoc_STRVAR(doc_wxHtmlHelpController_SetViewer, "SetViewer(self, viewer: Any, flags: int = 0)");

extern "C" {static PyObject *meth_wxHtmlHelpController_SetViewer(PyObject *, PyObject *, PyObject *);}
static PyObject *meth_wxHtmlHelpController_SetViewer(PyObject *sipSelf, PyObject *sipArgs, PyObject *sipKwds)
{
    PyObject *sipParseErr = SIP_NULLPTR;
    bool sipSelfWasArg = (!sipSelf || sipIsDerivedClass((sipSimpleWrapper *)sipSelf));

    {
        const ::wxString* viewer;
        int viewerState = 0;
        long flags = 0;
        ::wxHtmlHelpController *sipCpp;

        static const char *sipKwdList[] = {
            sipName_viewer,
            sipName_flags,
        };

        if (sipParseKwdArgs(&sipParseErr, sipArgs, sipKwds, sipKwdList, SIP_NULLPTR, "BJ1|l", &sipSelf, sipType_wxHtmlHelpController, &sipCpp, sipType_wxString, &viewer, &viewerState, &flags))
        {
            PyErr_Clear();

            Py_BEGIN_ALLOW_THREADS
            (sipSelfWasArg ? sipCpp->::wxHtmlHelpController::SetViewer(*viewer, flags) : sipCpp->SetViewer(*viewer, flags));
            Py_END_ALLOW_THREADS
            sipReleaseType(const_cast< ::wxString *>(viewer), sipType_wxString, viewerState);

            if (PyErr_Occurred())
                return 0;

            Py_INCREF(Py_None);
            return Py_None;
        }
    }

    sipNoMethod(sipParseErr, sipName_HtmlHelpController, sipName_SetViewer, doc_wxHtmlHelpController_SetViewer);

    return SIP_NULLPTR;
}


PyDoc_STRVAR(doc_wxHtmlHelpController_LoadFile, "LoadFile(self, file: Any = \"\") -> bool");

extern "C" {static PyObject *meth_wxHtmlHelpController_LoadFile(PyObject *, PyObject *, PyObject *);}
static PyObject *meth_wxHtmlHelpController_LoadFile(PyObject *sipSelf, PyObject *sipArgs, PyObject *sipKwds)
{
    PyObject *sipParseErr = SIP_NULLPTR;
    bool sipSelfWasArg = (!sipSelf || sipIsDerivedClass((sipSimpleWrapper *)sipSelf));

    {
        const ::wxString& filedef = "";
        const ::wxString* file = &filedef;
        int fileState = 0;
        ::wxHtmlHelpController *sipCpp;

        static const char *sipKwdList[] = {
            sipName_file,
        };

        if (sipParseKwdArgs(&sipParseErr, sipArgs, sipKwds, sipKwdList, SIP_NULLPTR, "B|J1", &sipSelf, sipType_wxHtmlHelpController, &sipCpp, sipType_wxString, &file, &fileState))
        {
            bool sipRes;

            PyErr_Clear();

            Py_BEGIN_ALLOW_THREADS
            sipRes = (sipSelfWasArg ? sipCpp->::wxHtmlHelpController::LoadFile(*file) : sipCpp->LoadFile(*file));
            Py_END_ALLOW_THREADS
            sipReleaseType(const_cast< ::wxString *>(file), sipType_wxString, fileState);

            if (PyErr_Occurred())
                return 0;

            return PyBool_FromLong(sipRes);
        }
    }

    sipNoMethod(sipParseErr, sipName_HtmlHelpController, sipName_LoadFile, doc_wxHtmlHelpController_LoadFile);

    return SIP_NULLPTR;
}


PyDoc_STRVAR(doc_wxHtmlHelpController_DisplaySection, "DisplaySection(self, sectionNo: int) -> bool\n"
"DisplaySection(self, section: Any) -> bool");

extern "C" {static PyObject *meth_wxHtmlHelpController_DisplaySection(PyObject *, PyObject *, PyObject *);}
static PyObject *meth_wxHtmlHelpController_DisplaySection(PyObject *sipSelf, PyObject *sipArgs, PyObject *sipKwds)
{
    PyObject *sipParseErr = SIP_NULLPTR;
    bool sipSelfWasArg = (!sipSelf || sipIsDerivedClass((sipSimpleWrapper *)sipSelf));

    {
        int sectionNo;
        ::wxHtmlHelpController *sipCpp;

        static const char *sipKwdList[] = {
            sipName_sectionNo,
        };

        if (sipParseKwdArgs(&sipParseErr, sipArgs, sipKwds, sipKwdList, SIP_NULLPTR, "Bi", &sipSelf, sipType_wxHtmlHelpController, &sipCpp, &sectionNo))
        {
            bool sipRes;

            PyErr_Clear();

            Py_BEGIN_ALLOW_THREADS
            sipRes = (sipSelfWasArg ? sipCpp->::wxHtmlHelpController::DisplaySection(sectionNo) : sipCpp->DisplaySection(sectionNo));
            Py_END_ALLOW_THREADS

            if (PyErr_Occurred())
                return 0;

            return PyBool_FromLong(sipRes);
        }
    }

    {
        const ::wxString* section;
        int sectionState = 0;
        ::wxHtmlHelpController *sipCpp;

        static const char *sipKwdList[] = {
            sipName_section,
        };

        if (sipParseKwdArgs(&sipParseErr, sipArgs, sipKwds, sipKwdList, SIP_NULLPTR, "BJ1", &sipSelf, sipType_wxHtmlHelpController, &sipCpp, sipType_wxString, &section, &sectionState))
        {
            bool sipRes;

            PyErr_Clear();

            Py_BEGIN_ALLOW_THREADS
            sipRes = (sipSelfWasArg ? sipCpp->::wxHtmlHelpController::DisplaySection(*section) : sipCpp->DisplaySection(*section));
            Py_END_ALLOW_THREADS
            sipReleaseType(const_cast< ::wxString *>(section), sipType_wxString, sectionState);

            if (PyErr_Occurred())
                return 0;

            return PyBool_FromLong(sipRes);
        }
    }

    sipNoMethod(sipParseErr, sipName_HtmlHelpController, sipName_DisplaySection, doc_wxHtmlHelpController_DisplaySection);

    return SIP_NULLPTR;
}


PyDoc_STRVAR(doc_wxHtmlHelpController_DisplayBlock, "DisplayBlock(self, blockNo: int) -> bool");

extern "C" {static PyObject *meth_wxHtmlHelpController_DisplayBlock(PyObject *, PyObject *, PyObject *);}
static PyObject *meth_wxHtmlHelpController_DisplayBlock(PyObject *sipSelf, PyObject *sipArgs, PyObject *sipKwds)
{
    PyObject *sipParseErr = SIP_NULLPTR;
    bool sipSelfWasArg = (!sipSelf || sipIsDerivedClass((sipSimpleWrapper *)sipSelf));

    {
        long blockNo;
        ::wxHtmlHelpController *sipCpp;

        static const char *sipKwdList[] = {
            sipName_blockNo,
        };

        if (sipParseKwdArgs(&sipParseErr, sipArgs, sipKwds, sipKwdList, SIP_NULLPTR, "Bl", &sipSelf, sipType_wxHtmlHelpController, &sipCpp, &blockNo))
        {
            bool sipRes;

            PyErr_Clear();

            Py_BEGIN_ALLOW_THREADS
            sipRes = (sipSelfWasArg ? sipCpp->::wxHtmlHelpController::DisplayBlock(blockNo) : sipCpp->DisplayBlock(blockNo));
            Py_END_ALLOW_THREADS

            if (PyErr_Occurred())
                return 0;

            return PyBool_FromLong(sipRes);
        }
    }

    sipNoMethod(sipParseErr, sipName_HtmlHelpController, sipName_DisplayBlock, doc_wxHtmlHelpController_DisplayBlock);

    return SIP_NULLPTR;
}


PyDoc_STRVAR(doc_wxHtmlHelpController_DisplayTextPopup, "DisplayTextPopup(self, text: Any, pos: Point) -> bool");

extern "C" {static PyObject *meth_wxHtmlHelpController_DisplayTextPopup(PyObject *, PyObject *, PyObject *);}
static PyObject *meth_wxHtmlHelpController_DisplayTextPopup(PyObject *sipSelf, PyObject *sipArgs, PyObject *sipKwds)
{
    PyObject *sipParseErr = SIP_NULLPTR;
    bool sipSelfWasArg = (!sipSelf || sipIsDerivedClass((sipSimpleWrapper *)sipSelf));

    {
        const ::wxString* text;
        int textState = 0;
        const ::wxPoint* pos;
        int posState = 0;
        ::wxHtmlHelpController *sipCpp;

        static const char *sipKwdList[] = {
            sipName_text,
            sipName_pos,
        };

        if (sipParseKwdArgs(&sipParseErr, sipArgs, sipKwds, sipKwdList, SIP_NULLPTR, "BJ1J1", &sipSelf, sipType_wxHtmlHelpController, &sipCpp, sipType_wxString, &text, &textState, sipType_wxPoint, &pos, &posState))
        {
            bool sipRes;

            PyErr_Clear();

            Py_BEGIN_ALLOW_THREADS
            sipRes = (sipSelfWasArg ? sipCpp->::wxHtmlHelpController::DisplayTextPopup(*text, *pos) : sipCpp->DisplayTextPopup(*text, *pos));
            Py_END_ALLOW_THREADS
            sipReleaseType(const_cast< ::wxString *>(text), sipType_wxString, textState);
            sipReleaseType(const_cast< ::wxPoint *>(pos), sipType_wxPoint, posState);

            if (PyErr_Occurred())
                return 0;

            return PyBool_FromLong(sipRes);
        }
    }

    sipNoMethod(sipParseErr, sipName_HtmlHelpController, sipName_DisplayTextPopup, doc_wxHtmlHelpController_DisplayTextPopup);

    return SIP_NULLPTR;
}


PyDoc_STRVAR(doc_wxHtmlHelpController_DisplayContextPopup, "DisplayContextPopup(self, contextId: int) -> bool");

extern "C" {static PyObject *meth_wxHtmlHelpController_DisplayContextPopup(PyObject *, PyObject *, PyObject *);}
static PyObject *meth_wxHtmlHelpController_DisplayContextPopup(PyObject *sipSelf, PyObject *sipArgs, PyObject *sipKwds)
{
    PyObject *sipParseErr = SIP_NULLPTR;
    bool sipSelfWasArg = (!sipSelf || sipIsDerivedClass((sipSimpleWrapper *)sipSelf));

    {
        int contextId;
        ::wxHtmlHelpController *sipCpp;

        static const char *sipKwdList[] = {
            sipName_contextId,
        };

        if (sipParseKwdArgs(&sipParseErr, sipArgs, sipKwds, sipKwdList, SIP_NULLPTR, "Bi", &sipSelf, sipType_wxHtmlHelpController, &sipCpp, &contextId))
        {
            bool sipRes;

            PyErr_Clear();

            Py_BEGIN_ALLOW_THREADS
            sipRes = (sipSelfWasArg ? sipCpp->::wxHtmlHelpController::DisplayContextPopup(contextId) : sipCpp->DisplayContextPopup(contextId));
            Py_END_ALLOW_THREADS

            if (PyErr_Occurred())
                return 0;

            return PyBool_FromLong(sipRes);
        }
    }

    sipNoMethod(sipParseErr, sipName_HtmlHelpController, sipName_DisplayContextPopup, doc_wxHtmlHelpController_DisplayContextPopup);

    return SIP_NULLPTR;
}


PyDoc_STRVAR(doc_wxHtmlHelpController_Quit, "Quit(self) -> bool");

extern "C" {static PyObject *meth_wxHtmlHelpController_Quit(PyObject *, PyObject *);}
static PyObject *meth_wxHtmlHelpController_Quit(PyObject *sipSelf, PyObject *sipArgs)
{
    PyObject *sipParseErr = SIP_NULLPTR;
    bool sipSelfWasArg = (!sipSelf || sipIsDerivedClass((sipSimpleWrapper *)sipSelf));

    {
        ::wxHtmlHelpController *sipCpp;

        if (sipParseArgs(&sipParseErr, sipArgs, "B", &sipSelf, sipType_wxHtmlHelpController, &sipCpp))
        {
            bool sipRes;

            PyErr_Clear();

            Py_BEGIN_ALLOW_THREADS
            sipRes = (sipSelfWasArg ? sipCpp->::wxHtmlHelpController::Quit() : sipCpp->Quit());
            Py_END_ALLOW_THREADS

            if (PyErr_Occurred())
                return 0;

            return PyBool_FromLong(sipRes);
        }
    }

    sipNoMethod(sipParseErr, sipName_HtmlHelpController, sipName_Quit, doc_wxHtmlHelpController_Quit);

    return SIP_NULLPTR;
}


PyDoc_STRVAR(doc_wxHtmlHelpController_OnQuit, "OnQuit(self)");

extern "C" {static PyObject *meth_wxHtmlHelpController_OnQuit(PyObject *, PyObject *);}
static PyObject *meth_wxHtmlHelpController_OnQuit(PyObject *sipSelf, PyObject *sipArgs)
{
    PyObject *sipParseErr = SIP_NULLPTR;
    bool sipSelfWasArg = (!sipSelf || sipIsDerivedClass((sipSimpleWrapper *)sipSelf));

    {
        ::wxHtmlHelpController *sipCpp;

        if (sipParseArgs(&sipParseErr, sipArgs, "B", &sipSelf, sipType_wxHtmlHelpController, &sipCpp))
        {
            PyErr_Clear();

            Py_BEGIN_ALLOW_THREADS
            (sipSelfWasArg ? sipCpp->::wxHtmlHelpController::OnQuit() : sipCpp->OnQuit());
            Py_END_ALLOW_THREADS

            if (PyErr_Occurred())
                return 0;

            Py_INCREF(Py_None);
            return Py_None;
        }
    }

    sipNoMethod(sipParseErr, sipName_HtmlHelpController, sipName_OnQuit, doc_wxHtmlHelpController_OnQuit);

    return SIP_NULLPTR;
}


PyDoc_STRVAR(doc_wxHtmlHelpController_SetFrameParameters, "SetFrameParameters(self, titleFormat: Any, size: Size, pos: Point = wxDefaultPosition, newFrameEachTime: bool = False)");

extern "C" {static PyObject *meth_wxHtmlHelpController_SetFrameParameters(PyObject *, PyObject *, PyObject *);}
static PyObject *meth_wxHtmlHelpController_SetFrameParameters(PyObject *sipSelf, PyObject *sipArgs, PyObject *sipKwds)
{
    PyObject *sipParseErr = SIP_NULLPTR;
    bool sipSelfWasArg = (!sipSelf || sipIsDerivedClass((sipSimpleWrapper *)sipSelf));

    {
        const ::wxString* titleFormat;
        int titleFormatState = 0;
        const ::wxSize* size;
        int sizeState = 0;
        const ::wxPoint& posdef = wxDefaultPosition;
        const ::wxPoint* pos = &posdef;
        int posState = 0;
        bool newFrameEachTime = 0;
        ::wxHtmlHelpController *sipCpp;

        static const char *sipKwdList[] = {
            sipName_titleFormat,
            sipName_size,
            sipName_pos,
            sipName_newFrameEachTime,
        };

        if (sipParseKwdArgs(&sipParseErr, sipArgs, sipKwds, sipKwdList, SIP_NULLPTR, "BJ1J1|J1b", &sipSelf, sipType_wxHtmlHelpController, &sipCpp, sipType_wxString, &titleFormat, &titleFormatState, sipType_wxSize, &size, &sizeState, sipType_wxPoint, &pos, &posState, &newFrameEachTime))
        {
            PyErr_Clear();

            Py_BEGIN_ALLOW_THREADS
            (sipSelfWasArg ? sipCpp->::wxHtmlHelpController::SetFrameParameters(*titleFormat, *size, *pos, newFrameEachTime) : sipCpp->SetFrameParameters(*titleFormat, *size, *pos, newFrameEachTime));
            Py_END_ALLOW_THREADS
            sipReleaseType(const_cast< ::wxString *>(titleFormat), sipType_wxString, titleFormatState);
            sipReleaseType(const_cast< ::wxSize *>(size), sipType_wxSize, sizeState);
            sipReleaseType(const_cast< ::wxPoint *>(pos), sipType_wxPoint, posState);

            if (PyErr_Occurred())
                return 0;

            Py_INCREF(Py_None);
            return Py_None;
        }
    }

    sipNoMethod(sipParseErr, sipName_HtmlHelpController, sipName_SetFrameParameters, doc_wxHtmlHelpController_SetFrameParameters);

    return SIP_NULLPTR;
}


PyDoc_STRVAR(doc_wxHtmlHelpController_CreateHelpDialog, "CreateHelpDialog(data) -> HtmlHelpDialog\n"
"\n"
"This protected virtual method may be overridden so that when\n"
"specifying the wxHF_DIALOG style, the controller uses a different\n"
"dialog.");

extern "C" {static PyObject *meth_wxHtmlHelpController_CreateHelpDialog(PyObject *, PyObject *, PyObject *);}
static PyObject *meth_wxHtmlHelpController_CreateHelpDialog(PyObject *sipSelf, PyObject *sipArgs, PyObject *sipKwds)
{
    PyObject *sipParseErr = SIP_NULLPTR;
    bool sipSelfWasArg = (!sipSelf || sipIsDerivedClass((sipSimpleWrapper *)sipSelf));

    {
        ::wxHtmlHelpData* data;
        sipwxHtmlHelpController *sipCpp;

        static const char *sipKwdList[] = {
            sipName_data,
        };

        if (sipParseKwdArgs(&sipParseErr, sipArgs, sipKwds, sipKwdList, SIP_NULLPTR, "BJ8", &sipSelf, sipType_wxHtmlHelpController, &sipCpp, sipType_wxHtmlHelpData, &data))
        {
            ::wxHtmlHelpDialog*sipRes;

            PyErr_Clear();

            Py_BEGIN_ALLOW_THREADS
            sipRes = sipCpp->sipProtectVirt_CreateHelpDialog(sipSelfWasArg, data);
            Py_END_ALLOW_THREADS

            if (PyErr_Occurred())
                return 0;

            return sipConvertFromType(sipRes, sipType_wxHtmlHelpDialog, SIP_NULLPTR);
        }
    }

    sipNoMethod(sipParseErr, sipName_HtmlHelpController, sipName_CreateHelpDialog, SIP_NULLPTR);

    return SIP_NULLPTR;
}


PyDoc_STRVAR(doc_wxHtmlHelpController_CreateHelpFrame, "CreateHelpFrame(data) -> HtmlHelpFrame\n"
"\n"
"This protected virtual method may be overridden so that the controller\n"
"uses a different frame.");

extern "C" {static PyObject *meth_wxHtmlHelpController_CreateHelpFrame(PyObject *, PyObject *, PyObject *);}
static PyObject *meth_wxHtmlHelpController_CreateHelpFrame(PyObject *sipSelf, PyObject *sipArgs, PyObject *sipKwds)
{
    PyObject *sipParseErr = SIP_NULLPTR;
    bool sipSelfWasArg = (!sipSelf || sipIsDerivedClass((sipSimpleWrapper *)sipSelf));

    {
        ::wxHtmlHelpData* data;
        sipwxHtmlHelpController *sipCpp;

        static const char *sipKwdList[] = {
            sipName_data,
        };

        if (sipParseKwdArgs(&sipParseErr, sipArgs, sipKwds, sipKwdList, SIP_NULLPTR, "BJ8", &sipSelf, sipType_wxHtmlHelpController, &sipCpp, sipType_wxHtmlHelpData, &data))
        {
            ::wxHtmlHelpFrame*sipRes;

            PyErr_Clear();

            Py_BEGIN_ALLOW_THREADS
            sipRes = sipCpp->sipProtectVirt_CreateHelpFrame(sipSelfWasArg, data);
            Py_END_ALLOW_THREADS

            if (PyErr_Occurred())
                return 0;

            return sipConvertFromType(sipRes, sipType_wxHtmlHelpFrame, SIP_NULLPTR);
        }
    }

    sipNoMethod(sipParseErr, sipName_HtmlHelpController, sipName_CreateHelpFrame, SIP_NULLPTR);

    return SIP_NULLPTR;
}


/* Cast a pointer to a type somewhere in its inheritance hierarchy. */
extern "C" {static void *cast_wxHtmlHelpController(void *, const sipTypeDef *);}
static void *cast_wxHtmlHelpController(void *sipCppV, const sipTypeDef *targetType)
{
    ::wxHtmlHelpController *sipCpp = reinterpret_cast< ::wxHtmlHelpController *>(sipCppV);

    if (targetType == sipType_wxHtmlHelpController)
        return sipCppV;

    sipCppV = ((const sipClassTypeDef *)sipType_wxHelpControllerBase)->ctd_cast(static_cast< ::wxHelpControllerBase *>(sipCpp), targetType);
    if (sipCppV)
        return sipCppV;

    return SIP_NULLPTR;
}


/* Call the instance's destructor. */
extern "C" {static void release_wxHtmlHelpController(void *, int);}
static void release_wxHtmlHelpController(void *sipCppV, int sipState)
{
    Py_BEGIN_ALLOW_THREADS

    if (sipState & SIP_DERIVED_CLASS)
        delete reinterpret_cast<sipwxHtmlHelpController *>(sipCppV);
    else
        delete reinterpret_cast< ::wxHtmlHelpController *>(sipCppV);

    Py_END_ALLOW_THREADS
}


extern "C" {static void *array_wxHtmlHelpController(Py_ssize_t);}
static void *array_wxHtmlHelpController(Py_ssize_t sipNrElem)
{
    return new ::wxHtmlHelpController[sipNrElem];
}


extern "C" {static void array_delete_wxHtmlHelpController(void *);}
static void array_delete_wxHtmlHelpController(void *sipCpp)
{
    delete[] reinterpret_cast< ::wxHtmlHelpController *>(sipCpp);
}


extern "C" {static void dealloc_wxHtmlHelpController(sipSimpleWrapper *);}
static void dealloc_wxHtmlHelpController(sipSimpleWrapper *sipSelf)
{
    if (sipIsDerivedClass(sipSelf))
        reinterpret_cast<sipwxHtmlHelpController *>(sipGetAddress(sipSelf))->sipPySelf = SIP_NULLPTR;

    if (sipIsOwnedByPython(sipSelf))
    {
        release_wxHtmlHelpController(sipGetAddress(sipSelf), sipIsDerivedClass(sipSelf));
    }
}


extern "C" {static void *init_type_wxHtmlHelpController(sipSimpleWrapper *, PyObject *, PyObject *, PyObject **, PyObject **, PyObject **);}
static void *init_type_wxHtmlHelpController(sipSimpleWrapper *sipSelf, PyObject *sipArgs, PyObject *sipKwds, PyObject **sipUnused, PyObject **, PyObject **sipParseErr)
{
    sipwxHtmlHelpController *sipCpp = SIP_NULLPTR;

    {
        int style = wxHF_DEFAULT_STYLE;
        ::wxWindow* parentWindow = 0;

        static const char *sipKwdList[] = {
            sipName_style,
            sipName_parentWindow,
        };

        if (sipParseKwdArgs(sipParseErr, sipArgs, sipKwds, sipKwdList, sipUnused, "|iJ8", &style, sipType_wxWindow, &parentWindow))
        {

        if (!wxPyCheckForApp()) return NULL;

            PyErr_Clear();

            Py_BEGIN_ALLOW_THREADS
            sipCpp = new sipwxHtmlHelpController(style, parentWindow);
            Py_END_ALLOW_THREADS

            if (PyErr_Occurred())
            {
                delete sipCpp;
                return SIP_NULLPTR;
            }

            sipCpp->sipPySelf = sipSelf;

            return sipCpp;
        }
    }

    {
        ::wxWindow* parentWindow;
        int style = wxHF_DEFAULT_STYLE;

        static const char *sipKwdList[] = {
            sipName_parentWindow,
            sipName_style,
        };

        if (sipParseKwdArgs(sipParseErr, sipArgs, sipKwds, sipKwdList, sipUnused, "J8|i", sipType_wxWindow, &parentWindow, &style))
        {

        if (!wxPyCheckForApp()) return NULL;

            PyErr_Clear();

            Py_BEGIN_ALLOW_THREADS
            sipCpp = new sipwxHtmlHelpController(parentWindow, style);
            Py_END_ALLOW_THREADS

            if (PyErr_Occurred())
            {
                delete sipCpp;
                return SIP_NULLPTR;
            }

            sipCpp->sipPySelf = sipSelf;

            return sipCpp;
        }
    }

    return SIP_NULLPTR;
}


/* Define this type's super-types. */
static sipEncodedTypeDef supers_wxHtmlHelpController[] = {{19, 0, 1}};


static PyMethodDef methods_wxHtmlHelpController[] = {
    {sipName_AddBook, SIP_MLMETH_CAST(meth_wxHtmlHelpController_AddBook), METH_VARARGS|METH_KEYWORDS, doc_wxHtmlHelpController_AddBook},
    {sipName_CreateHelpDialog, SIP_MLMETH_CAST(meth_wxHtmlHelpController_CreateHelpDialog), METH_VARARGS|METH_KEYWORDS, doc_wxHtmlHelpController_CreateHelpDialog},
    {sipName_CreateHelpFrame, SIP_MLMETH_CAST(meth_wxHtmlHelpController_CreateHelpFrame), METH_VARARGS|METH_KEYWORDS, doc_wxHtmlHelpController_CreateHelpFrame},
    {sipName_Display, SIP_MLMETH_CAST(meth_wxHtmlHelpController_Display), METH_VARARGS|METH_KEYWORDS, doc_wxHtmlHelpController_Display},
    {sipName_DisplayBlock, SIP_MLMETH_CAST(meth_wxHtmlHelpController_DisplayBlock), METH_VARARGS|METH_KEYWORDS, doc_wxHtmlHelpController_DisplayBlock},
    {sipName_DisplayContents, meth_wxHtmlHelpController_DisplayContents, METH_VARARGS, doc_wxHtmlHelpController_DisplayContents},
    {sipName_DisplayContextPopup, SIP_MLMETH_CAST(meth_wxHtmlHelpController_DisplayContextPopup), METH_VARARGS|METH_KEYWORDS, doc_wxHtmlHelpController_DisplayContextPopup},
    {sipName_DisplayIndex, meth_wxHtmlHelpController_DisplayIndex, METH_VARARGS, doc_wxHtmlHelpController_DisplayIndex},
    {sipName_DisplaySection, SIP_MLMETH_CAST(meth_wxHtmlHelpController_DisplaySection), METH_VARARGS|METH_KEYWORDS, doc_wxHtmlHelpController_DisplaySection},
    {sipName_DisplayTextPopup, SIP_MLMETH_CAST(meth_wxHtmlHelpController_DisplayTextPopup), METH_VARARGS|METH_KEYWORDS, doc_wxHtmlHelpController_DisplayTextPopup},
    {sipName_GetDialog, meth_wxHtmlHelpController_GetDialog, METH_VARARGS, doc_wxHtmlHelpController_GetDialog},
    {sipName_GetFrame, meth_wxHtmlHelpController_GetFrame, METH_VARARGS, doc_wxHtmlHelpController_GetFrame},
    {sipName_GetHelpWindow, meth_wxHtmlHelpController_GetHelpWindow, METH_VARARGS, doc_wxHtmlHelpController_GetHelpWindow},
    {sipName_Initialize, SIP_MLMETH_CAST(meth_wxHtmlHelpController_Initialize), METH_VARARGS|METH_KEYWORDS, doc_wxHtmlHelpController_Initialize},
    {sipName_KeywordSearch, SIP_MLMETH_CAST(meth_wxHtmlHelpController_KeywordSearch), METH_VARARGS|METH_KEYWORDS, doc_wxHtmlHelpController_KeywordSearch},
    {sipName_LoadFile, SIP_MLMETH_CAST(meth_wxHtmlHelpController_LoadFile), METH_VARARGS|METH_KEYWORDS, doc_wxHtmlHelpController_LoadFile},
    {sipName_OnQuit, meth_wxHtmlHelpController_OnQuit, METH_VARARGS, doc_wxHtmlHelpController_OnQuit},
    {sipName_Quit, meth_wxHtmlHelpController_Quit, METH_VARARGS, doc_wxHtmlHelpController_Quit},
    {sipName_ReadCustomization, SIP_MLMETH_CAST(meth_wxHtmlHelpController_ReadCustomization), METH_VARARGS|METH_KEYWORDS, doc_wxHtmlHelpController_ReadCustomization},
    {sipName_SetFrameParameters, SIP_MLMETH_CAST(meth_wxHtmlHelpController_SetFrameParameters), METH_VARARGS|METH_KEYWORDS, doc_wxHtmlHelpController_SetFrameParameters},
    {sipName_SetHelpWindow, SIP_MLMETH_CAST(meth_wxHtmlHelpController_SetHelpWindow), METH_VARARGS|METH_KEYWORDS, doc_wxHtmlHelpController_SetHelpWindow},
    {sipName_SetShouldPreventAppExit, SIP_MLMETH_CAST(meth_wxHtmlHelpController_SetShouldPreventAppExit), METH_VARARGS|METH_KEYWORDS, doc_wxHtmlHelpController_SetShouldPreventAppExit},
    {sipName_SetTempDir, SIP_MLMETH_CAST(meth_wxHtmlHelpController_SetTempDir), METH_VARARGS|METH_KEYWORDS, doc_wxHtmlHelpController_SetTempDir},
    {sipName_SetTitleFormat, SIP_MLMETH_CAST(meth_wxHtmlHelpController_SetTitleFormat), METH_VARARGS|METH_KEYWORDS, doc_wxHtmlHelpController_SetTitleFormat},
    {sipName_SetViewer, SIP_MLMETH_CAST(meth_wxHtmlHelpController_SetViewer), METH_VARARGS|METH_KEYWORDS, doc_wxHtmlHelpController_SetViewer},
    {sipName_UseConfig, SIP_MLMETH_CAST(meth_wxHtmlHelpController_UseConfig), METH_VARARGS|METH_KEYWORDS, doc_wxHtmlHelpController_UseConfig},
    {sipName_WriteCustomization, SIP_MLMETH_CAST(meth_wxHtmlHelpController_WriteCustomization), METH_VARARGS|METH_KEYWORDS, doc_wxHtmlHelpController_WriteCustomization}
};

sipVariableDef variables_wxHtmlHelpController[] = {
    {PropertyVariable, sipName_HelpWindow, &methods_wxHtmlHelpController[12], &methods_wxHtmlHelpController[20], SIP_NULLPTR, SIP_NULLPTR},
    {PropertyVariable, sipName_Frame, &methods_wxHtmlHelpController[11], SIP_NULLPTR, SIP_NULLPTR, SIP_NULLPTR},
    {PropertyVariable, sipName_Dialog, &methods_wxHtmlHelpController[10], SIP_NULLPTR, SIP_NULLPTR, SIP_NULLPTR},
};

PyDoc_STRVAR(doc_wxHtmlHelpController, "HtmlHelpController(style=HF_DEFAULT_STYLE, parentWindow=None)\n"
"HtmlHelpController(parentWindow, style=HF_DEFAULT_STYLE)\n"
"\n"
"This help controller provides an easy way of displaying HTML help in\n"
"your application (see HTML Sample, test example).");


sipClassTypeDef sipTypeDef__html_wxHtmlHelpController = {
    {
        -1,
        SIP_NULLPTR,
        SIP_NULLPTR,
        SIP_TYPE_SCC|SIP_TYPE_CLASS,
        sipNameNr_wxHtmlHelpController,
        SIP_NULLPTR,
        SIP_NULLPTR,
    },
    {
        sipNameNr_HtmlHelpController,
        {0, 0, 1},
        27, methods_wxHtmlHelpController,
        0, SIP_NULLPTR,
        3, variables_wxHtmlHelpController,
        {SIP_NULLPTR, SIP_NULLPTR, SIP_NULLPTR, SIP_NULLPTR, SIP_NULLPTR, SIP_NULLPTR, SIP_NULLPTR, SIP_NULLPTR, SIP_NULLPTR, SIP_NULLPTR},
    },
    doc_wxHtmlHelpController,
    -1,
    -1,
    supers_wxHtmlHelpController,
    SIP_NULLPTR,
    init_type_wxHtmlHelpController,
    SIP_NULLPTR,
    SIP_NULLPTR,
    SIP_NULLPTR,
    SIP_NULLPTR,
    dealloc_wxHtmlHelpController,
    SIP_NULLPTR,
    array_wxHtmlHelpController,
    SIP_NULLPTR,
    release_wxHtmlHelpController,
    cast_wxHtmlHelpController,
    SIP_NULLPTR,
    SIP_NULLPTR,
    SIP_NULLPTR,
    SIP_NULLPTR,
    SIP_NULLPTR,
    SIP_NULLPTR,
    array_delete_wxHtmlHelpController,
    sizeof (::wxHtmlHelpController),
};
