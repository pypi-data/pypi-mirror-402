/*
 * Interface wrapper code.
 *
 * Generated by SIP 6.15.1
 */

#include "sipAPI_richtext.h"

        #include <wx/richtext/richtextbuffer.h>

        #include <wx/richtext/richtextbuffer.h>
        #include <wx/richtext/richtextbuffer.h>
        #include <wx/richtext/richtextbuffer.h>
        #include <wx/position.h>
        #include <wx/richtext/richtextbuffer.h>
        #include <wx/window.h>
        #include <wx/richtext/richtextbuffer.h>
        #include <wx/dc.h>
        #include <wx/richtext/richtextbuffer.h>
        #include <wx/gdicmn.h>
        #include <wx/xml/xml.h>
        #include <wx/richtext/richtextxml.h>
        #include <wx/richtext/richtextbuffer.h>
        #include <wx/gdicmn.h>
        #include <wx/gdicmn.h>
        
        
        #include <wx/richtext/richtextstyles.h>
        #include <wx/richtext/richtextbuffer.h>
        #include <wx/richtext/richtextbuffer.h>
        #include <wx/richtext/richtextbuffer.h>
        #include <wx/richtext/richtextstyles.h>
        #include <wx/richtext/richtextbuffer.h>
        #include <wx/image.h>
        #include <wx/richtext/richtextctrl.h>
        #include <wx/richtext/richtextbuffer.h>
        #include <wx/richtext/richtextbuffer.h>
        #include <wx/richtext/richtextbuffer.h>
        #include <wx/richtext/richtextbuffer.h>
        #include <wx/object.h>
        #include <wx/object.h>
        #include <wx/object.h>


class sipwxRichTextTable : public ::wxRichTextTable
{
public:
    sipwxRichTextTable(::wxRichTextObject*);
    sipwxRichTextTable(const ::wxRichTextTable&);
    virtual ~sipwxRichTextTable();

    /*
     * There is a protected method for every virtual method visible from
     * this class.
     */
protected:
    bool AddColumns(int, int, const ::wxRichTextAttr&) SIP_OVERRIDE;
    bool AddRows(int, int, const ::wxRichTextAttr&) SIP_OVERRIDE;
    bool DeleteColumns(int, int) SIP_OVERRIDE;
    bool DeleteRows(int, int) SIP_OVERRIDE;
    bool SetCellStyle(const ::wxRichTextSelection&, const ::wxRichTextAttr&, int) SIP_OVERRIDE;
    bool CreateTable(int, int) SIP_OVERRIDE;
    void ClearTable() SIP_OVERRIDE;
    ::wxPosition GetFocusedCell() const SIP_OVERRIDE;
    bool GetCellRowColumnPosition(long, int&, int&) const SIP_OVERRIDE;
    ::wxRichTextCell* GetCell(long) const SIP_OVERRIDE;
    ::wxRichTextCell* GetCell(int, int) const SIP_OVERRIDE;
    bool UpdateFloatingObjects(const ::wxRect&, ::wxRichTextObject*) SIP_OVERRIDE;
    void InvalidateHierarchy(const ::wxRichTextRange&) SIP_OVERRIDE;
    void DoInvalidate(const ::wxRichTextRange&) SIP_OVERRIDE;
    const ::wxRichTextAttr& GetBasicStyle() const SIP_OVERRIDE;
    void SetBasicStyle(const ::wxRichTextAttr&) SIP_OVERRIDE;
    const ::wxRichTextAttr& GetDefaultStyle() const SIP_OVERRIDE;
    bool SetDefaultStyle(const ::wxRichTextAttr&) SIP_OVERRIDE;
    ::wxString GetText() const SIP_OVERRIDE;
    void UpdateRanges() SIP_OVERRIDE;
    bool ApplyStyleSheet(::wxRichTextStyleSheet*) SIP_OVERRIDE;
    bool CopyFragment(const ::wxRichTextRange&, ::wxRichTextParagraphLayoutBox&) SIP_OVERRIDE;
    bool InsertFragment(long, ::wxRichTextParagraphLayoutBox&) SIP_OVERRIDE;
    void PrepareContent(::wxRichTextParagraphLayoutBox&) SIP_OVERRIDE;
    bool HasParagraphAttributes(const ::wxRichTextRange&, const ::wxRichTextAttr&) const SIP_OVERRIDE;
    bool HasCharacterAttributes(const ::wxRichTextRange&, const ::wxRichTextAttr&) const SIP_OVERRIDE;
    bool SetObjectPropertiesWithUndo(::wxRichTextObject&, const ::wxRichTextProperties&, ::wxRichTextObject*) SIP_OVERRIDE;
    bool SetProperties(const ::wxRichTextRange&, const ::wxRichTextProperties&, int) SIP_OVERRIDE;
    bool FindNextParagraphNumber(::wxRichTextParagraph*, ::wxRichTextAttr&) const SIP_OVERRIDE;
    bool DoNumberList(const ::wxRichTextRange&, const ::wxRichTextRange&, int, ::wxRichTextListStyleDefinition*, int, int, int) SIP_OVERRIDE;
    bool ClearListStyle(const ::wxRichTextRange&, int) SIP_OVERRIDE;
    bool GetStyleForRange(const ::wxRichTextRange&, ::wxRichTextAttr&) SIP_OVERRIDE;
    bool DoGetStyle(long, ::wxRichTextAttr&, bool) SIP_OVERRIDE;
    bool GetUncombinedStyle(long, ::wxRichTextAttr&) SIP_OVERRIDE;
    bool GetStyle(long, ::wxRichTextAttr&) SIP_OVERRIDE;
    void SetStyle(::wxRichTextObject*, const ::wxRichTextAttr&, int) SIP_OVERRIDE;
    bool SetStyle(const ::wxRichTextRange&, const ::wxRichTextAttr&, int) SIP_OVERRIDE;
    bool PositionToXY(long, long*, long*) const SIP_OVERRIDE;
    long XYToPosition(long, long) const SIP_OVERRIDE;
    ::wxString GetParagraphText(long) const SIP_OVERRIDE;
    int GetLineCount() const SIP_OVERRIDE;
    int GetParagraphCount() const SIP_OVERRIDE;
    int GetParagraphLength(long) const SIP_OVERRIDE;
    ::wxRichTextParagraph* GetParagraphForLine(::wxRichTextLine*) const SIP_OVERRIDE;
    ::wxRichTextParagraph* GetParagraphAtLine(long) const SIP_OVERRIDE;
    ::wxRichTextObject* GetLeafObjectAtPosition(long) const SIP_OVERRIDE;
    ::wxRichTextLine* GetLineForVisibleLineNumber(long) const SIP_OVERRIDE;
    long GetVisibleLineNumber(long, bool, bool) const SIP_OVERRIDE;
    ::wxSize GetLineSizeAtPosition(long, bool) const SIP_OVERRIDE;
    ::wxRichTextParagraph* GetParagraphAtPosition(long, bool) const SIP_OVERRIDE;
    ::wxRichTextLine* GetLineAtYPosition(int) const SIP_OVERRIDE;
    ::wxRichTextLine* GetLineAtPosition(long, bool) const SIP_OVERRIDE;
    ::wxRichTextRange AddParagraphs(const ::wxString&, ::wxRichTextAttr*) SIP_OVERRIDE;
    ::wxRichTextRange AddImage(const ::wxImage&, ::wxRichTextAttr*) SIP_OVERRIDE;
    ::wxRichTextRange AddParagraph(const ::wxString&, ::wxRichTextAttr*) SIP_OVERRIDE;
    void Reset() SIP_OVERRIDE;
    void Clear() SIP_OVERRIDE;
    ::wxRichTextStyleSheet* GetStyleSheet() const SIP_OVERRIDE;
    bool PromoteList(int, const ::wxRichTextRange&, const ::wxString&, int, int) SIP_OVERRIDE;
    bool PromoteList(int, const ::wxRichTextRange&, ::wxRichTextListStyleDefinition*, int, int) SIP_OVERRIDE;
    bool NumberList(const ::wxRichTextRange&, const ::wxString&, int, int, int) SIP_OVERRIDE;
    bool NumberList(const ::wxRichTextRange&, ::wxRichTextListStyleDefinition*, int, int, int) SIP_OVERRIDE;
    bool SetListStyle(const ::wxRichTextRange&, const ::wxString&, int, int, int) SIP_OVERRIDE;
    bool SetListStyle(const ::wxRichTextRange&, ::wxRichTextListStyleDefinition*, int, int, int) SIP_OVERRIDE;
    void Move(const ::wxPoint&) SIP_OVERRIDE;
    ::wxRichTextObject* Clone() const SIP_OVERRIDE;
    void Show(bool) SIP_OVERRIDE;
    bool IsTopLevel() const SIP_OVERRIDE;
    bool AdjustAttributes(::wxRichTextAttr&, ::wxRichTextDrawingContext&) SIP_OVERRIDE;
    bool LayoutToBestSize(::wxDC&, ::wxRichTextDrawingContext&, ::wxRichTextBuffer*, const ::wxRichTextAttr&, const ::wxRichTextAttr&, const ::wxRect&, const ::wxRect&, int) SIP_OVERRIDE;
    ::wxRect GetAvailableContentArea(::wxDC&, ::wxRichTextDrawingContext&, const ::wxRect&) const SIP_OVERRIDE;
    int GetBottomMargin() const SIP_OVERRIDE;
    int GetTopMargin() const SIP_OVERRIDE;
    int GetRightMargin() const SIP_OVERRIDE;
    int GetLeftMargin() const SIP_OVERRIDE;
    void SetMargins(int, int, int, int) SIP_OVERRIDE;
    void SetMargins(int) SIP_OVERRIDE;
    ::wxRichTextParagraphLayoutBox* GetParentContainer() const SIP_OVERRIDE;
    ::wxRichTextParagraphLayoutBox* GetContainer() const SIP_OVERRIDE;
    void SetParent(::wxRichTextObject*) SIP_OVERRIDE;
    ::wxRichTextObject* GetParent() const SIP_OVERRIDE;
    bool IsAtomic() const SIP_OVERRIDE;
    bool IsComposite() const SIP_OVERRIDE;
    ::wxRect GetRect() const SIP_OVERRIDE;
    ::wxPoint GetAbsolutePosition() const SIP_OVERRIDE;
    void SetPosition(const ::wxPoint&) SIP_OVERRIDE;
    ::wxPoint GetPosition() const SIP_OVERRIDE;
    ::wxTextAttrSize GetNaturalSize() const SIP_OVERRIDE;
    void SetMinSize(const ::wxSize&) SIP_OVERRIDE;
    ::wxSize GetMinSize() const SIP_OVERRIDE;
    void SetMaxSize(const ::wxSize&) SIP_OVERRIDE;
    ::wxSize GetMaxSize() const SIP_OVERRIDE;
    void SetCachedSize(const ::wxSize&) SIP_OVERRIDE;
    ::wxSize GetCachedSize() const SIP_OVERRIDE;
    ::wxRichTextSelection GetSelection(long, long) const SIP_OVERRIDE;
    bool HandlesChildSelections() const SIP_OVERRIDE;
    void Invalidate(const ::wxRichTextRange&) SIP_OVERRIDE;
    ::wxString GetXMLNodeName() const SIP_OVERRIDE;
    bool UsesParagraphAttributes() const SIP_OVERRIDE;
    bool ImportFromXML(::wxRichTextBuffer*, ::wxXmlNode*, ::wxRichTextXMLHandler*, bool*) SIP_OVERRIDE;
    bool AcceptsFocus() const SIP_OVERRIDE;
    ::wxString GetPropertiesMenuLabel() const SIP_OVERRIDE;
    bool EditProperties(::wxWindow*, ::wxRichTextBuffer*) SIP_OVERRIDE;
    bool CanEditProperties() const SIP_OVERRIDE;
    ::wxRichTextObject* Split(::wxRichTextDrawingContext&) SIP_OVERRIDE;
    bool CanSplit(::wxRichTextDrawingContext&) const SIP_OVERRIDE;
    bool Merge(::wxRichTextObject*, ::wxRichTextDrawingContext&) SIP_OVERRIDE;
    bool CanMerge(::wxRichTextObject*, ::wxRichTextDrawingContext&) const SIP_OVERRIDE;
    ::wxString GetTextForRange(const ::wxRichTextRange&) const SIP_OVERRIDE;
    int GetFloatDirection() const SIP_OVERRIDE;
    bool IsFloating() const SIP_OVERRIDE;
    bool IsFloatable() const SIP_OVERRIDE;
    bool IsEmpty() const SIP_OVERRIDE;
    bool DeleteRange(const ::wxRichTextRange&) SIP_OVERRIDE;
    void CalculateRange(long, long&) SIP_OVERRIDE;
    ::wxRichTextObject* DoSplit(long) SIP_OVERRIDE;
    bool GetRangeSize(const ::wxRichTextRange&, ::wxSize&, int&, ::wxDC&, ::wxRichTextDrawingContext&, int, const ::wxPoint&, const ::wxSize&, ::wxArrayInt*) const SIP_OVERRIDE;
    ::wxSize GetBestSize() const SIP_OVERRIDE;
    bool FindPosition(::wxDC&, ::wxRichTextDrawingContext&, long, ::wxPoint&, int*, bool) SIP_OVERRIDE;
    int HitTest(::wxDC&, ::wxRichTextDrawingContext&, const ::wxPoint&, long&, ::wxRichTextObject**, ::wxRichTextObject**, int) SIP_OVERRIDE;
    bool Layout(::wxDC&, ::wxRichTextDrawingContext&, const ::wxRect&, const ::wxRect&, int) SIP_OVERRIDE;
    bool Draw(::wxDC&, ::wxRichTextDrawingContext&, const ::wxRichTextRange&, const ::wxRichTextSelection&, const ::wxRect&, int, int) SIP_OVERRIDE;
    ::wxRichTextObject* GetChildAtPosition(long) const SIP_OVERRIDE;

public:
    sipSimpleWrapper *sipPySelf;

private:
    sipwxRichTextTable(const sipwxRichTextTable &);
    sipwxRichTextTable &operator = (const sipwxRichTextTable &);

    char sipPyMethods[123];
};

sipwxRichTextTable::sipwxRichTextTable(::wxRichTextObject*parent): ::wxRichTextTable(parent), sipPySelf(SIP_NULLPTR)
{
    memset(sipPyMethods, 0, sizeof (sipPyMethods));
}

sipwxRichTextTable::sipwxRichTextTable(const ::wxRichTextTable& obj): ::wxRichTextTable(obj), sipPySelf(SIP_NULLPTR)
{
    memset(sipPyMethods, 0, sizeof (sipPyMethods));
}

sipwxRichTextTable::~sipwxRichTextTable()
{
    sipInstanceDestroyedEx(&sipPySelf);
}

bool sipwxRichTextTable::AddColumns(int startCol, int noCols, const ::wxRichTextAttr& attr)
{
    sip_gilstate_t sipGILState;
    PyObject *sipMeth;

    sipMeth = sipIsPyMethod(&sipGILState, &sipPyMethods[0], &sipPySelf, SIP_NULLPTR, sipName_AddColumns);

    if (!sipMeth)
        return ::wxRichTextTable::AddColumns(startCol, noCols, attr);

    extern bool sipVH__richtext_107(sip_gilstate_t, sipVirtErrorHandlerFunc, sipSimpleWrapper *, PyObject *, int, int, const ::wxRichTextAttr&);

    return sipVH__richtext_107(sipGILState, 0, sipPySelf, sipMeth, startCol, noCols, attr);
}

bool sipwxRichTextTable::AddRows(int startRow, int noRows, const ::wxRichTextAttr& attr)
{
    sip_gilstate_t sipGILState;
    PyObject *sipMeth;

    sipMeth = sipIsPyMethod(&sipGILState, &sipPyMethods[1], &sipPySelf, SIP_NULLPTR, sipName_AddRows);

    if (!sipMeth)
        return ::wxRichTextTable::AddRows(startRow, noRows, attr);

    extern bool sipVH__richtext_107(sip_gilstate_t, sipVirtErrorHandlerFunc, sipSimpleWrapper *, PyObject *, int, int, const ::wxRichTextAttr&);

    return sipVH__richtext_107(sipGILState, 0, sipPySelf, sipMeth, startRow, noRows, attr);
}

bool sipwxRichTextTable::DeleteColumns(int startCol, int noCols)
{
    sip_gilstate_t sipGILState;
    PyObject *sipMeth;

    sipMeth = sipIsPyMethod(&sipGILState, &sipPyMethods[2], &sipPySelf, SIP_NULLPTR, sipName_DeleteColumns);

    if (!sipMeth)
        return ::wxRichTextTable::DeleteColumns(startCol, noCols);

    extern bool sipVH__richtext_105(sip_gilstate_t, sipVirtErrorHandlerFunc, sipSimpleWrapper *, PyObject *, int, int);

    return sipVH__richtext_105(sipGILState, 0, sipPySelf, sipMeth, startCol, noCols);
}

bool sipwxRichTextTable::DeleteRows(int startRow, int noRows)
{
    sip_gilstate_t sipGILState;
    PyObject *sipMeth;

    sipMeth = sipIsPyMethod(&sipGILState, &sipPyMethods[3], &sipPySelf, SIP_NULLPTR, sipName_DeleteRows);

    if (!sipMeth)
        return ::wxRichTextTable::DeleteRows(startRow, noRows);

    extern bool sipVH__richtext_105(sip_gilstate_t, sipVirtErrorHandlerFunc, sipSimpleWrapper *, PyObject *, int, int);

    return sipVH__richtext_105(sipGILState, 0, sipPySelf, sipMeth, startRow, noRows);
}

bool sipwxRichTextTable::SetCellStyle(const ::wxRichTextSelection& selection, const ::wxRichTextAttr& style, int flags)
{
    sip_gilstate_t sipGILState;
    PyObject *sipMeth;

    sipMeth = sipIsPyMethod(&sipGILState, &sipPyMethods[4], &sipPySelf, SIP_NULLPTR, sipName_SetCellStyle);

    if (!sipMeth)
        return ::wxRichTextTable::SetCellStyle(selection, style, flags);

    extern bool sipVH__richtext_106(sip_gilstate_t, sipVirtErrorHandlerFunc, sipSimpleWrapper *, PyObject *, const ::wxRichTextSelection&, const ::wxRichTextAttr&, int);

    return sipVH__richtext_106(sipGILState, 0, sipPySelf, sipMeth, selection, style, flags);
}

bool sipwxRichTextTable::CreateTable(int rows, int cols)
{
    sip_gilstate_t sipGILState;
    PyObject *sipMeth;

    sipMeth = sipIsPyMethod(&sipGILState, &sipPyMethods[5], &sipPySelf, SIP_NULLPTR, sipName_CreateTable);

    if (!sipMeth)
        return ::wxRichTextTable::CreateTable(rows, cols);

    extern bool sipVH__richtext_105(sip_gilstate_t, sipVirtErrorHandlerFunc, sipSimpleWrapper *, PyObject *, int, int);

    return sipVH__richtext_105(sipGILState, 0, sipPySelf, sipMeth, rows, cols);
}

void sipwxRichTextTable::ClearTable()
{
    sip_gilstate_t sipGILState;
    PyObject *sipMeth;

    sipMeth = sipIsPyMethod(&sipGILState, &sipPyMethods[6], &sipPySelf, SIP_NULLPTR, sipName_ClearTable);

    if (!sipMeth)
    {
        ::wxRichTextTable::ClearTable();
        return;
    }

    extern void sipVH__richtext_40(sip_gilstate_t, sipVirtErrorHandlerFunc, sipSimpleWrapper *, PyObject *);

    sipVH__richtext_40(sipGILState, 0, sipPySelf, sipMeth);
}

::wxPosition sipwxRichTextTable::GetFocusedCell() const
{
    sip_gilstate_t sipGILState;
    PyObject *sipMeth;

    sipMeth = sipIsPyMethod(&sipGILState, const_cast<char *>(&sipPyMethods[7]), const_cast<sipSimpleWrapper **>(&sipPySelf), SIP_NULLPTR, sipName_GetFocusedCell);

    if (!sipMeth)
        return ::wxRichTextTable::GetFocusedCell();

    extern ::wxPosition sipVH__richtext_104(sip_gilstate_t, sipVirtErrorHandlerFunc, sipSimpleWrapper *, PyObject *);

    return sipVH__richtext_104(sipGILState, 0, sipPySelf, sipMeth);
}

bool sipwxRichTextTable::GetCellRowColumnPosition(long pos, int& row, int& col) const
{
    sip_gilstate_t sipGILState;
    PyObject *sipMeth;

    sipMeth = sipIsPyMethod(&sipGILState, const_cast<char *>(&sipPyMethods[8]), const_cast<sipSimpleWrapper **>(&sipPySelf), SIP_NULLPTR, sipName_GetCellRowColumnPosition);

    if (!sipMeth)
        return ::wxRichTextTable::GetCellRowColumnPosition(pos, row, col);

    extern bool sipVH__richtext_103(sip_gilstate_t, sipVirtErrorHandlerFunc, sipSimpleWrapper *, PyObject *, long, int&, int&);

    return sipVH__richtext_103(sipGILState, 0, sipPySelf, sipMeth, pos, row, col);
}

::wxRichTextCell* sipwxRichTextTable::GetCell(long pos) const
{
    sip_gilstate_t sipGILState;
    PyObject *sipMeth;

    sipMeth = sipIsPyMethod(&sipGILState, const_cast<char *>(&sipPyMethods[9]), const_cast<sipSimpleWrapper **>(&sipPySelf), SIP_NULLPTR, sipName_GetCell);

    if (!sipMeth)
        return ::wxRichTextTable::GetCell(pos);

    extern ::wxRichTextCell* sipVH__richtext_102(sip_gilstate_t, sipVirtErrorHandlerFunc, sipSimpleWrapper *, PyObject *, long);

    return sipVH__richtext_102(sipGILState, 0, sipPySelf, sipMeth, pos);
}

::wxRichTextCell* sipwxRichTextTable::GetCell(int row, int col) const
{
    sip_gilstate_t sipGILState;
    PyObject *sipMeth;

    sipMeth = sipIsPyMethod(&sipGILState, const_cast<char *>(&sipPyMethods[10]), const_cast<sipSimpleWrapper **>(&sipPySelf), SIP_NULLPTR, sipName_GetCell);

    if (!sipMeth)
        return ::wxRichTextTable::GetCell(row, col);

    extern ::wxRichTextCell* sipVH__richtext_101(sip_gilstate_t, sipVirtErrorHandlerFunc, sipSimpleWrapper *, PyObject *, int, int);

    return sipVH__richtext_101(sipGILState, 0, sipPySelf, sipMeth, row, col);
}

bool sipwxRichTextTable::UpdateFloatingObjects(const ::wxRect& availableRect, ::wxRichTextObject*untilObj)
{
    sip_gilstate_t sipGILState;
    PyObject *sipMeth;

    sipMeth = sipIsPyMethod(&sipGILState, &sipPyMethods[11], &sipPySelf, SIP_NULLPTR, sipName_UpdateFloatingObjects);

    if (!sipMeth)
        return ::wxRichTextTable::UpdateFloatingObjects(availableRect, untilObj);

    extern bool sipVH__richtext_73(sip_gilstate_t, sipVirtErrorHandlerFunc, sipSimpleWrapper *, PyObject *, const ::wxRect&, ::wxRichTextObject*);

    return sipVH__richtext_73(sipGILState, 0, sipPySelf, sipMeth, availableRect, untilObj);
}

void sipwxRichTextTable::InvalidateHierarchy(const ::wxRichTextRange& invalidRange)
{
    sip_gilstate_t sipGILState;
    PyObject *sipMeth;

    sipMeth = sipIsPyMethod(&sipGILState, &sipPyMethods[12], &sipPySelf, SIP_NULLPTR, sipName_InvalidateHierarchy);

    if (!sipMeth)
    {
        ::wxRichTextTable::InvalidateHierarchy(invalidRange);
        return;
    }

    extern void sipVH__richtext_18(sip_gilstate_t, sipVirtErrorHandlerFunc, sipSimpleWrapper *, PyObject *, const ::wxRichTextRange&);

    sipVH__richtext_18(sipGILState, 0, sipPySelf, sipMeth, invalidRange);
}

void sipwxRichTextTable::DoInvalidate(const ::wxRichTextRange& invalidRange)
{
    sip_gilstate_t sipGILState;
    PyObject *sipMeth;

    sipMeth = sipIsPyMethod(&sipGILState, &sipPyMethods[13], &sipPySelf, SIP_NULLPTR, sipName_DoInvalidate);

    if (!sipMeth)
    {
        ::wxRichTextTable::DoInvalidate(invalidRange);
        return;
    }

    extern void sipVH__richtext_18(sip_gilstate_t, sipVirtErrorHandlerFunc, sipSimpleWrapper *, PyObject *, const ::wxRichTextRange&);

    sipVH__richtext_18(sipGILState, 0, sipPySelf, sipMeth, invalidRange);
}

const ::wxRichTextAttr& sipwxRichTextTable::GetBasicStyle() const
{
    sip_gilstate_t sipGILState;
    PyObject *sipMeth;

    sipMeth = sipIsPyMethod(&sipGILState, const_cast<char *>(&sipPyMethods[14]), const_cast<sipSimpleWrapper **>(&sipPySelf), SIP_NULLPTR, sipName_GetBasicStyle);

    if (!sipMeth)
        return ::wxRichTextTable::GetBasicStyle();

    extern const ::wxRichTextAttr& sipVH__richtext_71(sip_gilstate_t, sipVirtErrorHandlerFunc, sipSimpleWrapper *, PyObject *);

    return sipVH__richtext_71(sipGILState, 0, sipPySelf, sipMeth);
}

void sipwxRichTextTable::SetBasicStyle(const ::wxRichTextAttr& style)
{
    sip_gilstate_t sipGILState;
    PyObject *sipMeth;

    sipMeth = sipIsPyMethod(&sipGILState, &sipPyMethods[15], &sipPySelf, SIP_NULLPTR, sipName_SetBasicStyle);

    if (!sipMeth)
    {
        ::wxRichTextTable::SetBasicStyle(style);
        return;
    }

    extern void sipVH__richtext_72(sip_gilstate_t, sipVirtErrorHandlerFunc, sipSimpleWrapper *, PyObject *, const ::wxRichTextAttr&);

    sipVH__richtext_72(sipGILState, 0, sipPySelf, sipMeth, style);
}

const ::wxRichTextAttr& sipwxRichTextTable::GetDefaultStyle() const
{
    sip_gilstate_t sipGILState;
    PyObject *sipMeth;

    sipMeth = sipIsPyMethod(&sipGILState, const_cast<char *>(&sipPyMethods[16]), const_cast<sipSimpleWrapper **>(&sipPySelf), SIP_NULLPTR, sipName_GetDefaultStyle);

    if (!sipMeth)
        return ::wxRichTextTable::GetDefaultStyle();

    extern const ::wxRichTextAttr& sipVH__richtext_71(sip_gilstate_t, sipVirtErrorHandlerFunc, sipSimpleWrapper *, PyObject *);

    return sipVH__richtext_71(sipGILState, 0, sipPySelf, sipMeth);
}

bool sipwxRichTextTable::SetDefaultStyle(const ::wxRichTextAttr& style)
{
    sip_gilstate_t sipGILState;
    PyObject *sipMeth;

    sipMeth = sipIsPyMethod(&sipGILState, &sipPyMethods[17], &sipPySelf, SIP_NULLPTR, sipName_SetDefaultStyle);

    if (!sipMeth)
        return ::wxRichTextTable::SetDefaultStyle(style);

    extern bool sipVH__richtext_70(sip_gilstate_t, sipVirtErrorHandlerFunc, sipSimpleWrapper *, PyObject *, const ::wxRichTextAttr&);

    return sipVH__richtext_70(sipGILState, 0, sipPySelf, sipMeth, style);
}

::wxString sipwxRichTextTable::GetText() const
{
    sip_gilstate_t sipGILState;
    PyObject *sipMeth;

    sipMeth = sipIsPyMethod(&sipGILState, const_cast<char *>(&sipPyMethods[18]), const_cast<sipSimpleWrapper **>(&sipPySelf), SIP_NULLPTR, sipName_GetText);

    if (!sipMeth)
        return ::wxRichTextTable::GetText();

    extern ::wxString sipVH__richtext_16(sip_gilstate_t, sipVirtErrorHandlerFunc, sipSimpleWrapper *, PyObject *);

    return sipVH__richtext_16(sipGILState, 0, sipPySelf, sipMeth);
}

void sipwxRichTextTable::UpdateRanges()
{
    sip_gilstate_t sipGILState;
    PyObject *sipMeth;

    sipMeth = sipIsPyMethod(&sipGILState, &sipPyMethods[19], &sipPySelf, SIP_NULLPTR, sipName_UpdateRanges);

    if (!sipMeth)
    {
        ::wxRichTextTable::UpdateRanges();
        return;
    }

    extern void sipVH__richtext_40(sip_gilstate_t, sipVirtErrorHandlerFunc, sipSimpleWrapper *, PyObject *);

    sipVH__richtext_40(sipGILState, 0, sipPySelf, sipMeth);
}

bool sipwxRichTextTable::ApplyStyleSheet(::wxRichTextStyleSheet*styleSheet)
{
    sip_gilstate_t sipGILState;
    PyObject *sipMeth;

    sipMeth = sipIsPyMethod(&sipGILState, &sipPyMethods[20], &sipPySelf, SIP_NULLPTR, sipName_ApplyStyleSheet);

    if (!sipMeth)
        return ::wxRichTextTable::ApplyStyleSheet(styleSheet);

    extern bool sipVH__richtext_69(sip_gilstate_t, sipVirtErrorHandlerFunc, sipSimpleWrapper *, PyObject *, ::wxRichTextStyleSheet*);

    return sipVH__richtext_69(sipGILState, 0, sipPySelf, sipMeth, styleSheet);
}

bool sipwxRichTextTable::CopyFragment(const ::wxRichTextRange& range, ::wxRichTextParagraphLayoutBox& fragment)
{
    sip_gilstate_t sipGILState;
    PyObject *sipMeth;

    sipMeth = sipIsPyMethod(&sipGILState, &sipPyMethods[21], &sipPySelf, SIP_NULLPTR, sipName_CopyFragment);

    if (!sipMeth)
        return ::wxRichTextTable::CopyFragment(range, fragment);

    extern bool sipVH__richtext_68(sip_gilstate_t, sipVirtErrorHandlerFunc, sipSimpleWrapper *, PyObject *, const ::wxRichTextRange&, ::wxRichTextParagraphLayoutBox&);

    return sipVH__richtext_68(sipGILState, 0, sipPySelf, sipMeth, range, fragment);
}

bool sipwxRichTextTable::InsertFragment(long position, ::wxRichTextParagraphLayoutBox& fragment)
{
    sip_gilstate_t sipGILState;
    PyObject *sipMeth;

    sipMeth = sipIsPyMethod(&sipGILState, &sipPyMethods[22], &sipPySelf, SIP_NULLPTR, sipName_InsertFragment);

    if (!sipMeth)
        return ::wxRichTextTable::InsertFragment(position, fragment);

    extern bool sipVH__richtext_67(sip_gilstate_t, sipVirtErrorHandlerFunc, sipSimpleWrapper *, PyObject *, long, ::wxRichTextParagraphLayoutBox&);

    return sipVH__richtext_67(sipGILState, 0, sipPySelf, sipMeth, position, fragment);
}

void sipwxRichTextTable::PrepareContent(::wxRichTextParagraphLayoutBox& container)
{
    sip_gilstate_t sipGILState;
    PyObject *sipMeth;

    sipMeth = sipIsPyMethod(&sipGILState, &sipPyMethods[23], &sipPySelf, SIP_NULLPTR, sipName_PrepareContent);

    if (!sipMeth)
    {
        ::wxRichTextTable::PrepareContent(container);
        return;
    }

    extern void sipVH__richtext_66(sip_gilstate_t, sipVirtErrorHandlerFunc, sipSimpleWrapper *, PyObject *, ::wxRichTextParagraphLayoutBox&);

    sipVH__richtext_66(sipGILState, 0, sipPySelf, sipMeth, container);
}

bool sipwxRichTextTable::HasParagraphAttributes(const ::wxRichTextRange& range, const ::wxRichTextAttr& style) const
{
    sip_gilstate_t sipGILState;
    PyObject *sipMeth;

    sipMeth = sipIsPyMethod(&sipGILState, const_cast<char *>(&sipPyMethods[24]), const_cast<sipSimpleWrapper **>(&sipPySelf), SIP_NULLPTR, sipName_HasParagraphAttributes);

    if (!sipMeth)
        return ::wxRichTextTable::HasParagraphAttributes(range, style);

    extern bool sipVH__richtext_65(sip_gilstate_t, sipVirtErrorHandlerFunc, sipSimpleWrapper *, PyObject *, const ::wxRichTextRange&, const ::wxRichTextAttr&);

    return sipVH__richtext_65(sipGILState, 0, sipPySelf, sipMeth, range, style);
}

bool sipwxRichTextTable::HasCharacterAttributes(const ::wxRichTextRange& range, const ::wxRichTextAttr& style) const
{
    sip_gilstate_t sipGILState;
    PyObject *sipMeth;

    sipMeth = sipIsPyMethod(&sipGILState, const_cast<char *>(&sipPyMethods[25]), const_cast<sipSimpleWrapper **>(&sipPySelf), SIP_NULLPTR, sipName_HasCharacterAttributes);

    if (!sipMeth)
        return ::wxRichTextTable::HasCharacterAttributes(range, style);

    extern bool sipVH__richtext_65(sip_gilstate_t, sipVirtErrorHandlerFunc, sipSimpleWrapper *, PyObject *, const ::wxRichTextRange&, const ::wxRichTextAttr&);

    return sipVH__richtext_65(sipGILState, 0, sipPySelf, sipMeth, range, style);
}

bool sipwxRichTextTable::SetObjectPropertiesWithUndo(::wxRichTextObject& obj, const ::wxRichTextProperties& properties, ::wxRichTextObject*objToSet)
{
    sip_gilstate_t sipGILState;
    PyObject *sipMeth;

    sipMeth = sipIsPyMethod(&sipGILState, &sipPyMethods[26], &sipPySelf, SIP_NULLPTR, sipName_SetObjectPropertiesWithUndo);

    if (!sipMeth)
        return ::wxRichTextTable::SetObjectPropertiesWithUndo(obj, properties, objToSet);

    extern bool sipVH__richtext_64(sip_gilstate_t, sipVirtErrorHandlerFunc, sipSimpleWrapper *, PyObject *, ::wxRichTextObject&, const ::wxRichTextProperties&, ::wxRichTextObject*);

    return sipVH__richtext_64(sipGILState, 0, sipPySelf, sipMeth, obj, properties, objToSet);
}

bool sipwxRichTextTable::SetProperties(const ::wxRichTextRange& range, const ::wxRichTextProperties& properties, int flags)
{
    sip_gilstate_t sipGILState;
    PyObject *sipMeth;

    sipMeth = sipIsPyMethod(&sipGILState, &sipPyMethods[27], &sipPySelf, SIP_NULLPTR, sipName_SetProperties);

    if (!sipMeth)
        return ::wxRichTextTable::SetProperties(range, properties, flags);

    extern bool sipVH__richtext_63(sip_gilstate_t, sipVirtErrorHandlerFunc, sipSimpleWrapper *, PyObject *, const ::wxRichTextRange&, const ::wxRichTextProperties&, int);

    return sipVH__richtext_63(sipGILState, 0, sipPySelf, sipMeth, range, properties, flags);
}

bool sipwxRichTextTable::FindNextParagraphNumber(::wxRichTextParagraph*previousParagraph, ::wxRichTextAttr& attr) const
{
    sip_gilstate_t sipGILState;
    PyObject *sipMeth;

    sipMeth = sipIsPyMethod(&sipGILState, const_cast<char *>(&sipPyMethods[28]), const_cast<sipSimpleWrapper **>(&sipPySelf), SIP_NULLPTR, sipName_FindNextParagraphNumber);

    if (!sipMeth)
        return ::wxRichTextTable::FindNextParagraphNumber(previousParagraph, attr);

    extern bool sipVH__richtext_62(sip_gilstate_t, sipVirtErrorHandlerFunc, sipSimpleWrapper *, PyObject *, ::wxRichTextParagraph*, ::wxRichTextAttr&);

    return sipVH__richtext_62(sipGILState, 0, sipPySelf, sipMeth, previousParagraph, attr);
}

bool sipwxRichTextTable::DoNumberList(const ::wxRichTextRange& range, const ::wxRichTextRange& promotionRange, int promoteBy, ::wxRichTextListStyleDefinition*styleDef, int flags, int startFrom, int specifiedLevel)
{
    sip_gilstate_t sipGILState;
    PyObject *sipMeth;

    sipMeth = sipIsPyMethod(&sipGILState, &sipPyMethods[29], &sipPySelf, SIP_NULLPTR, sipName_DoNumberList);

    if (!sipMeth)
        return ::wxRichTextTable::DoNumberList(range, promotionRange, promoteBy, styleDef, flags, startFrom, specifiedLevel);

    extern bool sipVH__richtext_61(sip_gilstate_t, sipVirtErrorHandlerFunc, sipSimpleWrapper *, PyObject *, const ::wxRichTextRange&, const ::wxRichTextRange&, int, ::wxRichTextListStyleDefinition*, int, int, int);

    return sipVH__richtext_61(sipGILState, 0, sipPySelf, sipMeth, range, promotionRange, promoteBy, styleDef, flags, startFrom, specifiedLevel);
}

bool sipwxRichTextTable::ClearListStyle(const ::wxRichTextRange& range, int flags)
{
    sip_gilstate_t sipGILState;
    PyObject *sipMeth;

    sipMeth = sipIsPyMethod(&sipGILState, &sipPyMethods[30], &sipPySelf, SIP_NULLPTR, sipName_ClearListStyle);

    if (!sipMeth)
        return ::wxRichTextTable::ClearListStyle(range, flags);

    extern bool sipVH__richtext_60(sip_gilstate_t, sipVirtErrorHandlerFunc, sipSimpleWrapper *, PyObject *, const ::wxRichTextRange&, int);

    return sipVH__richtext_60(sipGILState, 0, sipPySelf, sipMeth, range, flags);
}

bool sipwxRichTextTable::GetStyleForRange(const ::wxRichTextRange& range, ::wxRichTextAttr& style)
{
    sip_gilstate_t sipGILState;
    PyObject *sipMeth;

    sipMeth = sipIsPyMethod(&sipGILState, &sipPyMethods[31], &sipPySelf, SIP_NULLPTR, sipName_GetStyleForRange);

    if (!sipMeth)
        return ::wxRichTextTable::GetStyleForRange(range, style);

    extern bool sipVH__richtext_59(sip_gilstate_t, sipVirtErrorHandlerFunc, sipSimpleWrapper *, PyObject *, const ::wxRichTextRange&, ::wxRichTextAttr&);

    return sipVH__richtext_59(sipGILState, 0, sipPySelf, sipMeth, range, style);
}

bool sipwxRichTextTable::DoGetStyle(long position, ::wxRichTextAttr& style, bool combineStyles)
{
    sip_gilstate_t sipGILState;
    PyObject *sipMeth;

    sipMeth = sipIsPyMethod(&sipGILState, &sipPyMethods[32], &sipPySelf, SIP_NULLPTR, sipName_DoGetStyle);

    if (!sipMeth)
        return ::wxRichTextTable::DoGetStyle(position, style, combineStyles);

    extern bool sipVH__richtext_58(sip_gilstate_t, sipVirtErrorHandlerFunc, sipSimpleWrapper *, PyObject *, long, ::wxRichTextAttr&, bool);

    return sipVH__richtext_58(sipGILState, 0, sipPySelf, sipMeth, position, style, combineStyles);
}

bool sipwxRichTextTable::GetUncombinedStyle(long position, ::wxRichTextAttr& style)
{
    sip_gilstate_t sipGILState;
    PyObject *sipMeth;

    sipMeth = sipIsPyMethod(&sipGILState, &sipPyMethods[33], &sipPySelf, SIP_NULLPTR, sipName_GetUncombinedStyle);

    if (!sipMeth)
        return ::wxRichTextTable::GetUncombinedStyle(position, style);

    extern bool sipVH__richtext_57(sip_gilstate_t, sipVirtErrorHandlerFunc, sipSimpleWrapper *, PyObject *, long, ::wxRichTextAttr&);

    return sipVH__richtext_57(sipGILState, 0, sipPySelf, sipMeth, position, style);
}

bool sipwxRichTextTable::GetStyle(long position, ::wxRichTextAttr& style)
{
    sip_gilstate_t sipGILState;
    PyObject *sipMeth;

    sipMeth = sipIsPyMethod(&sipGILState, &sipPyMethods[34], &sipPySelf, SIP_NULLPTR, sipName_GetStyle);

    if (!sipMeth)
        return ::wxRichTextTable::GetStyle(position, style);

    extern bool sipVH__richtext_57(sip_gilstate_t, sipVirtErrorHandlerFunc, sipSimpleWrapper *, PyObject *, long, ::wxRichTextAttr&);

    return sipVH__richtext_57(sipGILState, 0, sipPySelf, sipMeth, position, style);
}

void sipwxRichTextTable::SetStyle(::wxRichTextObject*obj, const ::wxRichTextAttr& textAttr, int flags)
{
    sip_gilstate_t sipGILState;
    PyObject *sipMeth;

    sipMeth = sipIsPyMethod(&sipGILState, &sipPyMethods[35], &sipPySelf, SIP_NULLPTR, sipName_SetStyle);

    if (!sipMeth)
    {
        ::wxRichTextTable::SetStyle(obj, textAttr, flags);
        return;
    }

    extern void sipVH__richtext_56(sip_gilstate_t, sipVirtErrorHandlerFunc, sipSimpleWrapper *, PyObject *, ::wxRichTextObject*, const ::wxRichTextAttr&, int);

    sipVH__richtext_56(sipGILState, 0, sipPySelf, sipMeth, obj, textAttr, flags);
}

bool sipwxRichTextTable::SetStyle(const ::wxRichTextRange& range, const ::wxRichTextAttr& style, int flags)
{
    sip_gilstate_t sipGILState;
    PyObject *sipMeth;

    sipMeth = sipIsPyMethod(&sipGILState, &sipPyMethods[36], &sipPySelf, SIP_NULLPTR, sipName_SetStyle);

    if (!sipMeth)
        return ::wxRichTextTable::SetStyle(range, style, flags);

    extern bool sipVH__richtext_55(sip_gilstate_t, sipVirtErrorHandlerFunc, sipSimpleWrapper *, PyObject *, const ::wxRichTextRange&, const ::wxRichTextAttr&, int);

    return sipVH__richtext_55(sipGILState, 0, sipPySelf, sipMeth, range, style, flags);
}

bool sipwxRichTextTable::PositionToXY(long pos, long*x, long*y) const
{
    sip_gilstate_t sipGILState;
    PyObject *sipMeth;

    sipMeth = sipIsPyMethod(&sipGILState, const_cast<char *>(&sipPyMethods[37]), const_cast<sipSimpleWrapper **>(&sipPySelf), SIP_NULLPTR, sipName_PositionToXY);

    if (!sipMeth)
        return ::wxRichTextTable::PositionToXY(pos, x, y);

    extern bool sipVH__richtext_54(sip_gilstate_t, sipVirtErrorHandlerFunc, sipSimpleWrapper *, PyObject *, long, long*, long*);

    return sipVH__richtext_54(sipGILState, 0, sipPySelf, sipMeth, pos, x, y);
}

long sipwxRichTextTable::XYToPosition(long x, long y) const
{
    sip_gilstate_t sipGILState;
    PyObject *sipMeth;

    sipMeth = sipIsPyMethod(&sipGILState, const_cast<char *>(&sipPyMethods[38]), const_cast<sipSimpleWrapper **>(&sipPySelf), SIP_NULLPTR, sipName_XYToPosition);

    if (!sipMeth)
        return ::wxRichTextTable::XYToPosition(x, y);

    extern long sipVH__richtext_53(sip_gilstate_t, sipVirtErrorHandlerFunc, sipSimpleWrapper *, PyObject *, long, long);

    return sipVH__richtext_53(sipGILState, 0, sipPySelf, sipMeth, x, y);
}

::wxString sipwxRichTextTable::GetParagraphText(long paragraphNumber) const
{
    sip_gilstate_t sipGILState;
    PyObject *sipMeth;

    sipMeth = sipIsPyMethod(&sipGILState, const_cast<char *>(&sipPyMethods[39]), const_cast<sipSimpleWrapper **>(&sipPySelf), SIP_NULLPTR, sipName_GetParagraphText);

    if (!sipMeth)
        return ::wxRichTextTable::GetParagraphText(paragraphNumber);

    extern ::wxString sipVH__richtext_52(sip_gilstate_t, sipVirtErrorHandlerFunc, sipSimpleWrapper *, PyObject *, long);

    return sipVH__richtext_52(sipGILState, 0, sipPySelf, sipMeth, paragraphNumber);
}

int sipwxRichTextTable::GetLineCount() const
{
    sip_gilstate_t sipGILState;
    PyObject *sipMeth;

    sipMeth = sipIsPyMethod(&sipGILState, const_cast<char *>(&sipPyMethods[40]), const_cast<sipSimpleWrapper **>(&sipPySelf), SIP_NULLPTR, sipName_GetLineCount);

    if (!sipMeth)
        return ::wxRichTextTable::GetLineCount();

    extern int sipVH__richtext_10(sip_gilstate_t, sipVirtErrorHandlerFunc, sipSimpleWrapper *, PyObject *);

    return sipVH__richtext_10(sipGILState, 0, sipPySelf, sipMeth);
}

int sipwxRichTextTable::GetParagraphCount() const
{
    sip_gilstate_t sipGILState;
    PyObject *sipMeth;

    sipMeth = sipIsPyMethod(&sipGILState, const_cast<char *>(&sipPyMethods[41]), const_cast<sipSimpleWrapper **>(&sipPySelf), SIP_NULLPTR, sipName_GetParagraphCount);

    if (!sipMeth)
        return ::wxRichTextTable::GetParagraphCount();

    extern int sipVH__richtext_10(sip_gilstate_t, sipVirtErrorHandlerFunc, sipSimpleWrapper *, PyObject *);

    return sipVH__richtext_10(sipGILState, 0, sipPySelf, sipMeth);
}

int sipwxRichTextTable::GetParagraphLength(long paragraphNumber) const
{
    sip_gilstate_t sipGILState;
    PyObject *sipMeth;

    sipMeth = sipIsPyMethod(&sipGILState, const_cast<char *>(&sipPyMethods[42]), const_cast<sipSimpleWrapper **>(&sipPySelf), SIP_NULLPTR, sipName_GetParagraphLength);

    if (!sipMeth)
        return ::wxRichTextTable::GetParagraphLength(paragraphNumber);

    extern int sipVH__richtext_51(sip_gilstate_t, sipVirtErrorHandlerFunc, sipSimpleWrapper *, PyObject *, long);

    return sipVH__richtext_51(sipGILState, 0, sipPySelf, sipMeth, paragraphNumber);
}

::wxRichTextParagraph* sipwxRichTextTable::GetParagraphForLine(::wxRichTextLine*line) const
{
    sip_gilstate_t sipGILState;
    PyObject *sipMeth;

    sipMeth = sipIsPyMethod(&sipGILState, const_cast<char *>(&sipPyMethods[43]), const_cast<sipSimpleWrapper **>(&sipPySelf), SIP_NULLPTR, sipName_GetParagraphForLine);

    if (!sipMeth)
        return ::wxRichTextTable::GetParagraphForLine(line);

    extern ::wxRichTextParagraph* sipVH__richtext_50(sip_gilstate_t, sipVirtErrorHandlerFunc, sipSimpleWrapper *, PyObject *, ::wxRichTextLine*);

    return sipVH__richtext_50(sipGILState, 0, sipPySelf, sipMeth, line);
}

::wxRichTextParagraph* sipwxRichTextTable::GetParagraphAtLine(long paragraphNumber) const
{
    sip_gilstate_t sipGILState;
    PyObject *sipMeth;

    sipMeth = sipIsPyMethod(&sipGILState, const_cast<char *>(&sipPyMethods[44]), const_cast<sipSimpleWrapper **>(&sipPySelf), SIP_NULLPTR, sipName_GetParagraphAtLine);

    if (!sipMeth)
        return ::wxRichTextTable::GetParagraphAtLine(paragraphNumber);

    extern ::wxRichTextParagraph* sipVH__richtext_49(sip_gilstate_t, sipVirtErrorHandlerFunc, sipSimpleWrapper *, PyObject *, long);

    return sipVH__richtext_49(sipGILState, 0, sipPySelf, sipMeth, paragraphNumber);
}

::wxRichTextObject* sipwxRichTextTable::GetLeafObjectAtPosition(long position) const
{
    sip_gilstate_t sipGILState;
    PyObject *sipMeth;

    sipMeth = sipIsPyMethod(&sipGILState, const_cast<char *>(&sipPyMethods[45]), const_cast<sipSimpleWrapper **>(&sipPySelf), SIP_NULLPTR, sipName_GetLeafObjectAtPosition);

    if (!sipMeth)
        return ::wxRichTextTable::GetLeafObjectAtPosition(position);

    extern ::wxRichTextObject* sipVH__richtext_6(sip_gilstate_t, sipVirtErrorHandlerFunc, sipSimpleWrapper *, PyObject *, long);

    return sipVH__richtext_6(sipGILState, 0, sipPySelf, sipMeth, position);
}

::wxRichTextLine* sipwxRichTextTable::GetLineForVisibleLineNumber(long lineNumber) const
{
    sip_gilstate_t sipGILState;
    PyObject *sipMeth;

    sipMeth = sipIsPyMethod(&sipGILState, const_cast<char *>(&sipPyMethods[46]), const_cast<sipSimpleWrapper **>(&sipPySelf), SIP_NULLPTR, sipName_GetLineForVisibleLineNumber);

    if (!sipMeth)
        return ::wxRichTextTable::GetLineForVisibleLineNumber(lineNumber);

    extern ::wxRichTextLine* sipVH__richtext_48(sip_gilstate_t, sipVirtErrorHandlerFunc, sipSimpleWrapper *, PyObject *, long);

    return sipVH__richtext_48(sipGILState, 0, sipPySelf, sipMeth, lineNumber);
}

long sipwxRichTextTable::GetVisibleLineNumber(long pos, bool caretPosition, bool startOfLine) const
{
    sip_gilstate_t sipGILState;
    PyObject *sipMeth;

    sipMeth = sipIsPyMethod(&sipGILState, const_cast<char *>(&sipPyMethods[47]), const_cast<sipSimpleWrapper **>(&sipPySelf), SIP_NULLPTR, sipName_GetVisibleLineNumber);

    if (!sipMeth)
        return ::wxRichTextTable::GetVisibleLineNumber(pos, caretPosition, startOfLine);

    extern long sipVH__richtext_47(sip_gilstate_t, sipVirtErrorHandlerFunc, sipSimpleWrapper *, PyObject *, long, bool, bool);

    return sipVH__richtext_47(sipGILState, 0, sipPySelf, sipMeth, pos, caretPosition, startOfLine);
}

::wxSize sipwxRichTextTable::GetLineSizeAtPosition(long pos, bool caretPosition) const
{
    sip_gilstate_t sipGILState;
    PyObject *sipMeth;

    sipMeth = sipIsPyMethod(&sipGILState, const_cast<char *>(&sipPyMethods[48]), const_cast<sipSimpleWrapper **>(&sipPySelf), SIP_NULLPTR, sipName_GetLineSizeAtPosition);

    if (!sipMeth)
        return ::wxRichTextTable::GetLineSizeAtPosition(pos, caretPosition);

    extern ::wxSize sipVH__richtext_46(sip_gilstate_t, sipVirtErrorHandlerFunc, sipSimpleWrapper *, PyObject *, long, bool);

    return sipVH__richtext_46(sipGILState, 0, sipPySelf, sipMeth, pos, caretPosition);
}

::wxRichTextParagraph* sipwxRichTextTable::GetParagraphAtPosition(long pos, bool caretPosition) const
{
    sip_gilstate_t sipGILState;
    PyObject *sipMeth;

    sipMeth = sipIsPyMethod(&sipGILState, const_cast<char *>(&sipPyMethods[49]), const_cast<sipSimpleWrapper **>(&sipPySelf), SIP_NULLPTR, sipName_GetParagraphAtPosition);

    if (!sipMeth)
        return ::wxRichTextTable::GetParagraphAtPosition(pos, caretPosition);

    extern ::wxRichTextParagraph* sipVH__richtext_45(sip_gilstate_t, sipVirtErrorHandlerFunc, sipSimpleWrapper *, PyObject *, long, bool);

    return sipVH__richtext_45(sipGILState, 0, sipPySelf, sipMeth, pos, caretPosition);
}

::wxRichTextLine* sipwxRichTextTable::GetLineAtYPosition(int y) const
{
    sip_gilstate_t sipGILState;
    PyObject *sipMeth;

    sipMeth = sipIsPyMethod(&sipGILState, const_cast<char *>(&sipPyMethods[50]), const_cast<sipSimpleWrapper **>(&sipPySelf), SIP_NULLPTR, sipName_GetLineAtYPosition);

    if (!sipMeth)
        return ::wxRichTextTable::GetLineAtYPosition(y);

    extern ::wxRichTextLine* sipVH__richtext_44(sip_gilstate_t, sipVirtErrorHandlerFunc, sipSimpleWrapper *, PyObject *, int);

    return sipVH__richtext_44(sipGILState, 0, sipPySelf, sipMeth, y);
}

::wxRichTextLine* sipwxRichTextTable::GetLineAtPosition(long pos, bool caretPosition) const
{
    sip_gilstate_t sipGILState;
    PyObject *sipMeth;

    sipMeth = sipIsPyMethod(&sipGILState, const_cast<char *>(&sipPyMethods[51]), const_cast<sipSimpleWrapper **>(&sipPySelf), SIP_NULLPTR, sipName_GetLineAtPosition);

    if (!sipMeth)
        return ::wxRichTextTable::GetLineAtPosition(pos, caretPosition);

    extern ::wxRichTextLine* sipVH__richtext_43(sip_gilstate_t, sipVirtErrorHandlerFunc, sipSimpleWrapper *, PyObject *, long, bool);

    return sipVH__richtext_43(sipGILState, 0, sipPySelf, sipMeth, pos, caretPosition);
}

::wxRichTextRange sipwxRichTextTable::AddParagraphs(const ::wxString& text, ::wxRichTextAttr*paraStyle)
{
    sip_gilstate_t sipGILState;
    PyObject *sipMeth;

    sipMeth = sipIsPyMethod(&sipGILState, &sipPyMethods[52], &sipPySelf, SIP_NULLPTR, sipName_AddParagraphs);

    if (!sipMeth)
        return ::wxRichTextTable::AddParagraphs(text, paraStyle);

    extern ::wxRichTextRange sipVH__richtext_41(sip_gilstate_t, sipVirtErrorHandlerFunc, sipSimpleWrapper *, PyObject *, const ::wxString&, ::wxRichTextAttr*);

    return sipVH__richtext_41(sipGILState, 0, sipPySelf, sipMeth, text, paraStyle);
}

::wxRichTextRange sipwxRichTextTable::AddImage(const ::wxImage& image, ::wxRichTextAttr*paraStyle)
{
    sip_gilstate_t sipGILState;
    PyObject *sipMeth;

    sipMeth = sipIsPyMethod(&sipGILState, &sipPyMethods[53], &sipPySelf, SIP_NULLPTR, sipName_AddImage);

    if (!sipMeth)
        return ::wxRichTextTable::AddImage(image, paraStyle);

    extern ::wxRichTextRange sipVH__richtext_42(sip_gilstate_t, sipVirtErrorHandlerFunc, sipSimpleWrapper *, PyObject *, const ::wxImage&, ::wxRichTextAttr*);

    return sipVH__richtext_42(sipGILState, 0, sipPySelf, sipMeth, image, paraStyle);
}

::wxRichTextRange sipwxRichTextTable::AddParagraph(const ::wxString& text, ::wxRichTextAttr*paraStyle)
{
    sip_gilstate_t sipGILState;
    PyObject *sipMeth;

    sipMeth = sipIsPyMethod(&sipGILState, &sipPyMethods[54], &sipPySelf, SIP_NULLPTR, sipName_AddParagraph);

    if (!sipMeth)
        return ::wxRichTextTable::AddParagraph(text, paraStyle);

    extern ::wxRichTextRange sipVH__richtext_41(sip_gilstate_t, sipVirtErrorHandlerFunc, sipSimpleWrapper *, PyObject *, const ::wxString&, ::wxRichTextAttr*);

    return sipVH__richtext_41(sipGILState, 0, sipPySelf, sipMeth, text, paraStyle);
}

void sipwxRichTextTable::Reset()
{
    sip_gilstate_t sipGILState;
    PyObject *sipMeth;

    sipMeth = sipIsPyMethod(&sipGILState, &sipPyMethods[55], &sipPySelf, SIP_NULLPTR, sipName_Reset);

    if (!sipMeth)
    {
        ::wxRichTextTable::Reset();
        return;
    }

    extern void sipVH__richtext_40(sip_gilstate_t, sipVirtErrorHandlerFunc, sipSimpleWrapper *, PyObject *);

    sipVH__richtext_40(sipGILState, 0, sipPySelf, sipMeth);
}

void sipwxRichTextTable::Clear()
{
    sip_gilstate_t sipGILState;
    PyObject *sipMeth;

    sipMeth = sipIsPyMethod(&sipGILState, &sipPyMethods[56], &sipPySelf, SIP_NULLPTR, sipName_Clear);

    if (!sipMeth)
    {
        ::wxRichTextTable::Clear();
        return;
    }

    extern void sipVH__richtext_40(sip_gilstate_t, sipVirtErrorHandlerFunc, sipSimpleWrapper *, PyObject *);

    sipVH__richtext_40(sipGILState, 0, sipPySelf, sipMeth);
}

::wxRichTextStyleSheet* sipwxRichTextTable::GetStyleSheet() const
{
    sip_gilstate_t sipGILState;
    PyObject *sipMeth;

    sipMeth = sipIsPyMethod(&sipGILState, const_cast<char *>(&sipPyMethods[57]), const_cast<sipSimpleWrapper **>(&sipPySelf), SIP_NULLPTR, sipName_GetStyleSheet);

    if (!sipMeth)
        return ::wxRichTextTable::GetStyleSheet();

    extern ::wxRichTextStyleSheet* sipVH__richtext_39(sip_gilstate_t, sipVirtErrorHandlerFunc, sipSimpleWrapper *, PyObject *);

    return sipVH__richtext_39(sipGILState, 0, sipPySelf, sipMeth);
}

bool sipwxRichTextTable::PromoteList(int promoteBy, const ::wxRichTextRange& range, const ::wxString& defName, int flags, int specifiedLevel)
{
    sip_gilstate_t sipGILState;
    PyObject *sipMeth;

    sipMeth = sipIsPyMethod(&sipGILState, &sipPyMethods[58], &sipPySelf, SIP_NULLPTR, sipName_PromoteList);

    if (!sipMeth)
        return ::wxRichTextTable::PromoteList(promoteBy, range, defName, flags, specifiedLevel);

    extern bool sipVH__richtext_38(sip_gilstate_t, sipVirtErrorHandlerFunc, sipSimpleWrapper *, PyObject *, int, const ::wxRichTextRange&, const ::wxString&, int, int);

    return sipVH__richtext_38(sipGILState, 0, sipPySelf, sipMeth, promoteBy, range, defName, flags, specifiedLevel);
}

bool sipwxRichTextTable::PromoteList(int promoteBy, const ::wxRichTextRange& range, ::wxRichTextListStyleDefinition*def, int flags, int specifiedLevel)
{
    sip_gilstate_t sipGILState;
    PyObject *sipMeth;

    sipMeth = sipIsPyMethod(&sipGILState, &sipPyMethods[59], &sipPySelf, SIP_NULLPTR, sipName_PromoteList);

    if (!sipMeth)
        return ::wxRichTextTable::PromoteList(promoteBy, range, def, flags, specifiedLevel);

    extern bool sipVH__richtext_37(sip_gilstate_t, sipVirtErrorHandlerFunc, sipSimpleWrapper *, PyObject *, int, const ::wxRichTextRange&, ::wxRichTextListStyleDefinition*, int, int);

    return sipVH__richtext_37(sipGILState, 0, sipPySelf, sipMeth, promoteBy, range, def, flags, specifiedLevel);
}

bool sipwxRichTextTable::NumberList(const ::wxRichTextRange& range, const ::wxString& defName, int flags, int startFrom, int specifiedLevel)
{
    sip_gilstate_t sipGILState;
    PyObject *sipMeth;

    sipMeth = sipIsPyMethod(&sipGILState, &sipPyMethods[60], &sipPySelf, SIP_NULLPTR, sipName_NumberList);

    if (!sipMeth)
        return ::wxRichTextTable::NumberList(range, defName, flags, startFrom, specifiedLevel);

    extern bool sipVH__richtext_36(sip_gilstate_t, sipVirtErrorHandlerFunc, sipSimpleWrapper *, PyObject *, const ::wxRichTextRange&, const ::wxString&, int, int, int);

    return sipVH__richtext_36(sipGILState, 0, sipPySelf, sipMeth, range, defName, flags, startFrom, specifiedLevel);
}

bool sipwxRichTextTable::NumberList(const ::wxRichTextRange& range, ::wxRichTextListStyleDefinition*def, int flags, int startFrom, int specifiedLevel)
{
    sip_gilstate_t sipGILState;
    PyObject *sipMeth;

    sipMeth = sipIsPyMethod(&sipGILState, &sipPyMethods[61], &sipPySelf, SIP_NULLPTR, sipName_NumberList);

    if (!sipMeth)
        return ::wxRichTextTable::NumberList(range, def, flags, startFrom, specifiedLevel);

    extern bool sipVH__richtext_35(sip_gilstate_t, sipVirtErrorHandlerFunc, sipSimpleWrapper *, PyObject *, const ::wxRichTextRange&, ::wxRichTextListStyleDefinition*, int, int, int);

    return sipVH__richtext_35(sipGILState, 0, sipPySelf, sipMeth, range, def, flags, startFrom, specifiedLevel);
}

bool sipwxRichTextTable::SetListStyle(const ::wxRichTextRange& range, const ::wxString& defName, int flags, int startFrom, int specifiedLevel)
{
    sip_gilstate_t sipGILState;
    PyObject *sipMeth;

    sipMeth = sipIsPyMethod(&sipGILState, &sipPyMethods[62], &sipPySelf, SIP_NULLPTR, sipName_SetListStyle);

    if (!sipMeth)
        return ::wxRichTextTable::SetListStyle(range, defName, flags, startFrom, specifiedLevel);

    extern bool sipVH__richtext_36(sip_gilstate_t, sipVirtErrorHandlerFunc, sipSimpleWrapper *, PyObject *, const ::wxRichTextRange&, const ::wxString&, int, int, int);

    return sipVH__richtext_36(sipGILState, 0, sipPySelf, sipMeth, range, defName, flags, startFrom, specifiedLevel);
}

bool sipwxRichTextTable::SetListStyle(const ::wxRichTextRange& range, ::wxRichTextListStyleDefinition*styleDef, int flags, int startFrom, int specifiedLevel)
{
    sip_gilstate_t sipGILState;
    PyObject *sipMeth;

    sipMeth = sipIsPyMethod(&sipGILState, &sipPyMethods[63], &sipPySelf, SIP_NULLPTR, sipName_SetListStyle);

    if (!sipMeth)
        return ::wxRichTextTable::SetListStyle(range, styleDef, flags, startFrom, specifiedLevel);

    extern bool sipVH__richtext_35(sip_gilstate_t, sipVirtErrorHandlerFunc, sipSimpleWrapper *, PyObject *, const ::wxRichTextRange&, ::wxRichTextListStyleDefinition*, int, int, int);

    return sipVH__richtext_35(sipGILState, 0, sipPySelf, sipMeth, range, styleDef, flags, startFrom, specifiedLevel);
}

void sipwxRichTextTable::Move(const ::wxPoint& pt)
{
    sip_gilstate_t sipGILState;
    PyObject *sipMeth;

    sipMeth = sipIsPyMethod(&sipGILState, &sipPyMethods[64], &sipPySelf, SIP_NULLPTR, sipName_Move);

    if (!sipMeth)
    {
        ::wxRichTextTable::Move(pt);
        return;
    }

    extern void sipVH__richtext_23(sip_gilstate_t, sipVirtErrorHandlerFunc, sipSimpleWrapper *, PyObject *, const ::wxPoint&);

    sipVH__richtext_23(sipGILState, 0, sipPySelf, sipMeth, pt);
}

::wxRichTextObject* sipwxRichTextTable::Clone() const
{
    sip_gilstate_t sipGILState;
    PyObject *sipMeth;

    sipMeth = sipIsPyMethod(&sipGILState, const_cast<char *>(&sipPyMethods[65]), const_cast<sipSimpleWrapper **>(&sipPySelf), SIP_NULLPTR, sipName_Clone);

    if (!sipMeth)
        return ::wxRichTextTable::Clone();

    extern ::wxRichTextObject* sipVH__richtext_34(sip_gilstate_t, sipVirtErrorHandlerFunc, sipSimpleWrapper *, PyObject *);

    return sipVH__richtext_34(sipGILState, 0, sipPySelf, sipMeth);
}

void sipwxRichTextTable::Show(bool show)
{
    sip_gilstate_t sipGILState;
    PyObject *sipMeth;

    sipMeth = sipIsPyMethod(&sipGILState, &sipPyMethods[66], &sipPySelf, SIP_NULLPTR, sipName_Show);

    if (!sipMeth)
    {
        ::wxRichTextTable::Show(show);
        return;
    }

    extern void sipVH__richtext_33(sip_gilstate_t, sipVirtErrorHandlerFunc, sipSimpleWrapper *, PyObject *, bool);

    sipVH__richtext_33(sipGILState, 0, sipPySelf, sipMeth, show);
}

bool sipwxRichTextTable::IsTopLevel() const
{
    sip_gilstate_t sipGILState;
    PyObject *sipMeth;

    sipMeth = sipIsPyMethod(&sipGILState, const_cast<char *>(&sipPyMethods[67]), const_cast<sipSimpleWrapper **>(&sipPySelf), SIP_NULLPTR, sipName_IsTopLevel);

    if (!sipMeth)
        return ::wxRichTextTable::IsTopLevel();

    extern bool sipVH__richtext_9(sip_gilstate_t, sipVirtErrorHandlerFunc, sipSimpleWrapper *, PyObject *);

    return sipVH__richtext_9(sipGILState, 0, sipPySelf, sipMeth);
}

bool sipwxRichTextTable::AdjustAttributes(::wxRichTextAttr& attr, ::wxRichTextDrawingContext& context)
{
    sip_gilstate_t sipGILState;
    PyObject *sipMeth;

    sipMeth = sipIsPyMethod(&sipGILState, &sipPyMethods[68], &sipPySelf, SIP_NULLPTR, sipName_AdjustAttributes);

    if (!sipMeth)
        return ::wxRichTextTable::AdjustAttributes(attr, context);

    extern bool sipVH__richtext_32(sip_gilstate_t, sipVirtErrorHandlerFunc, sipSimpleWrapper *, PyObject *, ::wxRichTextAttr&, ::wxRichTextDrawingContext&);

    return sipVH__richtext_32(sipGILState, 0, sipPySelf, sipMeth, attr, context);
}

bool sipwxRichTextTable::LayoutToBestSize(::wxDC& dc, ::wxRichTextDrawingContext& context, ::wxRichTextBuffer*buffer, const ::wxRichTextAttr& parentAttr, const ::wxRichTextAttr& attr, const ::wxRect& availableParentSpace, const ::wxRect& availableContainerSpace, int style)
{
    sip_gilstate_t sipGILState;
    PyObject *sipMeth;

    sipMeth = sipIsPyMethod(&sipGILState, &sipPyMethods[69], &sipPySelf, SIP_NULLPTR, sipName_LayoutToBestSize);

    if (!sipMeth)
        return ::wxRichTextTable::LayoutToBestSize(dc, context, buffer, parentAttr, attr, availableParentSpace, availableContainerSpace, style);

    extern bool sipVH__richtext_31(sip_gilstate_t, sipVirtErrorHandlerFunc, sipSimpleWrapper *, PyObject *, ::wxDC&, ::wxRichTextDrawingContext&, ::wxRichTextBuffer*, const ::wxRichTextAttr&, const ::wxRichTextAttr&, const ::wxRect&, const ::wxRect&, int);

    return sipVH__richtext_31(sipGILState, 0, sipPySelf, sipMeth, dc, context, buffer, parentAttr, attr, availableParentSpace, availableContainerSpace, style);
}

::wxRect sipwxRichTextTable::GetAvailableContentArea(::wxDC& dc, ::wxRichTextDrawingContext& context, const ::wxRect& outerRect) const
{
    sip_gilstate_t sipGILState;
    PyObject *sipMeth;

    sipMeth = sipIsPyMethod(&sipGILState, const_cast<char *>(&sipPyMethods[70]), const_cast<sipSimpleWrapper **>(&sipPySelf), SIP_NULLPTR, sipName_GetAvailableContentArea);

    if (!sipMeth)
        return ::wxRichTextTable::GetAvailableContentArea(dc, context, outerRect);

    extern ::wxRect sipVH__richtext_30(sip_gilstate_t, sipVirtErrorHandlerFunc, sipSimpleWrapper *, PyObject *, ::wxDC&, ::wxRichTextDrawingContext&, const ::wxRect&);

    return sipVH__richtext_30(sipGILState, 0, sipPySelf, sipMeth, dc, context, outerRect);
}

int sipwxRichTextTable::GetBottomMargin() const
{
    sip_gilstate_t sipGILState;
    PyObject *sipMeth;

    sipMeth = sipIsPyMethod(&sipGILState, const_cast<char *>(&sipPyMethods[71]), const_cast<sipSimpleWrapper **>(&sipPySelf), SIP_NULLPTR, sipName_GetBottomMargin);

    if (!sipMeth)
        return ::wxRichTextTable::GetBottomMargin();

    extern int sipVH__richtext_10(sip_gilstate_t, sipVirtErrorHandlerFunc, sipSimpleWrapper *, PyObject *);

    return sipVH__richtext_10(sipGILState, 0, sipPySelf, sipMeth);
}

int sipwxRichTextTable::GetTopMargin() const
{
    sip_gilstate_t sipGILState;
    PyObject *sipMeth;

    sipMeth = sipIsPyMethod(&sipGILState, const_cast<char *>(&sipPyMethods[72]), const_cast<sipSimpleWrapper **>(&sipPySelf), SIP_NULLPTR, sipName_GetTopMargin);

    if (!sipMeth)
        return ::wxRichTextTable::GetTopMargin();

    extern int sipVH__richtext_10(sip_gilstate_t, sipVirtErrorHandlerFunc, sipSimpleWrapper *, PyObject *);

    return sipVH__richtext_10(sipGILState, 0, sipPySelf, sipMeth);
}

int sipwxRichTextTable::GetRightMargin() const
{
    sip_gilstate_t sipGILState;
    PyObject *sipMeth;

    sipMeth = sipIsPyMethod(&sipGILState, const_cast<char *>(&sipPyMethods[73]), const_cast<sipSimpleWrapper **>(&sipPySelf), SIP_NULLPTR, sipName_GetRightMargin);

    if (!sipMeth)
        return ::wxRichTextTable::GetRightMargin();

    extern int sipVH__richtext_10(sip_gilstate_t, sipVirtErrorHandlerFunc, sipSimpleWrapper *, PyObject *);

    return sipVH__richtext_10(sipGILState, 0, sipPySelf, sipMeth);
}

int sipwxRichTextTable::GetLeftMargin() const
{
    sip_gilstate_t sipGILState;
    PyObject *sipMeth;

    sipMeth = sipIsPyMethod(&sipGILState, const_cast<char *>(&sipPyMethods[74]), const_cast<sipSimpleWrapper **>(&sipPySelf), SIP_NULLPTR, sipName_GetLeftMargin);

    if (!sipMeth)
        return ::wxRichTextTable::GetLeftMargin();

    extern int sipVH__richtext_10(sip_gilstate_t, sipVirtErrorHandlerFunc, sipSimpleWrapper *, PyObject *);

    return sipVH__richtext_10(sipGILState, 0, sipPySelf, sipMeth);
}

void sipwxRichTextTable::SetMargins(int leftMargin, int rightMargin, int topMargin, int bottomMargin)
{
    sip_gilstate_t sipGILState;
    PyObject *sipMeth;

    sipMeth = sipIsPyMethod(&sipGILState, &sipPyMethods[75], &sipPySelf, SIP_NULLPTR, sipName_SetMargins);

    if (!sipMeth)
    {
        ::wxRichTextTable::SetMargins(leftMargin, rightMargin, topMargin, bottomMargin);
        return;
    }

    extern void sipVH__richtext_29(sip_gilstate_t, sipVirtErrorHandlerFunc, sipSimpleWrapper *, PyObject *, int, int, int, int);

    sipVH__richtext_29(sipGILState, 0, sipPySelf, sipMeth, leftMargin, rightMargin, topMargin, bottomMargin);
}

void sipwxRichTextTable::SetMargins(int margin)
{
    sip_gilstate_t sipGILState;
    PyObject *sipMeth;

    sipMeth = sipIsPyMethod(&sipGILState, &sipPyMethods[76], &sipPySelf, SIP_NULLPTR, sipName_SetMargins);

    if (!sipMeth)
    {
        ::wxRichTextTable::SetMargins(margin);
        return;
    }

    extern void sipVH__richtext_28(sip_gilstate_t, sipVirtErrorHandlerFunc, sipSimpleWrapper *, PyObject *, int);

    sipVH__richtext_28(sipGILState, 0, sipPySelf, sipMeth, margin);
}

::wxRichTextParagraphLayoutBox* sipwxRichTextTable::GetParentContainer() const
{
    sip_gilstate_t sipGILState;
    PyObject *sipMeth;

    sipMeth = sipIsPyMethod(&sipGILState, const_cast<char *>(&sipPyMethods[77]), const_cast<sipSimpleWrapper **>(&sipPySelf), SIP_NULLPTR, sipName_GetParentContainer);

    if (!sipMeth)
        return ::wxRichTextTable::GetParentContainer();

    extern ::wxRichTextParagraphLayoutBox* sipVH__richtext_27(sip_gilstate_t, sipVirtErrorHandlerFunc, sipSimpleWrapper *, PyObject *);

    return sipVH__richtext_27(sipGILState, 0, sipPySelf, sipMeth);
}

::wxRichTextParagraphLayoutBox* sipwxRichTextTable::GetContainer() const
{
    sip_gilstate_t sipGILState;
    PyObject *sipMeth;

    sipMeth = sipIsPyMethod(&sipGILState, const_cast<char *>(&sipPyMethods[78]), const_cast<sipSimpleWrapper **>(&sipPySelf), SIP_NULLPTR, sipName_GetContainer);

    if (!sipMeth)
        return ::wxRichTextTable::GetContainer();

    extern ::wxRichTextParagraphLayoutBox* sipVH__richtext_27(sip_gilstate_t, sipVirtErrorHandlerFunc, sipSimpleWrapper *, PyObject *);

    return sipVH__richtext_27(sipGILState, 0, sipPySelf, sipMeth);
}

void sipwxRichTextTable::SetParent(::wxRichTextObject*parent)
{
    sip_gilstate_t sipGILState;
    PyObject *sipMeth;

    sipMeth = sipIsPyMethod(&sipGILState, &sipPyMethods[79], &sipPySelf, SIP_NULLPTR, sipName_SetParent);

    if (!sipMeth)
    {
        ::wxRichTextTable::SetParent(parent);
        return;
    }

    extern void sipVH__richtext_26(sip_gilstate_t, sipVirtErrorHandlerFunc, sipSimpleWrapper *, PyObject *, ::wxRichTextObject*);

    sipVH__richtext_26(sipGILState, 0, sipPySelf, sipMeth, parent);
}

::wxRichTextObject* sipwxRichTextTable::GetParent() const
{
    sip_gilstate_t sipGILState;
    PyObject *sipMeth;

    sipMeth = sipIsPyMethod(&sipGILState, const_cast<char *>(&sipPyMethods[80]), const_cast<sipSimpleWrapper **>(&sipPySelf), SIP_NULLPTR, sipName_GetParent);

    if (!sipMeth)
        return ::wxRichTextTable::GetParent();

    extern ::wxRichTextObject* sipVH__richtext_34(sip_gilstate_t, sipVirtErrorHandlerFunc, sipSimpleWrapper *, PyObject *);

    return sipVH__richtext_34(sipGILState, 0, sipPySelf, sipMeth);
}

bool sipwxRichTextTable::IsAtomic() const
{
    sip_gilstate_t sipGILState;
    PyObject *sipMeth;

    sipMeth = sipIsPyMethod(&sipGILState, const_cast<char *>(&sipPyMethods[81]), const_cast<sipSimpleWrapper **>(&sipPySelf), SIP_NULLPTR, sipName_IsAtomic);

    if (!sipMeth)
        return ::wxRichTextTable::IsAtomic();

    extern bool sipVH__richtext_9(sip_gilstate_t, sipVirtErrorHandlerFunc, sipSimpleWrapper *, PyObject *);

    return sipVH__richtext_9(sipGILState, 0, sipPySelf, sipMeth);
}

bool sipwxRichTextTable::IsComposite() const
{
    sip_gilstate_t sipGILState;
    PyObject *sipMeth;

    sipMeth = sipIsPyMethod(&sipGILState, const_cast<char *>(&sipPyMethods[82]), const_cast<sipSimpleWrapper **>(&sipPySelf), SIP_NULLPTR, sipName_IsComposite);

    if (!sipMeth)
        return ::wxRichTextTable::IsComposite();

    extern bool sipVH__richtext_9(sip_gilstate_t, sipVirtErrorHandlerFunc, sipSimpleWrapper *, PyObject *);

    return sipVH__richtext_9(sipGILState, 0, sipPySelf, sipMeth);
}

::wxRect sipwxRichTextTable::GetRect() const
{
    sip_gilstate_t sipGILState;
    PyObject *sipMeth;

    sipMeth = sipIsPyMethod(&sipGILState, const_cast<char *>(&sipPyMethods[83]), const_cast<sipSimpleWrapper **>(&sipPySelf), SIP_NULLPTR, sipName_GetRect);

    if (!sipMeth)
        return ::wxRichTextTable::GetRect();

    extern ::wxRect sipVH__richtext_24(sip_gilstate_t, sipVirtErrorHandlerFunc, sipSimpleWrapper *, PyObject *);

    return sipVH__richtext_24(sipGILState, 0, sipPySelf, sipMeth);
}

::wxPoint sipwxRichTextTable::GetAbsolutePosition() const
{
    sip_gilstate_t sipGILState;
    PyObject *sipMeth;

    sipMeth = sipIsPyMethod(&sipGILState, const_cast<char *>(&sipPyMethods[84]), const_cast<sipSimpleWrapper **>(&sipPySelf), SIP_NULLPTR, sipName_GetAbsolutePosition);

    if (!sipMeth)
        return ::wxRichTextTable::GetAbsolutePosition();

    extern ::wxPoint sipVH__richtext_22(sip_gilstate_t, sipVirtErrorHandlerFunc, sipSimpleWrapper *, PyObject *);

    return sipVH__richtext_22(sipGILState, 0, sipPySelf, sipMeth);
}

void sipwxRichTextTable::SetPosition(const ::wxPoint& pos)
{
    sip_gilstate_t sipGILState;
    PyObject *sipMeth;

    sipMeth = sipIsPyMethod(&sipGILState, &sipPyMethods[85], &sipPySelf, SIP_NULLPTR, sipName_SetPosition);

    if (!sipMeth)
    {
        ::wxRichTextTable::SetPosition(pos);
        return;
    }

    extern void sipVH__richtext_23(sip_gilstate_t, sipVirtErrorHandlerFunc, sipSimpleWrapper *, PyObject *, const ::wxPoint&);

    sipVH__richtext_23(sipGILState, 0, sipPySelf, sipMeth, pos);
}

::wxPoint sipwxRichTextTable::GetPosition() const
{
    sip_gilstate_t sipGILState;
    PyObject *sipMeth;

    sipMeth = sipIsPyMethod(&sipGILState, const_cast<char *>(&sipPyMethods[86]), const_cast<sipSimpleWrapper **>(&sipPySelf), SIP_NULLPTR, sipName_GetPosition);

    if (!sipMeth)
        return ::wxRichTextTable::GetPosition();

    extern ::wxPoint sipVH__richtext_22(sip_gilstate_t, sipVirtErrorHandlerFunc, sipSimpleWrapper *, PyObject *);

    return sipVH__richtext_22(sipGILState, 0, sipPySelf, sipMeth);
}

::wxTextAttrSize sipwxRichTextTable::GetNaturalSize() const
{
    sip_gilstate_t sipGILState;
    PyObject *sipMeth;

    sipMeth = sipIsPyMethod(&sipGILState, const_cast<char *>(&sipPyMethods[87]), const_cast<sipSimpleWrapper **>(&sipPySelf), SIP_NULLPTR, sipName_GetNaturalSize);

    if (!sipMeth)
        return ::wxRichTextTable::GetNaturalSize();

    extern ::wxTextAttrSize sipVH__richtext_21(sip_gilstate_t, sipVirtErrorHandlerFunc, sipSimpleWrapper *, PyObject *);

    return sipVH__richtext_21(sipGILState, 0, sipPySelf, sipMeth);
}

void sipwxRichTextTable::SetMinSize(const ::wxSize& sz)
{
    sip_gilstate_t sipGILState;
    PyObject *sipMeth;

    sipMeth = sipIsPyMethod(&sipGILState, &sipPyMethods[88], &sipPySelf, SIP_NULLPTR, sipName_SetMinSize);

    if (!sipMeth)
    {
        ::wxRichTextTable::SetMinSize(sz);
        return;
    }

    extern void sipVH__richtext_20(sip_gilstate_t, sipVirtErrorHandlerFunc, sipSimpleWrapper *, PyObject *, const ::wxSize&);

    sipVH__richtext_20(sipGILState, 0, sipPySelf, sipMeth, sz);
}

::wxSize sipwxRichTextTable::GetMinSize() const
{
    sip_gilstate_t sipGILState;
    PyObject *sipMeth;

    sipMeth = sipIsPyMethod(&sipGILState, const_cast<char *>(&sipPyMethods[89]), const_cast<sipSimpleWrapper **>(&sipPySelf), SIP_NULLPTR, sipName_GetMinSize);

    if (!sipMeth)
        return ::wxRichTextTable::GetMinSize();

    extern ::wxSize sipVH__richtext_4(sip_gilstate_t, sipVirtErrorHandlerFunc, sipSimpleWrapper *, PyObject *);

    return sipVH__richtext_4(sipGILState, 0, sipPySelf, sipMeth);
}

void sipwxRichTextTable::SetMaxSize(const ::wxSize& sz)
{
    sip_gilstate_t sipGILState;
    PyObject *sipMeth;

    sipMeth = sipIsPyMethod(&sipGILState, &sipPyMethods[90], &sipPySelf, SIP_NULLPTR, sipName_SetMaxSize);

    if (!sipMeth)
    {
        ::wxRichTextTable::SetMaxSize(sz);
        return;
    }

    extern void sipVH__richtext_20(sip_gilstate_t, sipVirtErrorHandlerFunc, sipSimpleWrapper *, PyObject *, const ::wxSize&);

    sipVH__richtext_20(sipGILState, 0, sipPySelf, sipMeth, sz);
}

::wxSize sipwxRichTextTable::GetMaxSize() const
{
    sip_gilstate_t sipGILState;
    PyObject *sipMeth;

    sipMeth = sipIsPyMethod(&sipGILState, const_cast<char *>(&sipPyMethods[91]), const_cast<sipSimpleWrapper **>(&sipPySelf), SIP_NULLPTR, sipName_GetMaxSize);

    if (!sipMeth)
        return ::wxRichTextTable::GetMaxSize();

    extern ::wxSize sipVH__richtext_4(sip_gilstate_t, sipVirtErrorHandlerFunc, sipSimpleWrapper *, PyObject *);

    return sipVH__richtext_4(sipGILState, 0, sipPySelf, sipMeth);
}

void sipwxRichTextTable::SetCachedSize(const ::wxSize& sz)
{
    sip_gilstate_t sipGILState;
    PyObject *sipMeth;

    sipMeth = sipIsPyMethod(&sipGILState, &sipPyMethods[92], &sipPySelf, SIP_NULLPTR, sipName_SetCachedSize);

    if (!sipMeth)
    {
        ::wxRichTextTable::SetCachedSize(sz);
        return;
    }

    extern void sipVH__richtext_20(sip_gilstate_t, sipVirtErrorHandlerFunc, sipSimpleWrapper *, PyObject *, const ::wxSize&);

    sipVH__richtext_20(sipGILState, 0, sipPySelf, sipMeth, sz);
}

::wxSize sipwxRichTextTable::GetCachedSize() const
{
    sip_gilstate_t sipGILState;
    PyObject *sipMeth;

    sipMeth = sipIsPyMethod(&sipGILState, const_cast<char *>(&sipPyMethods[93]), const_cast<sipSimpleWrapper **>(&sipPySelf), SIP_NULLPTR, sipName_GetCachedSize);

    if (!sipMeth)
        return ::wxRichTextTable::GetCachedSize();

    extern ::wxSize sipVH__richtext_4(sip_gilstate_t, sipVirtErrorHandlerFunc, sipSimpleWrapper *, PyObject *);

    return sipVH__richtext_4(sipGILState, 0, sipPySelf, sipMeth);
}

::wxRichTextSelection sipwxRichTextTable::GetSelection(long start, long end) const
{
    sip_gilstate_t sipGILState;
    PyObject *sipMeth;

    sipMeth = sipIsPyMethod(&sipGILState, const_cast<char *>(&sipPyMethods[94]), const_cast<sipSimpleWrapper **>(&sipPySelf), SIP_NULLPTR, sipName_GetSelection);

    if (!sipMeth)
        return ::wxRichTextTable::GetSelection(start, end);

    extern ::wxRichTextSelection sipVH__richtext_19(sip_gilstate_t, sipVirtErrorHandlerFunc, sipSimpleWrapper *, PyObject *, long, long);

    return sipVH__richtext_19(sipGILState, 0, sipPySelf, sipMeth, start, end);
}

bool sipwxRichTextTable::HandlesChildSelections() const
{
    sip_gilstate_t sipGILState;
    PyObject *sipMeth;

    sipMeth = sipIsPyMethod(&sipGILState, const_cast<char *>(&sipPyMethods[95]), const_cast<sipSimpleWrapper **>(&sipPySelf), SIP_NULLPTR, sipName_HandlesChildSelections);

    if (!sipMeth)
        return ::wxRichTextTable::HandlesChildSelections();

    extern bool sipVH__richtext_9(sip_gilstate_t, sipVirtErrorHandlerFunc, sipSimpleWrapper *, PyObject *);

    return sipVH__richtext_9(sipGILState, 0, sipPySelf, sipMeth);
}

void sipwxRichTextTable::Invalidate(const ::wxRichTextRange& invalidRange)
{
    sip_gilstate_t sipGILState;
    PyObject *sipMeth;

    sipMeth = sipIsPyMethod(&sipGILState, &sipPyMethods[96], &sipPySelf, SIP_NULLPTR, sipName_Invalidate);

    if (!sipMeth)
    {
        ::wxRichTextTable::Invalidate(invalidRange);
        return;
    }

    extern void sipVH__richtext_18(sip_gilstate_t, sipVirtErrorHandlerFunc, sipSimpleWrapper *, PyObject *, const ::wxRichTextRange&);

    sipVH__richtext_18(sipGILState, 0, sipPySelf, sipMeth, invalidRange);
}

::wxString sipwxRichTextTable::GetXMLNodeName() const
{
    sip_gilstate_t sipGILState;
    PyObject *sipMeth;

    sipMeth = sipIsPyMethod(&sipGILState, const_cast<char *>(&sipPyMethods[97]), const_cast<sipSimpleWrapper **>(&sipPySelf), SIP_NULLPTR, sipName_GetXMLNodeName);

    if (!sipMeth)
        return ::wxRichTextTable::GetXMLNodeName();

    extern ::wxString sipVH__richtext_16(sip_gilstate_t, sipVirtErrorHandlerFunc, sipSimpleWrapper *, PyObject *);

    return sipVH__richtext_16(sipGILState, 0, sipPySelf, sipMeth);
}

bool sipwxRichTextTable::UsesParagraphAttributes() const
{
    sip_gilstate_t sipGILState;
    PyObject *sipMeth;

    sipMeth = sipIsPyMethod(&sipGILState, const_cast<char *>(&sipPyMethods[98]), const_cast<sipSimpleWrapper **>(&sipPySelf), SIP_NULLPTR, sipName_UsesParagraphAttributes);

    if (!sipMeth)
        return ::wxRichTextTable::UsesParagraphAttributes();

    extern bool sipVH__richtext_9(sip_gilstate_t, sipVirtErrorHandlerFunc, sipSimpleWrapper *, PyObject *);

    return sipVH__richtext_9(sipGILState, 0, sipPySelf, sipMeth);
}

bool sipwxRichTextTable::ImportFromXML(::wxRichTextBuffer*buffer, ::wxXmlNode*node, ::wxRichTextXMLHandler*handler, bool*recurse)
{
    sip_gilstate_t sipGILState;
    PyObject *sipMeth;

    sipMeth = sipIsPyMethod(&sipGILState, &sipPyMethods[99], &sipPySelf, SIP_NULLPTR, sipName_ImportFromXML);

    if (!sipMeth)
        return ::wxRichTextTable::ImportFromXML(buffer, node, handler, recurse);

    extern bool sipVH__richtext_17(sip_gilstate_t, sipVirtErrorHandlerFunc, sipSimpleWrapper *, PyObject *, ::wxRichTextBuffer*, ::wxXmlNode*, ::wxRichTextXMLHandler*, bool*);

    return sipVH__richtext_17(sipGILState, 0, sipPySelf, sipMeth, buffer, node, handler, recurse);
}

bool sipwxRichTextTable::AcceptsFocus() const
{
    sip_gilstate_t sipGILState;
    PyObject *sipMeth;

    sipMeth = sipIsPyMethod(&sipGILState, const_cast<char *>(&sipPyMethods[100]), const_cast<sipSimpleWrapper **>(&sipPySelf), SIP_NULLPTR, sipName_AcceptsFocus);

    if (!sipMeth)
        return ::wxRichTextTable::AcceptsFocus();

    extern bool sipVH__richtext_9(sip_gilstate_t, sipVirtErrorHandlerFunc, sipSimpleWrapper *, PyObject *);

    return sipVH__richtext_9(sipGILState, 0, sipPySelf, sipMeth);
}

::wxString sipwxRichTextTable::GetPropertiesMenuLabel() const
{
    sip_gilstate_t sipGILState;
    PyObject *sipMeth;

    sipMeth = sipIsPyMethod(&sipGILState, const_cast<char *>(&sipPyMethods[101]), const_cast<sipSimpleWrapper **>(&sipPySelf), SIP_NULLPTR, sipName_GetPropertiesMenuLabel);

    if (!sipMeth)
        return ::wxRichTextTable::GetPropertiesMenuLabel();

    extern ::wxString sipVH__richtext_16(sip_gilstate_t, sipVirtErrorHandlerFunc, sipSimpleWrapper *, PyObject *);

    return sipVH__richtext_16(sipGILState, 0, sipPySelf, sipMeth);
}

bool sipwxRichTextTable::EditProperties(::wxWindow*parent, ::wxRichTextBuffer*buffer)
{
    sip_gilstate_t sipGILState;
    PyObject *sipMeth;

    sipMeth = sipIsPyMethod(&sipGILState, &sipPyMethods[102], &sipPySelf, SIP_NULLPTR, sipName_EditProperties);

    if (!sipMeth)
        return ::wxRichTextTable::EditProperties(parent, buffer);

    extern bool sipVH__richtext_15(sip_gilstate_t, sipVirtErrorHandlerFunc, sipSimpleWrapper *, PyObject *, ::wxWindow*, ::wxRichTextBuffer*);

    return sipVH__richtext_15(sipGILState, 0, sipPySelf, sipMeth, parent, buffer);
}

bool sipwxRichTextTable::CanEditProperties() const
{
    sip_gilstate_t sipGILState;
    PyObject *sipMeth;

    sipMeth = sipIsPyMethod(&sipGILState, const_cast<char *>(&sipPyMethods[103]), const_cast<sipSimpleWrapper **>(&sipPySelf), SIP_NULLPTR, sipName_CanEditProperties);

    if (!sipMeth)
        return ::wxRichTextTable::CanEditProperties();

    extern bool sipVH__richtext_9(sip_gilstate_t, sipVirtErrorHandlerFunc, sipSimpleWrapper *, PyObject *);

    return sipVH__richtext_9(sipGILState, 0, sipPySelf, sipMeth);
}

::wxRichTextObject* sipwxRichTextTable::Split(::wxRichTextDrawingContext& context)
{
    sip_gilstate_t sipGILState;
    PyObject *sipMeth;

    sipMeth = sipIsPyMethod(&sipGILState, &sipPyMethods[104], &sipPySelf, SIP_NULLPTR, sipName_Split);

    if (!sipMeth)
        return ::wxRichTextTable::Split(context);

    extern ::wxRichTextObject* sipVH__richtext_14(sip_gilstate_t, sipVirtErrorHandlerFunc, sipSimpleWrapper *, PyObject *, ::wxRichTextDrawingContext&);

    return sipVH__richtext_14(sipGILState, 0, sipPySelf, sipMeth, context);
}

bool sipwxRichTextTable::CanSplit(::wxRichTextDrawingContext& context) const
{
    sip_gilstate_t sipGILState;
    PyObject *sipMeth;

    sipMeth = sipIsPyMethod(&sipGILState, const_cast<char *>(&sipPyMethods[105]), const_cast<sipSimpleWrapper **>(&sipPySelf), SIP_NULLPTR, sipName_CanSplit);

    if (!sipMeth)
        return ::wxRichTextTable::CanSplit(context);

    extern bool sipVH__richtext_13(sip_gilstate_t, sipVirtErrorHandlerFunc, sipSimpleWrapper *, PyObject *, ::wxRichTextDrawingContext&);

    return sipVH__richtext_13(sipGILState, 0, sipPySelf, sipMeth, context);
}

bool sipwxRichTextTable::Merge(::wxRichTextObject*object, ::wxRichTextDrawingContext& context)
{
    sip_gilstate_t sipGILState;
    PyObject *sipMeth;

    sipMeth = sipIsPyMethod(&sipGILState, &sipPyMethods[106], &sipPySelf, SIP_NULLPTR, sipName_Merge);

    if (!sipMeth)
        return ::wxRichTextTable::Merge(object, context);

    extern bool sipVH__richtext_12(sip_gilstate_t, sipVirtErrorHandlerFunc, sipSimpleWrapper *, PyObject *, ::wxRichTextObject*, ::wxRichTextDrawingContext&);

    return sipVH__richtext_12(sipGILState, 0, sipPySelf, sipMeth, object, context);
}

bool sipwxRichTextTable::CanMerge(::wxRichTextObject*object, ::wxRichTextDrawingContext& context) const
{
    sip_gilstate_t sipGILState;
    PyObject *sipMeth;

    sipMeth = sipIsPyMethod(&sipGILState, const_cast<char *>(&sipPyMethods[107]), const_cast<sipSimpleWrapper **>(&sipPySelf), SIP_NULLPTR, sipName_CanMerge);

    if (!sipMeth)
        return ::wxRichTextTable::CanMerge(object, context);

    extern bool sipVH__richtext_12(sip_gilstate_t, sipVirtErrorHandlerFunc, sipSimpleWrapper *, PyObject *, ::wxRichTextObject*, ::wxRichTextDrawingContext&);

    return sipVH__richtext_12(sipGILState, 0, sipPySelf, sipMeth, object, context);
}

::wxString sipwxRichTextTable::GetTextForRange(const ::wxRichTextRange& range) const
{
    sip_gilstate_t sipGILState;
    PyObject *sipMeth;

    sipMeth = sipIsPyMethod(&sipGILState, const_cast<char *>(&sipPyMethods[108]), const_cast<sipSimpleWrapper **>(&sipPySelf), SIP_NULLPTR, sipName_GetTextForRange);

    if (!sipMeth)
        return ::wxRichTextTable::GetTextForRange(range);

    extern ::wxString sipVH__richtext_11(sip_gilstate_t, sipVirtErrorHandlerFunc, sipSimpleWrapper *, PyObject *, const ::wxRichTextRange&);

    return sipVH__richtext_11(sipGILState, 0, sipPySelf, sipMeth, range);
}

int sipwxRichTextTable::GetFloatDirection() const
{
    sip_gilstate_t sipGILState;
    PyObject *sipMeth;

    sipMeth = sipIsPyMethod(&sipGILState, const_cast<char *>(&sipPyMethods[109]), const_cast<sipSimpleWrapper **>(&sipPySelf), SIP_NULLPTR, sipName_GetFloatDirection);

    if (!sipMeth)
        return ::wxRichTextTable::GetFloatDirection();

    extern int sipVH__richtext_10(sip_gilstate_t, sipVirtErrorHandlerFunc, sipSimpleWrapper *, PyObject *);

    return sipVH__richtext_10(sipGILState, 0, sipPySelf, sipMeth);
}

bool sipwxRichTextTable::IsFloating() const
{
    sip_gilstate_t sipGILState;
    PyObject *sipMeth;

    sipMeth = sipIsPyMethod(&sipGILState, const_cast<char *>(&sipPyMethods[110]), const_cast<sipSimpleWrapper **>(&sipPySelf), SIP_NULLPTR, sipName_IsFloating);

    if (!sipMeth)
        return ::wxRichTextTable::IsFloating();

    extern bool sipVH__richtext_9(sip_gilstate_t, sipVirtErrorHandlerFunc, sipSimpleWrapper *, PyObject *);

    return sipVH__richtext_9(sipGILState, 0, sipPySelf, sipMeth);
}

bool sipwxRichTextTable::IsFloatable() const
{
    sip_gilstate_t sipGILState;
    PyObject *sipMeth;

    sipMeth = sipIsPyMethod(&sipGILState, const_cast<char *>(&sipPyMethods[111]), const_cast<sipSimpleWrapper **>(&sipPySelf), SIP_NULLPTR, sipName_IsFloatable);

    if (!sipMeth)
        return ::wxRichTextTable::IsFloatable();

    extern bool sipVH__richtext_9(sip_gilstate_t, sipVirtErrorHandlerFunc, sipSimpleWrapper *, PyObject *);

    return sipVH__richtext_9(sipGILState, 0, sipPySelf, sipMeth);
}

bool sipwxRichTextTable::IsEmpty() const
{
    sip_gilstate_t sipGILState;
    PyObject *sipMeth;

    sipMeth = sipIsPyMethod(&sipGILState, const_cast<char *>(&sipPyMethods[112]), const_cast<sipSimpleWrapper **>(&sipPySelf), SIP_NULLPTR, sipName_IsEmpty);

    if (!sipMeth)
        return ::wxRichTextTable::IsEmpty();

    extern bool sipVH__richtext_9(sip_gilstate_t, sipVirtErrorHandlerFunc, sipSimpleWrapper *, PyObject *);

    return sipVH__richtext_9(sipGILState, 0, sipPySelf, sipMeth);
}

bool sipwxRichTextTable::DeleteRange(const ::wxRichTextRange& range)
{
    sip_gilstate_t sipGILState;
    PyObject *sipMeth;

    sipMeth = sipIsPyMethod(&sipGILState, &sipPyMethods[113], &sipPySelf, SIP_NULLPTR, sipName_DeleteRange);

    if (!sipMeth)
        return ::wxRichTextTable::DeleteRange(range);

    extern bool sipVH__richtext_8(sip_gilstate_t, sipVirtErrorHandlerFunc, sipSimpleWrapper *, PyObject *, const ::wxRichTextRange&);

    return sipVH__richtext_8(sipGILState, 0, sipPySelf, sipMeth, range);
}

void sipwxRichTextTable::CalculateRange(long start, long& end)
{
    sip_gilstate_t sipGILState;
    PyObject *sipMeth;

    sipMeth = sipIsPyMethod(&sipGILState, &sipPyMethods[114], &sipPySelf, SIP_NULLPTR, sipName_CalculateRange);

    if (!sipMeth)
    {
        ::wxRichTextTable::CalculateRange(start, end);
        return;
    }

    extern void sipVH__richtext_7(sip_gilstate_t, sipVirtErrorHandlerFunc, sipSimpleWrapper *, PyObject *, long, long&);

    sipVH__richtext_7(sipGILState, 0, sipPySelf, sipMeth, start, end);
}

::wxRichTextObject* sipwxRichTextTable::DoSplit(long pos)
{
    sip_gilstate_t sipGILState;
    PyObject *sipMeth;

    sipMeth = sipIsPyMethod(&sipGILState, &sipPyMethods[115], &sipPySelf, SIP_NULLPTR, sipName_DoSplit);

    if (!sipMeth)
        return ::wxRichTextTable::DoSplit(pos);

    extern ::wxRichTextObject* sipVH__richtext_6(sip_gilstate_t, sipVirtErrorHandlerFunc, sipSimpleWrapper *, PyObject *, long);

    return sipVH__richtext_6(sipGILState, 0, sipPySelf, sipMeth, pos);
}

bool sipwxRichTextTable::GetRangeSize(const ::wxRichTextRange& range, ::wxSize& size, int& descent, ::wxDC& dc, ::wxRichTextDrawingContext& context, int flags, const ::wxPoint& position, const ::wxSize& parentSize, ::wxArrayInt*partialExtents) const
{
    sip_gilstate_t sipGILState;
    PyObject *sipMeth;

    sipMeth = sipIsPyMethod(&sipGILState, const_cast<char *>(&sipPyMethods[116]), const_cast<sipSimpleWrapper **>(&sipPySelf), SIP_NULLPTR, sipName_GetRangeSize);

    if (!sipMeth)
        return ::wxRichTextTable::GetRangeSize(range, size, descent, dc, context, flags, position, parentSize, partialExtents);

    extern bool sipVH__richtext_5(sip_gilstate_t, sipVirtErrorHandlerFunc, sipSimpleWrapper *, PyObject *, const ::wxRichTextRange&, ::wxSize&, int&, ::wxDC&, ::wxRichTextDrawingContext&, int, const ::wxPoint&, const ::wxSize&, ::wxArrayInt*);

    return sipVH__richtext_5(sipGILState, 0, sipPySelf, sipMeth, range, size, descent, dc, context, flags, position, parentSize, partialExtents);
}

::wxSize sipwxRichTextTable::GetBestSize() const
{
    sip_gilstate_t sipGILState;
    PyObject *sipMeth;

    sipMeth = sipIsPyMethod(&sipGILState, const_cast<char *>(&sipPyMethods[117]), const_cast<sipSimpleWrapper **>(&sipPySelf), SIP_NULLPTR, sipName_GetBestSize);

    if (!sipMeth)
        return ::wxRichTextTable::GetBestSize();

    extern ::wxSize sipVH__richtext_4(sip_gilstate_t, sipVirtErrorHandlerFunc, sipSimpleWrapper *, PyObject *);

    return sipVH__richtext_4(sipGILState, 0, sipPySelf, sipMeth);
}

bool sipwxRichTextTable::FindPosition(::wxDC& dc, ::wxRichTextDrawingContext& context, long index, ::wxPoint& pt, int*height, bool forceLineStart)
{
    sip_gilstate_t sipGILState;
    PyObject *sipMeth;

    sipMeth = sipIsPyMethod(&sipGILState, &sipPyMethods[118], &sipPySelf, SIP_NULLPTR, sipName_FindPosition);

    if (!sipMeth)
        return ::wxRichTextTable::FindPosition(dc, context, index, pt, height, forceLineStart);

    extern bool sipVH__richtext_3(sip_gilstate_t, sipVirtErrorHandlerFunc, sipSimpleWrapper *, PyObject *, ::wxDC&, ::wxRichTextDrawingContext&, long, ::wxPoint&, int*, bool);

    return sipVH__richtext_3(sipGILState, 0, sipPySelf, sipMeth, dc, context, index, pt, height, forceLineStart);
}

int sipwxRichTextTable::HitTest(::wxDC& dc, ::wxRichTextDrawingContext& context, const ::wxPoint& pt, long& textPosition, ::wxRichTextObject**obj, ::wxRichTextObject**contextObj, int flags)
{
    sip_gilstate_t sipGILState;
    PyObject *sipMeth;

    sipMeth = sipIsPyMethod(&sipGILState, &sipPyMethods[119], &sipPySelf, SIP_NULLPTR, sipName_HitTest);

    if (!sipMeth)
        return ::wxRichTextTable::HitTest(dc, context, pt, textPosition, obj, contextObj, flags);

    extern int sipVH__richtext_2(sip_gilstate_t, sipVirtErrorHandlerFunc, sipSimpleWrapper *, PyObject *, ::wxDC&, ::wxRichTextDrawingContext&, const ::wxPoint&, long&, ::wxRichTextObject**, ::wxRichTextObject**, int);

    return sipVH__richtext_2(sipGILState, 0, sipPySelf, sipMeth, dc, context, pt, textPosition, obj, contextObj, flags);
}

bool sipwxRichTextTable::Layout(::wxDC& dc, ::wxRichTextDrawingContext& context, const ::wxRect& rect, const ::wxRect& parentRect, int style)
{
    sip_gilstate_t sipGILState;
    PyObject *sipMeth;

    sipMeth = sipIsPyMethod(&sipGILState, &sipPyMethods[120], &sipPySelf, SIP_NULLPTR, sipName_Layout);

    if (!sipMeth)
        return ::wxRichTextTable::Layout(dc, context, rect, parentRect, style);

    extern bool sipVH__richtext_1(sip_gilstate_t, sipVirtErrorHandlerFunc, sipSimpleWrapper *, PyObject *, ::wxDC&, ::wxRichTextDrawingContext&, const ::wxRect&, const ::wxRect&, int);

    return sipVH__richtext_1(sipGILState, 0, sipPySelf, sipMeth, dc, context, rect, parentRect, style);
}

bool sipwxRichTextTable::Draw(::wxDC& dc, ::wxRichTextDrawingContext& context, const ::wxRichTextRange& range, const ::wxRichTextSelection& selection, const ::wxRect& rect, int descent, int style)
{
    sip_gilstate_t sipGILState;
    PyObject *sipMeth;

    sipMeth = sipIsPyMethod(&sipGILState, &sipPyMethods[121], &sipPySelf, SIP_NULLPTR, sipName_Draw);

    if (!sipMeth)
        return ::wxRichTextTable::Draw(dc, context, range, selection, rect, descent, style);

    extern bool sipVH__richtext_0(sip_gilstate_t, sipVirtErrorHandlerFunc, sipSimpleWrapper *, PyObject *, ::wxDC&, ::wxRichTextDrawingContext&, const ::wxRichTextRange&, const ::wxRichTextSelection&, const ::wxRect&, int, int);

    return sipVH__richtext_0(sipGILState, 0, sipPySelf, sipMeth, dc, context, range, selection, rect, descent, style);
}

::wxRichTextObject* sipwxRichTextTable::GetChildAtPosition(long pos) const
{
    sip_gilstate_t sipGILState;
    PyObject *sipMeth;

    sipMeth = sipIsPyMethod(&sipGILState, const_cast<char *>(&sipPyMethods[122]), const_cast<sipSimpleWrapper **>(&sipPySelf), SIP_NULLPTR, sipName_GetChildAtPosition);

    if (!sipMeth)
        return ::wxRichTextTable::GetChildAtPosition(pos);

    extern ::wxRichTextObject* sipVH__richtext_6(sip_gilstate_t, sipVirtErrorHandlerFunc, sipSimpleWrapper *, PyObject *, long);

    return sipVH__richtext_6(sipGILState, 0, sipPySelf, sipMeth, pos);
}


PyDoc_STRVAR(doc_wxRichTextTable_Draw, "Draw(dc, context, range, selection, rect, descent, style) -> bool\n"
"\n"
"Draw the item, within the given range.");

extern "C" {static PyObject *meth_wxRichTextTable_Draw(PyObject *, PyObject *, PyObject *);}
static PyObject *meth_wxRichTextTable_Draw(PyObject *sipSelf, PyObject *sipArgs, PyObject *sipKwds)
{
    PyObject *sipParseErr = SIP_NULLPTR;
    bool sipSelfWasArg = (!sipSelf || sipIsDerivedClass((sipSimpleWrapper *)sipSelf));

    {
        ::wxDC* dc;
        ::wxRichTextDrawingContext* context;
        const ::wxRichTextRange* range;
        int rangeState = 0;
        const ::wxRichTextSelection* selection;
        const ::wxRect* rect;
        int rectState = 0;
        int descent;
        int style;
        ::wxRichTextTable *sipCpp;

        static const char *sipKwdList[] = {
            sipName_dc,
            sipName_context,
            sipName_range,
            sipName_selection,
            sipName_rect,
            sipName_descent,
            sipName_style,
        };

        if (sipParseKwdArgs(&sipParseErr, sipArgs, sipKwds, sipKwdList, SIP_NULLPTR, "BJ9J9J1J9J1ii", &sipSelf, sipType_wxRichTextTable, &sipCpp, sipType_wxDC, &dc, sipType_wxRichTextDrawingContext, &context, sipType_wxRichTextRange, &range, &rangeState, sipType_wxRichTextSelection, &selection, sipType_wxRect, &rect, &rectState, &descent, &style))
        {
            bool sipRes;

            PyErr_Clear();

            Py_BEGIN_ALLOW_THREADS
            sipRes = (sipSelfWasArg ? sipCpp->::wxRichTextTable::Draw(*dc, *context, *range, *selection, *rect, descent, style) : sipCpp->Draw(*dc, *context, *range, *selection, *rect, descent, style));
            Py_END_ALLOW_THREADS
            sipReleaseType(const_cast< ::wxRichTextRange *>(range), sipType_wxRichTextRange, rangeState);
            sipReleaseType(const_cast< ::wxRect *>(rect), sipType_wxRect, rectState);

            if (PyErr_Occurred())
                return 0;

            return PyBool_FromLong(sipRes);
        }
    }

    sipNoMethod(sipParseErr, sipName_RichTextTable, sipName_Draw, SIP_NULLPTR);

    return SIP_NULLPTR;
}


PyDoc_STRVAR(doc_wxRichTextTable_HitTest, "HitTest(dc, context, pt, flags=0) -> (int, textPosition, obj, contextObj)\n"
"\n"
"Hit-testing: returns a flag indicating hit test details, plus\n"
"information about position.");

extern "C" {static PyObject *meth_wxRichTextTable_HitTest(PyObject *, PyObject *, PyObject *);}
static PyObject *meth_wxRichTextTable_HitTest(PyObject *sipSelf, PyObject *sipArgs, PyObject *sipKwds)
{
    PyObject *sipParseErr = SIP_NULLPTR;
    bool sipSelfWasArg = (!sipSelf || sipIsDerivedClass((sipSimpleWrapper *)sipSelf));

    {
        ::wxDC* dc;
        ::wxRichTextDrawingContext* context;
        const ::wxPoint* pt;
        int ptState = 0;
        long textPosition;
        ::wxRichTextObject* obj;
        ::wxRichTextObject* contextObj;
        int flags = 0;
        ::wxRichTextTable *sipCpp;

        static const char *sipKwdList[] = {
            sipName_dc,
            sipName_context,
            sipName_pt,
            sipName_flags,
        };

        if (sipParseKwdArgs(&sipParseErr, sipArgs, sipKwds, sipKwdList, SIP_NULLPTR, "BJ9J9J1|i", &sipSelf, sipType_wxRichTextTable, &sipCpp, sipType_wxDC, &dc, sipType_wxRichTextDrawingContext, &context, sipType_wxPoint, &pt, &ptState, &flags))
        {
            int sipRes;

            PyErr_Clear();

            Py_BEGIN_ALLOW_THREADS
            sipRes = (sipSelfWasArg ? sipCpp->::wxRichTextTable::HitTest(*dc, *context, *pt, textPosition, &obj, &contextObj, flags) : sipCpp->HitTest(*dc, *context, *pt, textPosition, &obj, &contextObj, flags));
            Py_END_ALLOW_THREADS
            sipReleaseType(const_cast< ::wxPoint *>(pt), sipType_wxPoint, ptState);

            if (PyErr_Occurred())
                return 0;

            return sipBuildResult(0, "(ilDD)", sipRes, textPosition, obj, sipType_wxRichTextObject, SIP_NULLPTR, contextObj, sipType_wxRichTextObject, SIP_NULLPTR);
        }
    }

    sipNoMethod(sipParseErr, sipName_RichTextTable, sipName_HitTest, SIP_NULLPTR);

    return SIP_NULLPTR;
}


PyDoc_STRVAR(doc_wxRichTextTable_GetXMLNodeName, "GetXMLNodeName() -> String\n"
"\n"
"Returns the XML node name of this object.");

extern "C" {static PyObject *meth_wxRichTextTable_GetXMLNodeName(PyObject *, PyObject *);}
static PyObject *meth_wxRichTextTable_GetXMLNodeName(PyObject *sipSelf, PyObject *sipArgs)
{
    PyObject *sipParseErr = SIP_NULLPTR;
    bool sipSelfWasArg = (!sipSelf || sipIsDerivedClass((sipSimpleWrapper *)sipSelf));

    {
        const ::wxRichTextTable *sipCpp;

        if (sipParseArgs(&sipParseErr, sipArgs, "B", &sipSelf, sipType_wxRichTextTable, &sipCpp))
        {
            ::wxString*sipRes;

            PyErr_Clear();

            Py_BEGIN_ALLOW_THREADS
            sipRes = new ::wxString((sipSelfWasArg ? sipCpp->::wxRichTextTable::GetXMLNodeName() : sipCpp->GetXMLNodeName()));
            Py_END_ALLOW_THREADS

            if (PyErr_Occurred())
                return 0;

            return sipConvertFromNewType(sipRes, sipType_wxString, SIP_NULLPTR);
        }
    }

    sipNoMethod(sipParseErr, sipName_RichTextTable, sipName_GetXMLNodeName, SIP_NULLPTR);

    return SIP_NULLPTR;
}


PyDoc_STRVAR(doc_wxRichTextTable_Layout, "Layout(dc, context, rect, parentRect, style) -> bool\n"
"\n"
"Lay the item out at the specified position with the given size\n"
"constraint.");

extern "C" {static PyObject *meth_wxRichTextTable_Layout(PyObject *, PyObject *, PyObject *);}
static PyObject *meth_wxRichTextTable_Layout(PyObject *sipSelf, PyObject *sipArgs, PyObject *sipKwds)
{
    PyObject *sipParseErr = SIP_NULLPTR;
    bool sipSelfWasArg = (!sipSelf || sipIsDerivedClass((sipSimpleWrapper *)sipSelf));

    {
        ::wxDC* dc;
        ::wxRichTextDrawingContext* context;
        const ::wxRect* rect;
        int rectState = 0;
        const ::wxRect* parentRect;
        int parentRectState = 0;
        int style;
        ::wxRichTextTable *sipCpp;

        static const char *sipKwdList[] = {
            sipName_dc,
            sipName_context,
            sipName_rect,
            sipName_parentRect,
            sipName_style,
        };

        if (sipParseKwdArgs(&sipParseErr, sipArgs, sipKwds, sipKwdList, SIP_NULLPTR, "BJ9J9J1J1i", &sipSelf, sipType_wxRichTextTable, &sipCpp, sipType_wxDC, &dc, sipType_wxRichTextDrawingContext, &context, sipType_wxRect, &rect, &rectState, sipType_wxRect, &parentRect, &parentRectState, &style))
        {
            bool sipRes;

            PyErr_Clear();

            Py_BEGIN_ALLOW_THREADS
            sipRes = (sipSelfWasArg ? sipCpp->::wxRichTextTable::Layout(*dc, *context, *rect, *parentRect, style) : sipCpp->Layout(*dc, *context, *rect, *parentRect, style));
            Py_END_ALLOW_THREADS
            sipReleaseType(const_cast< ::wxRect *>(rect), sipType_wxRect, rectState);
            sipReleaseType(const_cast< ::wxRect *>(parentRect), sipType_wxRect, parentRectState);

            if (PyErr_Occurred())
                return 0;

            return PyBool_FromLong(sipRes);
        }
    }

    sipNoMethod(sipParseErr, sipName_RichTextTable, sipName_Layout, SIP_NULLPTR);

    return SIP_NULLPTR;
}


PyDoc_STRVAR(doc_wxRichTextTable_GetRangeSize, "GetRangeSize(range, size, descent, dc, context, flags, position=wx.Point(0,0), parentSize=wx.DefaultSize, partialExtents=None) -> bool\n"
"\n"
"Returns the object size for the given range.");

extern "C" {static PyObject *meth_wxRichTextTable_GetRangeSize(PyObject *, PyObject *, PyObject *);}
static PyObject *meth_wxRichTextTable_GetRangeSize(PyObject *sipSelf, PyObject *sipArgs, PyObject *sipKwds)
{
    PyObject *sipParseErr = SIP_NULLPTR;
    bool sipSelfWasArg = (!sipSelf || sipIsDerivedClass((sipSimpleWrapper *)sipSelf));

    {
        const ::wxRichTextRange* range;
        int rangeState = 0;
        ::wxSize* size;
        int sizeState = 0;
        int descent;
        ::wxDC* dc;
        ::wxRichTextDrawingContext* context;
        int flags;
        const ::wxPoint& positiondef = wxPoint(0, 0);
        const ::wxPoint* position = &positiondef;
        int positionState = 0;
        const ::wxSize& parentSizedef = wxDefaultSize;
        const ::wxSize* parentSize = &parentSizedef;
        int parentSizeState = 0;
        ::wxArrayInt* partialExtents = 0;
        int partialExtentsState = 0;
        const ::wxRichTextTable *sipCpp;

        static const char *sipKwdList[] = {
            sipName_range,
            sipName_size,
            sipName_dc,
            sipName_context,
            sipName_flags,
            sipName_position,
            sipName_parentSize,
            sipName_partialExtents,
        };

        if (sipParseKwdArgs(&sipParseErr, sipArgs, sipKwds, sipKwdList, SIP_NULLPTR, "BJ1J1J9J9i|J1J1J0", &sipSelf, sipType_wxRichTextTable, &sipCpp, sipType_wxRichTextRange, &range, &rangeState, sipType_wxSize, &size, &sizeState, sipType_wxDC, &dc, sipType_wxRichTextDrawingContext, &context, &flags, sipType_wxPoint, &position, &positionState, sipType_wxSize, &parentSize, &parentSizeState, sipType_wxArrayInt, &partialExtents, &partialExtentsState))
        {
            bool sipRes;

            PyErr_Clear();

            Py_BEGIN_ALLOW_THREADS
            sipRes = (sipSelfWasArg ? sipCpp->::wxRichTextTable::GetRangeSize(*range, *size, descent, *dc, *context, flags, *position, *parentSize, partialExtents) : sipCpp->GetRangeSize(*range, *size, descent, *dc, *context, flags, *position, *parentSize, partialExtents));
            Py_END_ALLOW_THREADS
            sipReleaseType(const_cast< ::wxRichTextRange *>(range), sipType_wxRichTextRange, rangeState);
            sipReleaseType(size, sipType_wxSize, sizeState);
            sipReleaseType(const_cast< ::wxPoint *>(position), sipType_wxPoint, positionState);
            sipReleaseType(const_cast< ::wxSize *>(parentSize), sipType_wxSize, parentSizeState);
            sipReleaseType(partialExtents, sipType_wxArrayInt, partialExtentsState);

            if (PyErr_Occurred())
                return 0;

            return sipBuildResult(0, "(bi)", sipRes, descent);
        }
    }

    sipNoMethod(sipParseErr, sipName_RichTextTable, sipName_GetRangeSize, SIP_NULLPTR);

    return SIP_NULLPTR;
}


PyDoc_STRVAR(doc_wxRichTextTable_DeleteRange, "DeleteRange(range) -> bool\n"
"\n"
"Deletes the given range.");

extern "C" {static PyObject *meth_wxRichTextTable_DeleteRange(PyObject *, PyObject *, PyObject *);}
static PyObject *meth_wxRichTextTable_DeleteRange(PyObject *sipSelf, PyObject *sipArgs, PyObject *sipKwds)
{
    PyObject *sipParseErr = SIP_NULLPTR;
    bool sipSelfWasArg = (!sipSelf || sipIsDerivedClass((sipSimpleWrapper *)sipSelf));

    {
        const ::wxRichTextRange* range;
        int rangeState = 0;
        ::wxRichTextTable *sipCpp;

        static const char *sipKwdList[] = {
            sipName_range,
        };

        if (sipParseKwdArgs(&sipParseErr, sipArgs, sipKwds, sipKwdList, SIP_NULLPTR, "BJ1", &sipSelf, sipType_wxRichTextTable, &sipCpp, sipType_wxRichTextRange, &range, &rangeState))
        {
            bool sipRes;

            PyErr_Clear();

            Py_BEGIN_ALLOW_THREADS
            sipRes = (sipSelfWasArg ? sipCpp->::wxRichTextTable::DeleteRange(*range) : sipCpp->DeleteRange(*range));
            Py_END_ALLOW_THREADS
            sipReleaseType(const_cast< ::wxRichTextRange *>(range), sipType_wxRichTextRange, rangeState);

            if (PyErr_Occurred())
                return 0;

            return PyBool_FromLong(sipRes);
        }
    }

    sipNoMethod(sipParseErr, sipName_RichTextTable, sipName_DeleteRange, SIP_NULLPTR);

    return SIP_NULLPTR;
}


PyDoc_STRVAR(doc_wxRichTextTable_GetTextForRange, "GetTextForRange(range) -> String\n"
"\n"
"Returns any text in this object for the given range.");

extern "C" {static PyObject *meth_wxRichTextTable_GetTextForRange(PyObject *, PyObject *, PyObject *);}
static PyObject *meth_wxRichTextTable_GetTextForRange(PyObject *sipSelf, PyObject *sipArgs, PyObject *sipKwds)
{
    PyObject *sipParseErr = SIP_NULLPTR;
    bool sipSelfWasArg = (!sipSelf || sipIsDerivedClass((sipSimpleWrapper *)sipSelf));

    {
        const ::wxRichTextRange* range;
        int rangeState = 0;
        const ::wxRichTextTable *sipCpp;

        static const char *sipKwdList[] = {
            sipName_range,
        };

        if (sipParseKwdArgs(&sipParseErr, sipArgs, sipKwds, sipKwdList, SIP_NULLPTR, "BJ1", &sipSelf, sipType_wxRichTextTable, &sipCpp, sipType_wxRichTextRange, &range, &rangeState))
        {
            ::wxString*sipRes;

            PyErr_Clear();

            Py_BEGIN_ALLOW_THREADS
            sipRes = new ::wxString((sipSelfWasArg ? sipCpp->::wxRichTextTable::GetTextForRange(*range) : sipCpp->GetTextForRange(*range)));
            Py_END_ALLOW_THREADS
            sipReleaseType(const_cast< ::wxRichTextRange *>(range), sipType_wxRichTextRange, rangeState);

            if (PyErr_Occurred())
                return 0;

            return sipConvertFromNewType(sipRes, sipType_wxString, SIP_NULLPTR);
        }
    }

    sipNoMethod(sipParseErr, sipName_RichTextTable, sipName_GetTextForRange, SIP_NULLPTR);

    return SIP_NULLPTR;
}


PyDoc_STRVAR(doc_wxRichTextTable_ImportFromXML, "ImportFromXML(buffer, node, handler, recurse) -> bool\n"
"\n"
"Imports this object from XML.");

extern "C" {static PyObject *meth_wxRichTextTable_ImportFromXML(PyObject *, PyObject *, PyObject *);}
static PyObject *meth_wxRichTextTable_ImportFromXML(PyObject *sipSelf, PyObject *sipArgs, PyObject *sipKwds)
{
    PyObject *sipParseErr = SIP_NULLPTR;
    bool sipSelfWasArg = (!sipSelf || sipIsDerivedClass((sipSimpleWrapper *)sipSelf));

    {
        ::wxRichTextBuffer* buffer;
        ::wxXmlNode* node;
        ::wxRichTextXMLHandler* handler;
        bool recurse;
        ::wxRichTextTable *sipCpp;

        static const char *sipKwdList[] = {
            sipName_buffer,
            sipName_node,
            sipName_handler,
        };

        if (sipParseKwdArgs(&sipParseErr, sipArgs, sipKwds, sipKwdList, SIP_NULLPTR, "BJ8J8J8", &sipSelf, sipType_wxRichTextTable, &sipCpp, sipType_wxRichTextBuffer, &buffer, sipType_wxXmlNode, &node, sipType_wxRichTextXMLHandler, &handler))
        {
            bool sipRes;

            PyErr_Clear();

            Py_BEGIN_ALLOW_THREADS
            sipRes = (sipSelfWasArg ? sipCpp->::wxRichTextTable::ImportFromXML(buffer, node, handler, &recurse) : sipCpp->ImportFromXML(buffer, node, handler, &recurse));
            Py_END_ALLOW_THREADS

            if (PyErr_Occurred())
                return 0;

            return sipBuildResult(0, "(bb)", sipRes, recurse);
        }
    }

    sipNoMethod(sipParseErr, sipName_RichTextTable, sipName_ImportFromXML, SIP_NULLPTR);

    return SIP_NULLPTR;
}


PyDoc_STRVAR(doc_wxRichTextTable_FindPosition, "FindPosition(dc, context, index, forceLineStart) -> (bool, pt, height)\n"
"\n"
"Finds the absolute position and row height for the given character\n"
"position.");

extern "C" {static PyObject *meth_wxRichTextTable_FindPosition(PyObject *, PyObject *, PyObject *);}
static PyObject *meth_wxRichTextTable_FindPosition(PyObject *sipSelf, PyObject *sipArgs, PyObject *sipKwds)
{
    PyObject *sipParseErr = SIP_NULLPTR;
    bool sipSelfWasArg = (!sipSelf || sipIsDerivedClass((sipSimpleWrapper *)sipSelf));

    {
        ::wxDC* dc;
        ::wxRichTextDrawingContext* context;
        long index;
        ::wxPoint* pt;
        int height;
        bool forceLineStart;
        ::wxRichTextTable *sipCpp;

        static const char *sipKwdList[] = {
            sipName_dc,
            sipName_context,
            sipName_index,
            sipName_forceLineStart,
        };

        if (sipParseKwdArgs(&sipParseErr, sipArgs, sipKwds, sipKwdList, SIP_NULLPTR, "BJ9J9lb", &sipSelf, sipType_wxRichTextTable, &sipCpp, sipType_wxDC, &dc, sipType_wxRichTextDrawingContext, &context, &index, &forceLineStart))
        {
            bool sipRes;
            pt = new ::wxPoint();

            PyErr_Clear();

            Py_BEGIN_ALLOW_THREADS
            sipRes = (sipSelfWasArg ? sipCpp->::wxRichTextTable::FindPosition(*dc, *context, index, *pt, &height, forceLineStart) : sipCpp->FindPosition(*dc, *context, index, *pt, &height, forceLineStart));
            Py_END_ALLOW_THREADS

            if (PyErr_Occurred())
                return 0;

            return sipBuildResult(0, "(bNi)", sipRes, pt, sipType_wxPoint, SIP_NULLPTR, height);
        }
    }

    sipNoMethod(sipParseErr, sipName_RichTextTable, sipName_FindPosition, SIP_NULLPTR);

    return SIP_NULLPTR;
}


PyDoc_STRVAR(doc_wxRichTextTable_CalculateRange, "CalculateRange(start) -> end\n"
"\n"
"Calculates the range of the object.");

extern "C" {static PyObject *meth_wxRichTextTable_CalculateRange(PyObject *, PyObject *, PyObject *);}
static PyObject *meth_wxRichTextTable_CalculateRange(PyObject *sipSelf, PyObject *sipArgs, PyObject *sipKwds)
{
    PyObject *sipParseErr = SIP_NULLPTR;
    bool sipSelfWasArg = (!sipSelf || sipIsDerivedClass((sipSimpleWrapper *)sipSelf));

    {
        long start;
        long end;
        ::wxRichTextTable *sipCpp;

        static const char *sipKwdList[] = {
            sipName_start,
        };

        if (sipParseKwdArgs(&sipParseErr, sipArgs, sipKwds, sipKwdList, SIP_NULLPTR, "Bl", &sipSelf, sipType_wxRichTextTable, &sipCpp, &start))
        {
            PyErr_Clear();

            Py_BEGIN_ALLOW_THREADS
            (sipSelfWasArg ? sipCpp->::wxRichTextTable::CalculateRange(start, end) : sipCpp->CalculateRange(start, end));
            Py_END_ALLOW_THREADS

            if (PyErr_Occurred())
                return 0;

            return PyLong_FromLong(end);
        }
    }

    sipNoMethod(sipParseErr, sipName_RichTextTable, sipName_CalculateRange, SIP_NULLPTR);

    return SIP_NULLPTR;
}


PyDoc_STRVAR(doc_wxRichTextTable_HandlesChildSelections, "HandlesChildSelections() -> bool\n"
"\n"
"Returns true if this object can handle the selections of its children,\n"
"fOr example a table.");

extern "C" {static PyObject *meth_wxRichTextTable_HandlesChildSelections(PyObject *, PyObject *);}
static PyObject *meth_wxRichTextTable_HandlesChildSelections(PyObject *sipSelf, PyObject *sipArgs)
{
    PyObject *sipParseErr = SIP_NULLPTR;
    bool sipSelfWasArg = (!sipSelf || sipIsDerivedClass((sipSimpleWrapper *)sipSelf));

    {
        const ::wxRichTextTable *sipCpp;

        if (sipParseArgs(&sipParseErr, sipArgs, "B", &sipSelf, sipType_wxRichTextTable, &sipCpp))
        {
            bool sipRes;

            PyErr_Clear();

            Py_BEGIN_ALLOW_THREADS
            sipRes = (sipSelfWasArg ? sipCpp->::wxRichTextTable::HandlesChildSelections() : sipCpp->HandlesChildSelections());
            Py_END_ALLOW_THREADS

            if (PyErr_Occurred())
                return 0;

            return PyBool_FromLong(sipRes);
        }
    }

    sipNoMethod(sipParseErr, sipName_RichTextTable, sipName_HandlesChildSelections, SIP_NULLPTR);

    return SIP_NULLPTR;
}


PyDoc_STRVAR(doc_wxRichTextTable_GetSelection, "GetSelection(start, end) -> RichTextSelection\n"
"\n"
"Returns a selection object specifying the selections between start and\n"
"end character positions.");

extern "C" {static PyObject *meth_wxRichTextTable_GetSelection(PyObject *, PyObject *, PyObject *);}
static PyObject *meth_wxRichTextTable_GetSelection(PyObject *sipSelf, PyObject *sipArgs, PyObject *sipKwds)
{
    PyObject *sipParseErr = SIP_NULLPTR;
    bool sipSelfWasArg = (!sipSelf || sipIsDerivedClass((sipSimpleWrapper *)sipSelf));

    {
        long start;
        long end;
        const ::wxRichTextTable *sipCpp;

        static const char *sipKwdList[] = {
            sipName_start,
            sipName_end,
        };

        if (sipParseKwdArgs(&sipParseErr, sipArgs, sipKwds, sipKwdList, SIP_NULLPTR, "Bll", &sipSelf, sipType_wxRichTextTable, &sipCpp, &start, &end))
        {
            ::wxRichTextSelection*sipRes;

            PyErr_Clear();

            Py_BEGIN_ALLOW_THREADS
            sipRes = new ::wxRichTextSelection((sipSelfWasArg ? sipCpp->::wxRichTextTable::GetSelection(start, end) : sipCpp->GetSelection(start, end)));
            Py_END_ALLOW_THREADS

            if (PyErr_Occurred())
                return 0;

            return sipConvertFromNewType(sipRes, sipType_wxRichTextSelection, SIP_NULLPTR);
        }
    }

    sipNoMethod(sipParseErr, sipName_RichTextTable, sipName_GetSelection, SIP_NULLPTR);

    return SIP_NULLPTR;
}


PyDoc_STRVAR(doc_wxRichTextTable_CanEditProperties, "CanEditProperties() -> bool\n"
"\n"
"Returns true if we can edit the object's properties via a GUI.");

extern "C" {static PyObject *meth_wxRichTextTable_CanEditProperties(PyObject *, PyObject *);}
static PyObject *meth_wxRichTextTable_CanEditProperties(PyObject *sipSelf, PyObject *sipArgs)
{
    PyObject *sipParseErr = SIP_NULLPTR;
    bool sipSelfWasArg = (!sipSelf || sipIsDerivedClass((sipSimpleWrapper *)sipSelf));

    {
        const ::wxRichTextTable *sipCpp;

        if (sipParseArgs(&sipParseErr, sipArgs, "B", &sipSelf, sipType_wxRichTextTable, &sipCpp))
        {
            bool sipRes;

            PyErr_Clear();

            Py_BEGIN_ALLOW_THREADS
            sipRes = (sipSelfWasArg ? sipCpp->::wxRichTextTable::CanEditProperties() : sipCpp->CanEditProperties());
            Py_END_ALLOW_THREADS

            if (PyErr_Occurred())
                return 0;

            return PyBool_FromLong(sipRes);
        }
    }

    sipNoMethod(sipParseErr, sipName_RichTextTable, sipName_CanEditProperties, SIP_NULLPTR);

    return SIP_NULLPTR;
}


PyDoc_STRVAR(doc_wxRichTextTable_EditProperties, "EditProperties(parent, buffer) -> bool\n"
"\n"
"Edits the object's properties via a GUI.");

extern "C" {static PyObject *meth_wxRichTextTable_EditProperties(PyObject *, PyObject *, PyObject *);}
static PyObject *meth_wxRichTextTable_EditProperties(PyObject *sipSelf, PyObject *sipArgs, PyObject *sipKwds)
{
    PyObject *sipParseErr = SIP_NULLPTR;
    bool sipSelfWasArg = (!sipSelf || sipIsDerivedClass((sipSimpleWrapper *)sipSelf));

    {
        ::wxWindow* parent;
        ::wxRichTextBuffer* buffer;
        ::wxRichTextTable *sipCpp;

        static const char *sipKwdList[] = {
            sipName_parent,
            sipName_buffer,
        };

        if (sipParseKwdArgs(&sipParseErr, sipArgs, sipKwds, sipKwdList, SIP_NULLPTR, "BJ8J8", &sipSelf, sipType_wxRichTextTable, &sipCpp, sipType_wxWindow, &parent, sipType_wxRichTextBuffer, &buffer))
        {
            bool sipRes;

            PyErr_Clear();

            Py_BEGIN_ALLOW_THREADS
            sipRes = (sipSelfWasArg ? sipCpp->::wxRichTextTable::EditProperties(parent, buffer) : sipCpp->EditProperties(parent, buffer));
            Py_END_ALLOW_THREADS

            if (PyErr_Occurred())
                return 0;

            return PyBool_FromLong(sipRes);
        }
    }

    sipNoMethod(sipParseErr, sipName_RichTextTable, sipName_EditProperties, SIP_NULLPTR);

    return SIP_NULLPTR;
}


PyDoc_STRVAR(doc_wxRichTextTable_GetPropertiesMenuLabel, "GetPropertiesMenuLabel() -> String\n"
"\n"
"Returns the label to be used for the properties context menu item.");

extern "C" {static PyObject *meth_wxRichTextTable_GetPropertiesMenuLabel(PyObject *, PyObject *);}
static PyObject *meth_wxRichTextTable_GetPropertiesMenuLabel(PyObject *sipSelf, PyObject *sipArgs)
{
    PyObject *sipParseErr = SIP_NULLPTR;
    bool sipSelfWasArg = (!sipSelf || sipIsDerivedClass((sipSimpleWrapper *)sipSelf));

    {
        const ::wxRichTextTable *sipCpp;

        if (sipParseArgs(&sipParseErr, sipArgs, "B", &sipSelf, sipType_wxRichTextTable, &sipCpp))
        {
            ::wxString*sipRes;

            PyErr_Clear();

            Py_BEGIN_ALLOW_THREADS
            sipRes = new ::wxString((sipSelfWasArg ? sipCpp->::wxRichTextTable::GetPropertiesMenuLabel() : sipCpp->GetPropertiesMenuLabel()));
            Py_END_ALLOW_THREADS

            if (PyErr_Occurred())
                return 0;

            return sipConvertFromNewType(sipRes, sipType_wxString, SIP_NULLPTR);
        }
    }

    sipNoMethod(sipParseErr, sipName_RichTextTable, sipName_GetPropertiesMenuLabel, SIP_NULLPTR);

    return SIP_NULLPTR;
}


PyDoc_STRVAR(doc_wxRichTextTable_AcceptsFocus, "AcceptsFocus() -> bool\n"
"\n"
"Returns true if objects of this class can accept the focus, i.e. a\n"
"call to SetFocusObject is possible.");

extern "C" {static PyObject *meth_wxRichTextTable_AcceptsFocus(PyObject *, PyObject *);}
static PyObject *meth_wxRichTextTable_AcceptsFocus(PyObject *sipSelf, PyObject *sipArgs)
{
    PyObject *sipParseErr = SIP_NULLPTR;
    bool sipSelfWasArg = (!sipSelf || sipIsDerivedClass((sipSimpleWrapper *)sipSelf));

    {
        const ::wxRichTextTable *sipCpp;

        if (sipParseArgs(&sipParseErr, sipArgs, "B", &sipSelf, sipType_wxRichTextTable, &sipCpp))
        {
            bool sipRes;

            PyErr_Clear();

            Py_BEGIN_ALLOW_THREADS
            sipRes = (sipSelfWasArg ? sipCpp->::wxRichTextTable::AcceptsFocus() : sipCpp->AcceptsFocus());
            Py_END_ALLOW_THREADS

            if (PyErr_Occurred())
                return 0;

            return PyBool_FromLong(sipRes);
        }
    }

    sipNoMethod(sipParseErr, sipName_RichTextTable, sipName_AcceptsFocus, SIP_NULLPTR);

    return SIP_NULLPTR;
}


PyDoc_STRVAR(doc_wxRichTextTable_GetCells, "GetCells() -> RichTextObjectPtrArrayArray\n"
"\n"
"Returns the cells array.");

extern "C" {static PyObject *meth_wxRichTextTable_GetCells(PyObject *, PyObject *);}
static PyObject *meth_wxRichTextTable_GetCells(PyObject *sipSelf, PyObject *sipArgs)
{
    PyObject *sipParseErr = SIP_NULLPTR;

    {
        ::wxRichTextTable *sipCpp;

        if (sipParseArgs(&sipParseErr, sipArgs, "B", &sipSelf, sipType_wxRichTextTable, &sipCpp))
        {
            ::wxRichTextObjectPtrArrayArray*sipRes;

            PyErr_Clear();

            Py_BEGIN_ALLOW_THREADS
            sipRes = &sipCpp->GetCells();
            Py_END_ALLOW_THREADS

            if (PyErr_Occurred())
                return 0;

            return sipConvertFromType(sipRes, sipType_wxRichTextObjectPtrArrayArray, SIP_NULLPTR);
        }
    }

    sipNoMethod(sipParseErr, sipName_RichTextTable, sipName_GetCells, SIP_NULLPTR);

    return SIP_NULLPTR;
}


PyDoc_STRVAR(doc_wxRichTextTable_GetRowCount, "GetRowCount() -> int\n"
"\n"
"Returns the row count.");

extern "C" {static PyObject *meth_wxRichTextTable_GetRowCount(PyObject *, PyObject *);}
static PyObject *meth_wxRichTextTable_GetRowCount(PyObject *sipSelf, PyObject *sipArgs)
{
    PyObject *sipParseErr = SIP_NULLPTR;

    {
        const ::wxRichTextTable *sipCpp;

        if (sipParseArgs(&sipParseErr, sipArgs, "B", &sipSelf, sipType_wxRichTextTable, &sipCpp))
        {
            int sipRes;

            PyErr_Clear();

            Py_BEGIN_ALLOW_THREADS
            sipRes = sipCpp->GetRowCount();
            Py_END_ALLOW_THREADS

            if (PyErr_Occurred())
                return 0;

            return PyLong_FromLong(sipRes);
        }
    }

    sipNoMethod(sipParseErr, sipName_RichTextTable, sipName_GetRowCount, SIP_NULLPTR);

    return SIP_NULLPTR;
}


PyDoc_STRVAR(doc_wxRichTextTable_GetColumnCount, "GetColumnCount() -> int\n"
"\n"
"Returns the column count.");

extern "C" {static PyObject *meth_wxRichTextTable_GetColumnCount(PyObject *, PyObject *);}
static PyObject *meth_wxRichTextTable_GetColumnCount(PyObject *sipSelf, PyObject *sipArgs)
{
    PyObject *sipParseErr = SIP_NULLPTR;

    {
        const ::wxRichTextTable *sipCpp;

        if (sipParseArgs(&sipParseErr, sipArgs, "B", &sipSelf, sipType_wxRichTextTable, &sipCpp))
        {
            int sipRes;

            PyErr_Clear();

            Py_BEGIN_ALLOW_THREADS
            sipRes = sipCpp->GetColumnCount();
            Py_END_ALLOW_THREADS

            if (PyErr_Occurred())
                return 0;

            return PyLong_FromLong(sipRes);
        }
    }

    sipNoMethod(sipParseErr, sipName_RichTextTable, sipName_GetColumnCount, SIP_NULLPTR);

    return SIP_NULLPTR;
}


PyDoc_STRVAR(doc_wxRichTextTable_GetCell, "GetCell(row, col) -> RichTextCell\n"
"GetCell(pos) -> RichTextCell\n"
"\n"
"Returns the cell at the given row/column position.\n"
"");

extern "C" {static PyObject *meth_wxRichTextTable_GetCell(PyObject *, PyObject *, PyObject *);}
static PyObject *meth_wxRichTextTable_GetCell(PyObject *sipSelf, PyObject *sipArgs, PyObject *sipKwds)
{
    PyObject *sipParseErr = SIP_NULLPTR;
    bool sipSelfWasArg = (!sipSelf || sipIsDerivedClass((sipSimpleWrapper *)sipSelf));

    {
        int row;
        int col;
        const ::wxRichTextTable *sipCpp;

        static const char *sipKwdList[] = {
            sipName_row,
            sipName_col,
        };

        if (sipParseKwdArgs(&sipParseErr, sipArgs, sipKwds, sipKwdList, SIP_NULLPTR, "Bii", &sipSelf, sipType_wxRichTextTable, &sipCpp, &row, &col))
        {
            ::wxRichTextCell*sipRes;

            PyErr_Clear();

            Py_BEGIN_ALLOW_THREADS
            sipRes = (sipSelfWasArg ? sipCpp->::wxRichTextTable::GetCell(row, col) : sipCpp->GetCell(row, col));
            Py_END_ALLOW_THREADS

            if (PyErr_Occurred())
                return 0;

            return sipConvertFromType(sipRes, sipType_wxRichTextCell, SIP_NULLPTR);
        }
    }

    {
        long pos;
        const ::wxRichTextTable *sipCpp;

        static const char *sipKwdList[] = {
            sipName_pos,
        };

        if (sipParseKwdArgs(&sipParseErr, sipArgs, sipKwds, sipKwdList, SIP_NULLPTR, "Bl", &sipSelf, sipType_wxRichTextTable, &sipCpp, &pos))
        {
            ::wxRichTextCell*sipRes;

            PyErr_Clear();

            Py_BEGIN_ALLOW_THREADS
            sipRes = (sipSelfWasArg ? sipCpp->::wxRichTextTable::GetCell(pos) : sipCpp->GetCell(pos));
            Py_END_ALLOW_THREADS

            if (PyErr_Occurred())
                return 0;

            return sipConvertFromType(sipRes, sipType_wxRichTextCell, SIP_NULLPTR);
        }
    }

    sipNoMethod(sipParseErr, sipName_RichTextTable, sipName_GetCell, SIP_NULLPTR);

    return SIP_NULLPTR;
}


PyDoc_STRVAR(doc_wxRichTextTable_GetCellRowColumnPosition, "GetCellRowColumnPosition(pos, row, col) -> bool\n"
"\n"
"Returns the row/column for a given character position.");

extern "C" {static PyObject *meth_wxRichTextTable_GetCellRowColumnPosition(PyObject *, PyObject *, PyObject *);}
static PyObject *meth_wxRichTextTable_GetCellRowColumnPosition(PyObject *sipSelf, PyObject *sipArgs, PyObject *sipKwds)
{
    PyObject *sipParseErr = SIP_NULLPTR;
    bool sipSelfWasArg = (!sipSelf || sipIsDerivedClass((sipSimpleWrapper *)sipSelf));

    {
        long pos;
        int row;
        int col;
        const ::wxRichTextTable *sipCpp;

        static const char *sipKwdList[] = {
            sipName_pos,
        };

        if (sipParseKwdArgs(&sipParseErr, sipArgs, sipKwds, sipKwdList, SIP_NULLPTR, "Bl", &sipSelf, sipType_wxRichTextTable, &sipCpp, &pos))
        {
            bool sipRes;

            PyErr_Clear();

            Py_BEGIN_ALLOW_THREADS
            sipRes = (sipSelfWasArg ? sipCpp->::wxRichTextTable::GetCellRowColumnPosition(pos, row, col) : sipCpp->GetCellRowColumnPosition(pos, row, col));
            Py_END_ALLOW_THREADS

            if (PyErr_Occurred())
                return 0;

            return sipBuildResult(0, "(bii)", sipRes, row, col);
        }
    }

    sipNoMethod(sipParseErr, sipName_RichTextTable, sipName_GetCellRowColumnPosition, SIP_NULLPTR);

    return SIP_NULLPTR;
}


PyDoc_STRVAR(doc_wxRichTextTable_GetFocusedCell, "GetFocusedCell() -> wx.Position\n"
"\n"
"Returns the coordinates of the cell with keyboard focus, or (-1,-1) if\n"
"none.");

extern "C" {static PyObject *meth_wxRichTextTable_GetFocusedCell(PyObject *, PyObject *);}
static PyObject *meth_wxRichTextTable_GetFocusedCell(PyObject *sipSelf, PyObject *sipArgs)
{
    PyObject *sipParseErr = SIP_NULLPTR;
    bool sipSelfWasArg = (!sipSelf || sipIsDerivedClass((sipSimpleWrapper *)sipSelf));

    {
        const ::wxRichTextTable *sipCpp;

        if (sipParseArgs(&sipParseErr, sipArgs, "B", &sipSelf, sipType_wxRichTextTable, &sipCpp))
        {
            ::wxPosition*sipRes;

            PyErr_Clear();

            Py_BEGIN_ALLOW_THREADS
            sipRes = new ::wxPosition((sipSelfWasArg ? sipCpp->::wxRichTextTable::GetFocusedCell() : sipCpp->GetFocusedCell()));
            Py_END_ALLOW_THREADS

            if (PyErr_Occurred())
                return 0;

            return sipConvertFromNewType(sipRes, sipType_wxPosition, SIP_NULLPTR);
        }
    }

    sipNoMethod(sipParseErr, sipName_RichTextTable, sipName_GetFocusedCell, SIP_NULLPTR);

    return SIP_NULLPTR;
}


PyDoc_STRVAR(doc_wxRichTextTable_ClearTable, "ClearTable()\n"
"\n"
"Clears the table.");

extern "C" {static PyObject *meth_wxRichTextTable_ClearTable(PyObject *, PyObject *);}
static PyObject *meth_wxRichTextTable_ClearTable(PyObject *sipSelf, PyObject *sipArgs)
{
    PyObject *sipParseErr = SIP_NULLPTR;
    bool sipSelfWasArg = (!sipSelf || sipIsDerivedClass((sipSimpleWrapper *)sipSelf));

    {
        ::wxRichTextTable *sipCpp;

        if (sipParseArgs(&sipParseErr, sipArgs, "B", &sipSelf, sipType_wxRichTextTable, &sipCpp))
        {
            PyErr_Clear();

            Py_BEGIN_ALLOW_THREADS
            (sipSelfWasArg ? sipCpp->::wxRichTextTable::ClearTable() : sipCpp->ClearTable());
            Py_END_ALLOW_THREADS

            if (PyErr_Occurred())
                return 0;

            Py_INCREF(Py_None);
            return Py_None;
        }
    }

    sipNoMethod(sipParseErr, sipName_RichTextTable, sipName_ClearTable, SIP_NULLPTR);

    return SIP_NULLPTR;
}


PyDoc_STRVAR(doc_wxRichTextTable_CreateTable, "CreateTable(rows, cols) -> bool\n"
"\n"
"Creates a table of the given dimensions.");

extern "C" {static PyObject *meth_wxRichTextTable_CreateTable(PyObject *, PyObject *, PyObject *);}
static PyObject *meth_wxRichTextTable_CreateTable(PyObject *sipSelf, PyObject *sipArgs, PyObject *sipKwds)
{
    PyObject *sipParseErr = SIP_NULLPTR;
    bool sipSelfWasArg = (!sipSelf || sipIsDerivedClass((sipSimpleWrapper *)sipSelf));

    {
        int rows;
        int cols;
        ::wxRichTextTable *sipCpp;

        static const char *sipKwdList[] = {
            sipName_rows,
            sipName_cols,
        };

        if (sipParseKwdArgs(&sipParseErr, sipArgs, sipKwds, sipKwdList, SIP_NULLPTR, "Bii", &sipSelf, sipType_wxRichTextTable, &sipCpp, &rows, &cols))
        {
            bool sipRes;

            PyErr_Clear();

            Py_BEGIN_ALLOW_THREADS
            sipRes = (sipSelfWasArg ? sipCpp->::wxRichTextTable::CreateTable(rows, cols) : sipCpp->CreateTable(rows, cols));
            Py_END_ALLOW_THREADS

            if (PyErr_Occurred())
                return 0;

            return PyBool_FromLong(sipRes);
        }
    }

    sipNoMethod(sipParseErr, sipName_RichTextTable, sipName_CreateTable, SIP_NULLPTR);

    return SIP_NULLPTR;
}


PyDoc_STRVAR(doc_wxRichTextTable_SetCellStyle, "SetCellStyle(selection, style, flags=RICHTEXT_SETSTYLE_WITH_UNDO) -> bool\n"
"\n"
"Sets the attributes for the cells specified by the selection.");

extern "C" {static PyObject *meth_wxRichTextTable_SetCellStyle(PyObject *, PyObject *, PyObject *);}
static PyObject *meth_wxRichTextTable_SetCellStyle(PyObject *sipSelf, PyObject *sipArgs, PyObject *sipKwds)
{
    PyObject *sipParseErr = SIP_NULLPTR;
    bool sipSelfWasArg = (!sipSelf || sipIsDerivedClass((sipSimpleWrapper *)sipSelf));

    {
        const ::wxRichTextSelection* selection;
        const ::wxRichTextAttr* style;
        int flags = wxRICHTEXT_SETSTYLE_WITH_UNDO;
        ::wxRichTextTable *sipCpp;

        static const char *sipKwdList[] = {
            sipName_selection,
            sipName_style,
            sipName_flags,
        };

        if (sipParseKwdArgs(&sipParseErr, sipArgs, sipKwds, sipKwdList, SIP_NULLPTR, "BJ9J9|i", &sipSelf, sipType_wxRichTextTable, &sipCpp, sipType_wxRichTextSelection, &selection, sipType_wxRichTextAttr, &style, &flags))
        {
            bool sipRes;

            PyErr_Clear();

            Py_BEGIN_ALLOW_THREADS
            sipRes = (sipSelfWasArg ? sipCpp->::wxRichTextTable::SetCellStyle(*selection, *style, flags) : sipCpp->SetCellStyle(*selection, *style, flags));
            Py_END_ALLOW_THREADS

            if (PyErr_Occurred())
                return 0;

            return PyBool_FromLong(sipRes);
        }
    }

    sipNoMethod(sipParseErr, sipName_RichTextTable, sipName_SetCellStyle, SIP_NULLPTR);

    return SIP_NULLPTR;
}


PyDoc_STRVAR(doc_wxRichTextTable_DeleteRows, "DeleteRows(startRow, noRows=1) -> bool\n"
"\n"
"Deletes rows from the given row position.");

extern "C" {static PyObject *meth_wxRichTextTable_DeleteRows(PyObject *, PyObject *, PyObject *);}
static PyObject *meth_wxRichTextTable_DeleteRows(PyObject *sipSelf, PyObject *sipArgs, PyObject *sipKwds)
{
    PyObject *sipParseErr = SIP_NULLPTR;
    bool sipSelfWasArg = (!sipSelf || sipIsDerivedClass((sipSimpleWrapper *)sipSelf));

    {
        int startRow;
        int noRows = 1;
        ::wxRichTextTable *sipCpp;

        static const char *sipKwdList[] = {
            sipName_startRow,
            sipName_noRows,
        };

        if (sipParseKwdArgs(&sipParseErr, sipArgs, sipKwds, sipKwdList, SIP_NULLPTR, "Bi|i", &sipSelf, sipType_wxRichTextTable, &sipCpp, &startRow, &noRows))
        {
            bool sipRes;

            PyErr_Clear();

            Py_BEGIN_ALLOW_THREADS
            sipRes = (sipSelfWasArg ? sipCpp->::wxRichTextTable::DeleteRows(startRow, noRows) : sipCpp->DeleteRows(startRow, noRows));
            Py_END_ALLOW_THREADS

            if (PyErr_Occurred())
                return 0;

            return PyBool_FromLong(sipRes);
        }
    }

    sipNoMethod(sipParseErr, sipName_RichTextTable, sipName_DeleteRows, SIP_NULLPTR);

    return SIP_NULLPTR;
}


PyDoc_STRVAR(doc_wxRichTextTable_DeleteColumns, "DeleteColumns(startCol, noCols=1) -> bool\n"
"\n"
"Deletes columns from the given column position.");

extern "C" {static PyObject *meth_wxRichTextTable_DeleteColumns(PyObject *, PyObject *, PyObject *);}
static PyObject *meth_wxRichTextTable_DeleteColumns(PyObject *sipSelf, PyObject *sipArgs, PyObject *sipKwds)
{
    PyObject *sipParseErr = SIP_NULLPTR;
    bool sipSelfWasArg = (!sipSelf || sipIsDerivedClass((sipSimpleWrapper *)sipSelf));

    {
        int startCol;
        int noCols = 1;
        ::wxRichTextTable *sipCpp;

        static const char *sipKwdList[] = {
            sipName_startCol,
            sipName_noCols,
        };

        if (sipParseKwdArgs(&sipParseErr, sipArgs, sipKwds, sipKwdList, SIP_NULLPTR, "Bi|i", &sipSelf, sipType_wxRichTextTable, &sipCpp, &startCol, &noCols))
        {
            bool sipRes;

            PyErr_Clear();

            Py_BEGIN_ALLOW_THREADS
            sipRes = (sipSelfWasArg ? sipCpp->::wxRichTextTable::DeleteColumns(startCol, noCols) : sipCpp->DeleteColumns(startCol, noCols));
            Py_END_ALLOW_THREADS

            if (PyErr_Occurred())
                return 0;

            return PyBool_FromLong(sipRes);
        }
    }

    sipNoMethod(sipParseErr, sipName_RichTextTable, sipName_DeleteColumns, SIP_NULLPTR);

    return SIP_NULLPTR;
}


PyDoc_STRVAR(doc_wxRichTextTable_AddRows, "AddRows(startRow, noRows=1, attr=RichTextAttr()) -> bool\n"
"\n"
"Adds rows from the given row position.");

extern "C" {static PyObject *meth_wxRichTextTable_AddRows(PyObject *, PyObject *, PyObject *);}
static PyObject *meth_wxRichTextTable_AddRows(PyObject *sipSelf, PyObject *sipArgs, PyObject *sipKwds)
{
    PyObject *sipParseErr = SIP_NULLPTR;
    bool sipSelfWasArg = (!sipSelf || sipIsDerivedClass((sipSimpleWrapper *)sipSelf));

    {
        int startRow;
        int noRows = 1;
        const ::wxRichTextAttr& attrdef = wxRichTextAttr();
        const ::wxRichTextAttr* attr = &attrdef;
        ::wxRichTextTable *sipCpp;

        static const char *sipKwdList[] = {
            sipName_startRow,
            sipName_noRows,
            sipName_attr,
        };

        if (sipParseKwdArgs(&sipParseErr, sipArgs, sipKwds, sipKwdList, SIP_NULLPTR, "Bi|iJ9", &sipSelf, sipType_wxRichTextTable, &sipCpp, &startRow, &noRows, sipType_wxRichTextAttr, &attr))
        {
            bool sipRes;

            PyErr_Clear();

            Py_BEGIN_ALLOW_THREADS
            sipRes = (sipSelfWasArg ? sipCpp->::wxRichTextTable::AddRows(startRow, noRows, *attr) : sipCpp->AddRows(startRow, noRows, *attr));
            Py_END_ALLOW_THREADS

            if (PyErr_Occurred())
                return 0;

            return PyBool_FromLong(sipRes);
        }
    }

    sipNoMethod(sipParseErr, sipName_RichTextTable, sipName_AddRows, SIP_NULLPTR);

    return SIP_NULLPTR;
}


PyDoc_STRVAR(doc_wxRichTextTable_AddColumns, "AddColumns(startCol, noCols=1, attr=RichTextAttr()) -> bool\n"
"\n"
"Adds columns from the given column position.");

extern "C" {static PyObject *meth_wxRichTextTable_AddColumns(PyObject *, PyObject *, PyObject *);}
static PyObject *meth_wxRichTextTable_AddColumns(PyObject *sipSelf, PyObject *sipArgs, PyObject *sipKwds)
{
    PyObject *sipParseErr = SIP_NULLPTR;
    bool sipSelfWasArg = (!sipSelf || sipIsDerivedClass((sipSimpleWrapper *)sipSelf));

    {
        int startCol;
        int noCols = 1;
        const ::wxRichTextAttr& attrdef = wxRichTextAttr();
        const ::wxRichTextAttr* attr = &attrdef;
        ::wxRichTextTable *sipCpp;

        static const char *sipKwdList[] = {
            sipName_startCol,
            sipName_noCols,
            sipName_attr,
        };

        if (sipParseKwdArgs(&sipParseErr, sipArgs, sipKwds, sipKwdList, SIP_NULLPTR, "Bi|iJ9", &sipSelf, sipType_wxRichTextTable, &sipCpp, &startCol, &noCols, sipType_wxRichTextAttr, &attr))
        {
            bool sipRes;

            PyErr_Clear();

            Py_BEGIN_ALLOW_THREADS
            sipRes = (sipSelfWasArg ? sipCpp->::wxRichTextTable::AddColumns(startCol, noCols, *attr) : sipCpp->AddColumns(startCol, noCols, *attr));
            Py_END_ALLOW_THREADS

            if (PyErr_Occurred())
                return 0;

            return PyBool_FromLong(sipRes);
        }
    }

    sipNoMethod(sipParseErr, sipName_RichTextTable, sipName_AddColumns, SIP_NULLPTR);

    return SIP_NULLPTR;
}


PyDoc_STRVAR(doc_wxRichTextTable_Clone, "Clone() -> RichTextObject\n"
"\n"
"Clones the object.");

extern "C" {static PyObject *meth_wxRichTextTable_Clone(PyObject *, PyObject *);}
static PyObject *meth_wxRichTextTable_Clone(PyObject *sipSelf, PyObject *sipArgs)
{
    PyObject *sipParseErr = SIP_NULLPTR;
    bool sipSelfWasArg = (!sipSelf || sipIsDerivedClass((sipSimpleWrapper *)sipSelf));

    {
        const ::wxRichTextTable *sipCpp;

        if (sipParseArgs(&sipParseErr, sipArgs, "B", &sipSelf, sipType_wxRichTextTable, &sipCpp))
        {
            ::wxRichTextObject*sipRes;

            PyErr_Clear();

            Py_BEGIN_ALLOW_THREADS
            sipRes = (sipSelfWasArg ? sipCpp->::wxRichTextTable::Clone() : sipCpp->Clone());
            Py_END_ALLOW_THREADS

            if (PyErr_Occurred())
                return 0;

            return sipConvertFromNewType(sipRes, sipType_wxRichTextObject, SIP_NULLPTR);
        }
    }

    sipNoMethod(sipParseErr, sipName_RichTextTable, sipName_Clone, SIP_NULLPTR);

    return SIP_NULLPTR;
}


PyDoc_STRVAR(doc_wxRichTextTable_Copy, "Copy(obj)");

extern "C" {static PyObject *meth_wxRichTextTable_Copy(PyObject *, PyObject *, PyObject *);}
static PyObject *meth_wxRichTextTable_Copy(PyObject *sipSelf, PyObject *sipArgs, PyObject *sipKwds)
{
    PyObject *sipParseErr = SIP_NULLPTR;

    {
        const ::wxRichTextTable* obj;
        ::wxRichTextTable *sipCpp;

        static const char *sipKwdList[] = {
            sipName_obj,
        };

        if (sipParseKwdArgs(&sipParseErr, sipArgs, sipKwds, sipKwdList, SIP_NULLPTR, "BJ9", &sipSelf, sipType_wxRichTextTable, &sipCpp, sipType_wxRichTextTable, &obj))
        {
            PyErr_Clear();

            Py_BEGIN_ALLOW_THREADS
            sipCpp->Copy(*obj);
            Py_END_ALLOW_THREADS

            if (PyErr_Occurred())
                return 0;

            Py_INCREF(Py_None);
            return Py_None;
        }
    }

    sipNoMethod(sipParseErr, sipName_RichTextTable, sipName_Copy, SIP_NULLPTR);

    return SIP_NULLPTR;
}


/* Cast a pointer to a type somewhere in its inheritance hierarchy. */
extern "C" {static void *cast_wxRichTextTable(void *, const sipTypeDef *);}
static void *cast_wxRichTextTable(void *sipCppV, const sipTypeDef *targetType)
{
    ::wxRichTextTable *sipCpp = reinterpret_cast< ::wxRichTextTable *>(sipCppV);

    if (targetType == sipType_wxRichTextTable)
        return sipCppV;

    sipCppV = ((const sipClassTypeDef *)sipType_wxRichTextBox)->ctd_cast(static_cast< ::wxRichTextBox *>(sipCpp), targetType);
    if (sipCppV)
        return sipCppV;

    return SIP_NULLPTR;
}


/* Call the instance's destructor. */
extern "C" {static void release_wxRichTextTable(void *, int);}
static void release_wxRichTextTable(void *sipCppV, int sipState)
{
    Py_BEGIN_ALLOW_THREADS

    if (sipState & SIP_DERIVED_CLASS)
        delete reinterpret_cast<sipwxRichTextTable *>(sipCppV);
    else
        delete reinterpret_cast< ::wxRichTextTable *>(sipCppV);

    Py_END_ALLOW_THREADS
}


extern "C" {static void *array_wxRichTextTable(Py_ssize_t);}
static void *array_wxRichTextTable(Py_ssize_t sipNrElem)
{
    return new ::wxRichTextTable[sipNrElem];
}


extern "C" {static void array_delete_wxRichTextTable(void *);}
static void array_delete_wxRichTextTable(void *sipCpp)
{
    delete[] reinterpret_cast< ::wxRichTextTable *>(sipCpp);
}


extern "C" {static void assign_wxRichTextTable(void *, Py_ssize_t, void *);}
static void assign_wxRichTextTable(void *sipDst, Py_ssize_t sipDstIdx, void *sipSrc)
{
    reinterpret_cast< ::wxRichTextTable *>(sipDst)[sipDstIdx] = *reinterpret_cast< ::wxRichTextTable *>(sipSrc);
}


extern "C" {static void *copy_wxRichTextTable(const void *, Py_ssize_t);}
static void *copy_wxRichTextTable(const void *sipSrc, Py_ssize_t sipSrcIdx)
{
    return new ::wxRichTextTable(reinterpret_cast<const ::wxRichTextTable *>(sipSrc)[sipSrcIdx]);
}


extern "C" {static void dealloc_wxRichTextTable(sipSimpleWrapper *);}
static void dealloc_wxRichTextTable(sipSimpleWrapper *sipSelf)
{
    if (sipIsDerivedClass(sipSelf))
        reinterpret_cast<sipwxRichTextTable *>(sipGetAddress(sipSelf))->sipPySelf = SIP_NULLPTR;

    if (sipIsOwnedByPython(sipSelf))
    {
        release_wxRichTextTable(sipGetAddress(sipSelf), sipIsDerivedClass(sipSelf));
    }
}


extern "C" {static void *init_type_wxRichTextTable(sipSimpleWrapper *, PyObject *, PyObject *, PyObject **, PyObject **, PyObject **);}
static void *init_type_wxRichTextTable(sipSimpleWrapper *sipSelf, PyObject *sipArgs, PyObject *sipKwds, PyObject **sipUnused, PyObject **, PyObject **sipParseErr)
{
    sipwxRichTextTable *sipCpp = SIP_NULLPTR;

    {
        ::wxRichTextObject* parent = 0;

        static const char *sipKwdList[] = {
            sipName_parent,
        };

        if (sipParseKwdArgs(sipParseErr, sipArgs, sipKwds, sipKwdList, sipUnused, "|J8", sipType_wxRichTextObject, &parent))
        {
            PyErr_Clear();

            Py_BEGIN_ALLOW_THREADS
            sipCpp = new sipwxRichTextTable(parent);
            Py_END_ALLOW_THREADS

            if (PyErr_Occurred())
            {
                delete sipCpp;
                return SIP_NULLPTR;
            }

            sipCpp->sipPySelf = sipSelf;

            return sipCpp;
        }
    }

    {
        const ::wxRichTextTable* obj;

        static const char *sipKwdList[] = {
            sipName_obj,
        };

        if (sipParseKwdArgs(sipParseErr, sipArgs, sipKwds, sipKwdList, sipUnused, "J9", sipType_wxRichTextTable, &obj))
        {
            PyErr_Clear();

            Py_BEGIN_ALLOW_THREADS
            sipCpp = new sipwxRichTextTable(*obj);
            Py_END_ALLOW_THREADS

            if (PyErr_Occurred())
            {
                delete sipCpp;
                return SIP_NULLPTR;
            }

            sipCpp->sipPySelf = sipSelf;

            return sipCpp;
        }
    }

    return SIP_NULLPTR;
}


/* Define this type's super-types. */
static sipEncodedTypeDef supers_wxRichTextTable[] = {{5, 255, 1}};


static PyMethodDef methods_wxRichTextTable[] = {
    {sipName_AcceptsFocus, meth_wxRichTextTable_AcceptsFocus, METH_VARARGS, doc_wxRichTextTable_AcceptsFocus},
    {sipName_AddColumns, SIP_MLMETH_CAST(meth_wxRichTextTable_AddColumns), METH_VARARGS|METH_KEYWORDS, doc_wxRichTextTable_AddColumns},
    {sipName_AddRows, SIP_MLMETH_CAST(meth_wxRichTextTable_AddRows), METH_VARARGS|METH_KEYWORDS, doc_wxRichTextTable_AddRows},
    {sipName_CalculateRange, SIP_MLMETH_CAST(meth_wxRichTextTable_CalculateRange), METH_VARARGS|METH_KEYWORDS, doc_wxRichTextTable_CalculateRange},
    {sipName_CanEditProperties, meth_wxRichTextTable_CanEditProperties, METH_VARARGS, doc_wxRichTextTable_CanEditProperties},
    {sipName_ClearTable, meth_wxRichTextTable_ClearTable, METH_VARARGS, doc_wxRichTextTable_ClearTable},
    {sipName_Clone, meth_wxRichTextTable_Clone, METH_VARARGS, doc_wxRichTextTable_Clone},
    {sipName_Copy, SIP_MLMETH_CAST(meth_wxRichTextTable_Copy), METH_VARARGS|METH_KEYWORDS, doc_wxRichTextTable_Copy},
    {sipName_CreateTable, SIP_MLMETH_CAST(meth_wxRichTextTable_CreateTable), METH_VARARGS|METH_KEYWORDS, doc_wxRichTextTable_CreateTable},
    {sipName_DeleteColumns, SIP_MLMETH_CAST(meth_wxRichTextTable_DeleteColumns), METH_VARARGS|METH_KEYWORDS, doc_wxRichTextTable_DeleteColumns},
    {sipName_DeleteRange, SIP_MLMETH_CAST(meth_wxRichTextTable_DeleteRange), METH_VARARGS|METH_KEYWORDS, doc_wxRichTextTable_DeleteRange},
    {sipName_DeleteRows, SIP_MLMETH_CAST(meth_wxRichTextTable_DeleteRows), METH_VARARGS|METH_KEYWORDS, doc_wxRichTextTable_DeleteRows},
    {sipName_Draw, SIP_MLMETH_CAST(meth_wxRichTextTable_Draw), METH_VARARGS|METH_KEYWORDS, doc_wxRichTextTable_Draw},
    {sipName_EditProperties, SIP_MLMETH_CAST(meth_wxRichTextTable_EditProperties), METH_VARARGS|METH_KEYWORDS, doc_wxRichTextTable_EditProperties},
    {sipName_FindPosition, SIP_MLMETH_CAST(meth_wxRichTextTable_FindPosition), METH_VARARGS|METH_KEYWORDS, doc_wxRichTextTable_FindPosition},
    {sipName_GetCell, SIP_MLMETH_CAST(meth_wxRichTextTable_GetCell), METH_VARARGS|METH_KEYWORDS, doc_wxRichTextTable_GetCell},
    {sipName_GetCellRowColumnPosition, SIP_MLMETH_CAST(meth_wxRichTextTable_GetCellRowColumnPosition), METH_VARARGS|METH_KEYWORDS, doc_wxRichTextTable_GetCellRowColumnPosition},
    {sipName_GetCells, meth_wxRichTextTable_GetCells, METH_VARARGS, doc_wxRichTextTable_GetCells},
    {sipName_GetColumnCount, meth_wxRichTextTable_GetColumnCount, METH_VARARGS, doc_wxRichTextTable_GetColumnCount},
    {sipName_GetFocusedCell, meth_wxRichTextTable_GetFocusedCell, METH_VARARGS, doc_wxRichTextTable_GetFocusedCell},
    {sipName_GetPropertiesMenuLabel, meth_wxRichTextTable_GetPropertiesMenuLabel, METH_VARARGS, doc_wxRichTextTable_GetPropertiesMenuLabel},
    {sipName_GetRangeSize, SIP_MLMETH_CAST(meth_wxRichTextTable_GetRangeSize), METH_VARARGS|METH_KEYWORDS, doc_wxRichTextTable_GetRangeSize},
    {sipName_GetRowCount, meth_wxRichTextTable_GetRowCount, METH_VARARGS, doc_wxRichTextTable_GetRowCount},
    {sipName_GetSelection, SIP_MLMETH_CAST(meth_wxRichTextTable_GetSelection), METH_VARARGS|METH_KEYWORDS, doc_wxRichTextTable_GetSelection},
    {sipName_GetTextForRange, SIP_MLMETH_CAST(meth_wxRichTextTable_GetTextForRange), METH_VARARGS|METH_KEYWORDS, doc_wxRichTextTable_GetTextForRange},
    {sipName_GetXMLNodeName, meth_wxRichTextTable_GetXMLNodeName, METH_VARARGS, doc_wxRichTextTable_GetXMLNodeName},
    {sipName_HandlesChildSelections, meth_wxRichTextTable_HandlesChildSelections, METH_VARARGS, doc_wxRichTextTable_HandlesChildSelections},
    {sipName_HitTest, SIP_MLMETH_CAST(meth_wxRichTextTable_HitTest), METH_VARARGS|METH_KEYWORDS, doc_wxRichTextTable_HitTest},
    {sipName_ImportFromXML, SIP_MLMETH_CAST(meth_wxRichTextTable_ImportFromXML), METH_VARARGS|METH_KEYWORDS, doc_wxRichTextTable_ImportFromXML},
    {sipName_Layout, SIP_MLMETH_CAST(meth_wxRichTextTable_Layout), METH_VARARGS|METH_KEYWORDS, doc_wxRichTextTable_Layout},
    {sipName_SetCellStyle, SIP_MLMETH_CAST(meth_wxRichTextTable_SetCellStyle), METH_VARARGS|METH_KEYWORDS, doc_wxRichTextTable_SetCellStyle}
};

sipVariableDef variables_wxRichTextTable[] = {
    {PropertyVariable, sipName_XMLNodeName, &methods_wxRichTextTable[25], SIP_NULLPTR, SIP_NULLPTR, SIP_NULLPTR},
    {PropertyVariable, sipName_RowCount, &methods_wxRichTextTable[22], SIP_NULLPTR, SIP_NULLPTR, SIP_NULLPTR},
    {PropertyVariable, sipName_PropertiesMenuLabel, &methods_wxRichTextTable[20], SIP_NULLPTR, SIP_NULLPTR, SIP_NULLPTR},
    {PropertyVariable, sipName_FocusedCell, &methods_wxRichTextTable[19], SIP_NULLPTR, SIP_NULLPTR, SIP_NULLPTR},
    {PropertyVariable, sipName_ColumnCount, &methods_wxRichTextTable[18], SIP_NULLPTR, SIP_NULLPTR, SIP_NULLPTR},
    {PropertyVariable, sipName_Cells, &methods_wxRichTextTable[17], SIP_NULLPTR, SIP_NULLPTR, SIP_NULLPTR},
};

PyDoc_STRVAR(doc_wxRichTextTable, "RichTextTable(parent=None)\n"
"RichTextTable(obj)\n"
"\n"
"wxRichTextTable represents a table with arbitrary columns and rows.");


sipClassTypeDef sipTypeDef__richtext_wxRichTextTable = {
    {
        -1,
        SIP_NULLPTR,
        SIP_NULLPTR,
        SIP_TYPE_SCC|SIP_TYPE_CLASS,
        sipNameNr_wxRichTextTable,
        SIP_NULLPTR,
        SIP_NULLPTR,
    },
    {
        sipNameNr_RichTextTable,
        {0, 0, 1},
        31, methods_wxRichTextTable,
        0, SIP_NULLPTR,
        6, variables_wxRichTextTable,
        {SIP_NULLPTR, SIP_NULLPTR, SIP_NULLPTR, SIP_NULLPTR, SIP_NULLPTR, SIP_NULLPTR, SIP_NULLPTR, SIP_NULLPTR, SIP_NULLPTR, SIP_NULLPTR},
    },
    doc_wxRichTextTable,
    -1,
    -1,
    supers_wxRichTextTable,
    SIP_NULLPTR,
    init_type_wxRichTextTable,
    SIP_NULLPTR,
    SIP_NULLPTR,
    SIP_NULLPTR,
    SIP_NULLPTR,
    dealloc_wxRichTextTable,
    assign_wxRichTextTable,
    array_wxRichTextTable,
    copy_wxRichTextTable,
    release_wxRichTextTable,
    cast_wxRichTextTable,
    SIP_NULLPTR,
    SIP_NULLPTR,
    SIP_NULLPTR,
    SIP_NULLPTR,
    SIP_NULLPTR,
    SIP_NULLPTR,
    array_delete_wxRichTextTable,
    sizeof (::wxRichTextTable),
};
