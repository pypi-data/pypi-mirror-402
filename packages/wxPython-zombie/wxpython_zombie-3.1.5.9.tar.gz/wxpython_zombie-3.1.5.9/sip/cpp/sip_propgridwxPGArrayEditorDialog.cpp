/*
 * Interface wrapper code.
 *
 * Generated by SIP 6.15.1
 */

#include "sipAPI_propgrid.h"

        #include <wx/propgrid/props.h>

        #include <wx/window.h>
        #include <wx/validate.h>
        #include <wx/window.h>
        #include <wx/gdicmn.h>
        #include <wx/gdicmn.h>
        #include <wx/event.h>
        #include <wx/dialog.h>
        #include <wx/iconbndl.h>
        #include <wx/icon.h>
        #include <wx/sizer.h>
        #include <wx/sizer.h>
        #include <wx/toplevel.h>
            #include <wx/toplevel.h>
        #include <wx/region.h>
        #include <wx/graphics.h>
        #include <wx/event.h>
    #include <wx/setup.h>
    #include "wxpy_api.h"
        #include <wx/event.h>
        #include <wx/cursor.h>
        #include <wx/caret.h>
        #include <wx/layout.h>
        #include <wx/dnd.h>
        #include <wx/access.h>
        #include <wx/accel.h>
        #include <wx/menu.h>
        #include <wx/tooltip.h>
        #include <wx/event.h>
        #include <wx/gdicmn.h>
        #include <wx/event.h>
        #include <wx/event.h>
        #include <wx/palette.h>
        #include <wx/colour.h>
        #include <wx/font.h>
        
        
        #include <wx/eventfilter.h>
        #include <wx/object.h>
        #include <wx/object.h>
        #include <wx/object.h>


class sipwxPGArrayEditorDialog : public ::wxPGArrayEditorDialog
{
public:
    sipwxPGArrayEditorDialog();
    virtual ~sipwxPGArrayEditorDialog();

    /*
     * There is a public method for every protected method visible from
     * this class.
     */
    void sipProtect_SendDestroyEvent();
    bool sipProtectVirt_ProcessEvent(bool, ::wxEvent&);
    void sipProtectVirt_DoEnable(bool, bool);
    void sipProtectVirt_DoGetPosition(bool, int*, int*) const;
    void sipProtectVirt_DoGetSize(bool, int*, int*) const;
    void sipProtectVirt_DoGetClientSize(bool, int*, int*) const;
    ::wxSize sipProtectVirt_DoGetBestSize(bool) const;
    ::wxSize sipProtectVirt_DoGetBestClientSize(bool) const;
    void sipProtectVirt_DoSetSize(bool, int, int, int, int, int);
    void sipProtectVirt_DoSetClientSize(bool, int, int);
    void sipProtectVirt_DoSetSizeHints(bool, int, int, int, int, int, int);
    ::wxSize sipProtectVirt_DoGetBorderSize(bool) const;
    void sipProtectVirt_DoMoveWindow(bool, int, int, int, int);
    void sipProtectVirt_DoSetWindowVariant(bool, ::wxWindowVariant);
    ::wxBorder sipProtectVirt_GetDefaultBorder(bool) const;
    ::wxBorder sipProtectVirt_GetDefaultBorderForControl(bool) const;
    void sipProtectVirt_DoFreeze(bool);
    void sipProtectVirt_DoThaw(bool);
    bool sipProtectVirt_HasTransparentBackground(bool);
    bool sipProtectVirt_TryBefore(bool, ::wxEvent&);
    bool sipProtectVirt_TryAfter(bool, ::wxEvent&);
    ::wxString sipProtect_ArrayGet(size_t);
    size_t sipProtect_ArrayGetCount();
    bool sipProtect_ArrayInsert(const ::wxString&, int);
    bool sipProtect_ArraySet(size_t, const ::wxString&);
    void sipProtect_ArrayRemoveAt(int);
    void sipProtect_ArraySwap(size_t, size_t);
    bool sipProtectVirt_OnCustomNewAction(bool, ::wxString*);

    /*
     * There is a protected method for every virtual method visible from
     * this class.
     */
protected:
    bool OnCustomNewAction(::wxString*) SIP_OVERRIDE;
    void ArraySwap(size_t, size_t) SIP_OVERRIDE;
    void ArrayRemoveAt(int) SIP_OVERRIDE;
    bool ArraySet(size_t, const ::wxString&) SIP_OVERRIDE;
    bool ArrayInsert(const ::wxString&, int) SIP_OVERRIDE;
    size_t ArrayGetCount() SIP_OVERRIDE;
    ::wxString ArrayGet(size_t) SIP_OVERRIDE;
    ::wxValidator* GetTextCtrlValidator() const SIP_OVERRIDE;
    ::wxPGVariant GetDialogValue() const SIP_OVERRIDE;
    void SetDialogValue(const ::wxPGVariant&) SIP_OVERRIDE;
    bool ShouldPreventAppExit() const SIP_OVERRIDE;
    ::wxSize DoGetBestClientSize() const SIP_OVERRIDE;
    ::wxSize DoGetBestSize() const SIP_OVERRIDE;
    void DoThaw() SIP_OVERRIDE;
    void DoFreeze() SIP_OVERRIDE;
    ::wxBorder GetDefaultBorderForControl() const SIP_OVERRIDE;
    ::wxBorder GetDefaultBorder() const SIP_OVERRIDE;
    void DoSetWindowVariant(::wxWindowVariant) SIP_OVERRIDE;
    void DoMoveWindow(int, int, int, int) SIP_OVERRIDE;
    ::wxSize DoGetBorderSize() const SIP_OVERRIDE;
    void DoSetSizeHints(int, int, int, int, int, int) SIP_OVERRIDE;
    void DoSetClientSize(int, int) SIP_OVERRIDE;
    void DoSetSize(int, int, int, int, int) SIP_OVERRIDE;
    void DoGetClientSize(int*, int*) const SIP_OVERRIDE;
    void DoGetSize(int*, int*) const SIP_OVERRIDE;
    void DoGetPosition(int*, int*) const SIP_OVERRIDE;
    void DoEnable(bool) SIP_OVERRIDE;
    ::wxWindow* GetMainWindowOfCompositeControl() SIP_OVERRIDE;
    void OnInternalIdle() SIP_OVERRIDE;
    void InitDialog() SIP_OVERRIDE;
    void InheritAttributes() SIP_OVERRIDE;
    bool Destroy() SIP_OVERRIDE;
    bool Validate() SIP_OVERRIDE;
    bool TransferDataToWindow() SIP_OVERRIDE;
    bool TransferDataFromWindow() SIP_OVERRIDE;
    void SetValidator(const ::wxValidator&) SIP_OVERRIDE;
    ::wxValidator* GetValidator() SIP_OVERRIDE;
    bool ShouldInheritColours() const SIP_OVERRIDE;
    bool HasTransparentBackground() SIP_OVERRIDE;
    ::wxPoint GetClientAreaOrigin() const SIP_OVERRIDE;
    bool InformFirstDirection(int, int, int) SIP_OVERRIDE;
    void EnableVisibleFocus(bool) SIP_OVERRIDE;
    void SetCanFocus(bool) SIP_OVERRIDE;
    bool AcceptsFocusRecursively() const SIP_OVERRIDE;
    bool AcceptsFocusFromKeyboard() const SIP_OVERRIDE;
    bool AcceptsFocus() const SIP_OVERRIDE;
    bool TryAfter(::wxEvent&) SIP_OVERRIDE;
    bool TryBefore(::wxEvent&) SIP_OVERRIDE;
    bool ProcessEvent(::wxEvent&) SIP_OVERRIDE;
    void AddChild(::wxWindowBase*) SIP_OVERRIDE;
    void RemoveChild(::wxWindowBase*) SIP_OVERRIDE;
    ::wxWindow* GetContentWindow() const SIP_OVERRIDE;

public:
    sipSimpleWrapper *sipPySelf;

private:
    sipwxPGArrayEditorDialog(const sipwxPGArrayEditorDialog &);
    sipwxPGArrayEditorDialog &operator = (const sipwxPGArrayEditorDialog &);

    char sipPyMethods[52];
};

sipwxPGArrayEditorDialog::sipwxPGArrayEditorDialog(): ::wxPGArrayEditorDialog(), sipPySelf(SIP_NULLPTR)
{
    memset(sipPyMethods, 0, sizeof (sipPyMethods));
}

sipwxPGArrayEditorDialog::~sipwxPGArrayEditorDialog()
{
    sipInstanceDestroyedEx(&sipPySelf);
}

bool sipwxPGArrayEditorDialog::OnCustomNewAction(::wxString*resString)
{
    sip_gilstate_t sipGILState;
    PyObject *sipMeth;

    sipMeth = sipIsPyMethod(&sipGILState, &sipPyMethods[0], &sipPySelf, SIP_NULLPTR, sipName_OnCustomNewAction);

    if (!sipMeth)
        return ::wxPGArrayEditorDialog::OnCustomNewAction(resString);

    extern bool sipVH__propgrid_84(sip_gilstate_t, sipVirtErrorHandlerFunc, sipSimpleWrapper *, PyObject *, ::wxString*);

    return sipVH__propgrid_84(sipGILState, 0, sipPySelf, sipMeth, resString);
}

void sipwxPGArrayEditorDialog::ArraySwap(size_t first, size_t second)
{
    sip_gilstate_t sipGILState;
    PyObject *sipMeth;

    sipMeth = sipIsPyMethod(&sipGILState, &sipPyMethods[1], &sipPySelf, sipName_PGArrayEditorDialog, sipName_ArraySwap);

    if (!sipMeth)
        return;

    extern void sipVH__propgrid_83(sip_gilstate_t, sipVirtErrorHandlerFunc, sipSimpleWrapper *, PyObject *, size_t, size_t);

    sipVH__propgrid_83(sipGILState, 0, sipPySelf, sipMeth, first, second);
}

void sipwxPGArrayEditorDialog::ArrayRemoveAt(int index)
{
    sip_gilstate_t sipGILState;
    PyObject *sipMeth;

    sipMeth = sipIsPyMethod(&sipGILState, &sipPyMethods[2], &sipPySelf, sipName_PGArrayEditorDialog, sipName_ArrayRemoveAt);

    if (!sipMeth)
        return;

    extern void sipVH__propgrid_82(sip_gilstate_t, sipVirtErrorHandlerFunc, sipSimpleWrapper *, PyObject *, int);

    sipVH__propgrid_82(sipGILState, 0, sipPySelf, sipMeth, index);
}

bool sipwxPGArrayEditorDialog::ArraySet(size_t index, const ::wxString& str)
{
    sip_gilstate_t sipGILState;
    PyObject *sipMeth;

    sipMeth = sipIsPyMethod(&sipGILState, &sipPyMethods[3], &sipPySelf, sipName_PGArrayEditorDialog, sipName_ArraySet);

    if (!sipMeth)
        return 0;

    extern bool sipVH__propgrid_81(sip_gilstate_t, sipVirtErrorHandlerFunc, sipSimpleWrapper *, PyObject *, size_t, const ::wxString&);

    return sipVH__propgrid_81(sipGILState, 0, sipPySelf, sipMeth, index, str);
}

bool sipwxPGArrayEditorDialog::ArrayInsert(const ::wxString& str, int index)
{
    sip_gilstate_t sipGILState;
    PyObject *sipMeth;

    sipMeth = sipIsPyMethod(&sipGILState, &sipPyMethods[4], &sipPySelf, sipName_PGArrayEditorDialog, sipName_ArrayInsert);

    if (!sipMeth)
        return 0;

    extern bool sipVH__propgrid_80(sip_gilstate_t, sipVirtErrorHandlerFunc, sipSimpleWrapper *, PyObject *, const ::wxString&, int);

    return sipVH__propgrid_80(sipGILState, 0, sipPySelf, sipMeth, str, index);
}

size_t sipwxPGArrayEditorDialog::ArrayGetCount()
{
    sip_gilstate_t sipGILState;
    PyObject *sipMeth;

    sipMeth = sipIsPyMethod(&sipGILState, &sipPyMethods[5], &sipPySelf, sipName_PGArrayEditorDialog, sipName_ArrayGetCount);

    if (!sipMeth)
        return 0;

    extern size_t sipVH__propgrid_79(sip_gilstate_t, sipVirtErrorHandlerFunc, sipSimpleWrapper *, PyObject *);

    return sipVH__propgrid_79(sipGILState, 0, sipPySelf, sipMeth);
}

::wxString sipwxPGArrayEditorDialog::ArrayGet(size_t index)
{
    sip_gilstate_t sipGILState;
    PyObject *sipMeth;

    sipMeth = sipIsPyMethod(&sipGILState, &sipPyMethods[6], &sipPySelf, sipName_PGArrayEditorDialog, sipName_ArrayGet);

    if (!sipMeth)
        return ::wxString();

    extern ::wxString sipVH__propgrid_78(sip_gilstate_t, sipVirtErrorHandlerFunc, sipSimpleWrapper *, PyObject *, size_t);

    return sipVH__propgrid_78(sipGILState, 0, sipPySelf, sipMeth, index);
}

::wxValidator* sipwxPGArrayEditorDialog::GetTextCtrlValidator() const
{
    sip_gilstate_t sipGILState;
    PyObject *sipMeth;

    sipMeth = sipIsPyMethod(&sipGILState, const_cast<char *>(&sipPyMethods[7]), const_cast<sipSimpleWrapper **>(&sipPySelf), SIP_NULLPTR, sipName_GetTextCtrlValidator);

    if (!sipMeth)
        return ::wxPGArrayEditorDialog::GetTextCtrlValidator();

    extern ::wxValidator* sipVH__propgrid_13(sip_gilstate_t, sipVirtErrorHandlerFunc, sipSimpleWrapper *, PyObject *);

    return sipVH__propgrid_13(sipGILState, 0, sipPySelf, sipMeth);
}

::wxPGVariant sipwxPGArrayEditorDialog::GetDialogValue() const
{
    sip_gilstate_t sipGILState;
    PyObject *sipMeth;

    sipMeth = sipIsPyMethod(&sipGILState, const_cast<char *>(&sipPyMethods[8]), const_cast<sipSimpleWrapper **>(&sipPySelf), SIP_NULLPTR, sipName_GetDialogValue);

    if (!sipMeth)
        return ::wxPGArrayEditorDialog::GetDialogValue();

    extern ::wxPGVariant sipVH__propgrid_4(sip_gilstate_t, sipVirtErrorHandlerFunc, sipSimpleWrapper *, PyObject *);

    return sipVH__propgrid_4(sipGILState, 0, sipPySelf, sipMeth);
}

void sipwxPGArrayEditorDialog::SetDialogValue(const ::wxPGVariant& value)
{
    sip_gilstate_t sipGILState;
    PyObject *sipMeth;

    sipMeth = sipIsPyMethod(&sipGILState, &sipPyMethods[9], &sipPySelf, SIP_NULLPTR, sipName_SetDialogValue);

    if (!sipMeth)
    {
        ::wxPGArrayEditorDialog::SetDialogValue(value);
        return;
    }

    extern void sipVH__propgrid_77(sip_gilstate_t, sipVirtErrorHandlerFunc, sipSimpleWrapper *, PyObject *, const ::wxPGVariant&);

    sipVH__propgrid_77(sipGILState, 0, sipPySelf, sipMeth, value);
}

bool sipwxPGArrayEditorDialog::ShouldPreventAppExit() const
{
    sip_gilstate_t sipGILState;
    PyObject *sipMeth;

    sipMeth = sipIsPyMethod(&sipGILState, const_cast<char *>(&sipPyMethods[10]), const_cast<sipSimpleWrapper **>(&sipPySelf), SIP_NULLPTR, sipName_ShouldPreventAppExit);

    if (!sipMeth)
        return ::wxPGArrayEditorDialog::ShouldPreventAppExit();

    extern bool sipVH__propgrid_33(sip_gilstate_t, sipVirtErrorHandlerFunc, sipSimpleWrapper *, PyObject *);

    return sipVH__propgrid_33(sipGILState, 0, sipPySelf, sipMeth);
}

::wxSize sipwxPGArrayEditorDialog::DoGetBestClientSize() const
{
    sip_gilstate_t sipGILState;
    PyObject *sipMeth;

    sipMeth = sipIsPyMethod(&sipGILState, const_cast<char *>(&sipPyMethods[11]), const_cast<sipSimpleWrapper **>(&sipPySelf), SIP_NULLPTR, sipName_DoGetBestClientSize);

    if (!sipMeth)
        return ::wxPGArrayEditorDialog::DoGetBestClientSize();

    extern ::wxSize sipVH__propgrid_36(sip_gilstate_t, sipVirtErrorHandlerFunc, sipSimpleWrapper *, PyObject *);

    return sipVH__propgrid_36(sipGILState, 0, sipPySelf, sipMeth);
}

::wxSize sipwxPGArrayEditorDialog::DoGetBestSize() const
{
    sip_gilstate_t sipGILState;
    PyObject *sipMeth;

    sipMeth = sipIsPyMethod(&sipGILState, const_cast<char *>(&sipPyMethods[12]), const_cast<sipSimpleWrapper **>(&sipPySelf), SIP_NULLPTR, sipName_DoGetBestSize);

    if (!sipMeth)
        return ::wxPGArrayEditorDialog::DoGetBestSize();

    extern ::wxSize sipVH__propgrid_36(sip_gilstate_t, sipVirtErrorHandlerFunc, sipSimpleWrapper *, PyObject *);

    return sipVH__propgrid_36(sipGILState, 0, sipPySelf, sipMeth);
}

void sipwxPGArrayEditorDialog::DoThaw()
{
    sip_gilstate_t sipGILState;
    PyObject *sipMeth;

    sipMeth = sipIsPyMethod(&sipGILState, &sipPyMethods[13], &sipPySelf, SIP_NULLPTR, sipName_DoThaw);

    if (!sipMeth)
    {
        ::wxPGArrayEditorDialog::DoThaw();
        return;
    }

    extern void sipVH__propgrid_3(sip_gilstate_t, sipVirtErrorHandlerFunc, sipSimpleWrapper *, PyObject *);

    sipVH__propgrid_3(sipGILState, 0, sipPySelf, sipMeth);
}

void sipwxPGArrayEditorDialog::DoFreeze()
{
    sip_gilstate_t sipGILState;
    PyObject *sipMeth;

    sipMeth = sipIsPyMethod(&sipGILState, &sipPyMethods[14], &sipPySelf, SIP_NULLPTR, sipName_DoFreeze);

    if (!sipMeth)
    {
        ::wxPGArrayEditorDialog::DoFreeze();
        return;
    }

    extern void sipVH__propgrid_3(sip_gilstate_t, sipVirtErrorHandlerFunc, sipSimpleWrapper *, PyObject *);

    sipVH__propgrid_3(sipGILState, 0, sipPySelf, sipMeth);
}

::wxBorder sipwxPGArrayEditorDialog::GetDefaultBorderForControl() const
{
    sip_gilstate_t sipGILState;
    PyObject *sipMeth;

    sipMeth = sipIsPyMethod(&sipGILState, const_cast<char *>(&sipPyMethods[15]), const_cast<sipSimpleWrapper **>(&sipPySelf), SIP_NULLPTR, sipName_GetDefaultBorderForControl);

    if (!sipMeth)
        return ::wxPGArrayEditorDialog::GetDefaultBorderForControl();

    extern ::wxBorder sipVH__propgrid_37(sip_gilstate_t, sipVirtErrorHandlerFunc, sipSimpleWrapper *, PyObject *);

    return sipVH__propgrid_37(sipGILState, 0, sipPySelf, sipMeth);
}

::wxBorder sipwxPGArrayEditorDialog::GetDefaultBorder() const
{
    sip_gilstate_t sipGILState;
    PyObject *sipMeth;

    sipMeth = sipIsPyMethod(&sipGILState, const_cast<char *>(&sipPyMethods[16]), const_cast<sipSimpleWrapper **>(&sipPySelf), SIP_NULLPTR, sipName_GetDefaultBorder);

    if (!sipMeth)
        return ::wxPGArrayEditorDialog::GetDefaultBorder();

    extern ::wxBorder sipVH__propgrid_37(sip_gilstate_t, sipVirtErrorHandlerFunc, sipSimpleWrapper *, PyObject *);

    return sipVH__propgrid_37(sipGILState, 0, sipPySelf, sipMeth);
}

void sipwxPGArrayEditorDialog::DoSetWindowVariant(::wxWindowVariant variant)
{
    sip_gilstate_t sipGILState;
    PyObject *sipMeth;

    sipMeth = sipIsPyMethod(&sipGILState, &sipPyMethods[17], &sipPySelf, SIP_NULLPTR, sipName_DoSetWindowVariant);

    if (!sipMeth)
    {
        ::wxPGArrayEditorDialog::DoSetWindowVariant(variant);
        return;
    }

    extern void sipVH__propgrid_38(sip_gilstate_t, sipVirtErrorHandlerFunc, sipSimpleWrapper *, PyObject *, ::wxWindowVariant);

    sipVH__propgrid_38(sipGILState, 0, sipPySelf, sipMeth, variant);
}

void sipwxPGArrayEditorDialog::DoMoveWindow(int x, int y, int width, int height)
{
    sip_gilstate_t sipGILState;
    PyObject *sipMeth;

    sipMeth = sipIsPyMethod(&sipGILState, &sipPyMethods[18], &sipPySelf, SIP_NULLPTR, sipName_DoMoveWindow);

    if (!sipMeth)
    {
        ::wxPGArrayEditorDialog::DoMoveWindow(x, y, width, height);
        return;
    }

    extern void sipVH__propgrid_39(sip_gilstate_t, sipVirtErrorHandlerFunc, sipSimpleWrapper *, PyObject *, int, int, int, int);

    sipVH__propgrid_39(sipGILState, 0, sipPySelf, sipMeth, x, y, width, height);
}

::wxSize sipwxPGArrayEditorDialog::DoGetBorderSize() const
{
    sip_gilstate_t sipGILState;
    PyObject *sipMeth;

    sipMeth = sipIsPyMethod(&sipGILState, const_cast<char *>(&sipPyMethods[19]), const_cast<sipSimpleWrapper **>(&sipPySelf), SIP_NULLPTR, sipName_DoGetBorderSize);

    if (!sipMeth)
        return ::wxPGArrayEditorDialog::DoGetBorderSize();

    extern ::wxSize sipVH__propgrid_36(sip_gilstate_t, sipVirtErrorHandlerFunc, sipSimpleWrapper *, PyObject *);

    return sipVH__propgrid_36(sipGILState, 0, sipPySelf, sipMeth);
}

void sipwxPGArrayEditorDialog::DoSetSizeHints(int minW, int minH, int maxW, int maxH, int incW, int incH)
{
    sip_gilstate_t sipGILState;
    PyObject *sipMeth;

    sipMeth = sipIsPyMethod(&sipGILState, &sipPyMethods[20], &sipPySelf, SIP_NULLPTR, sipName_DoSetSizeHints);

    if (!sipMeth)
    {
        ::wxPGArrayEditorDialog::DoSetSizeHints(minW, minH, maxW, maxH, incW, incH);
        return;
    }

    extern void sipVH__propgrid_40(sip_gilstate_t, sipVirtErrorHandlerFunc, sipSimpleWrapper *, PyObject *, int, int, int, int, int, int);

    sipVH__propgrid_40(sipGILState, 0, sipPySelf, sipMeth, minW, minH, maxW, maxH, incW, incH);
}

void sipwxPGArrayEditorDialog::DoSetClientSize(int width, int height)
{
    sip_gilstate_t sipGILState;
    PyObject *sipMeth;

    sipMeth = sipIsPyMethod(&sipGILState, &sipPyMethods[21], &sipPySelf, SIP_NULLPTR, sipName_DoSetClientSize);

    if (!sipMeth)
    {
        ::wxPGArrayEditorDialog::DoSetClientSize(width, height);
        return;
    }

    extern void sipVH__propgrid_41(sip_gilstate_t, sipVirtErrorHandlerFunc, sipSimpleWrapper *, PyObject *, int, int);

    sipVH__propgrid_41(sipGILState, 0, sipPySelf, sipMeth, width, height);
}

void sipwxPGArrayEditorDialog::DoSetSize(int x, int y, int width, int height, int sizeFlags)
{
    sip_gilstate_t sipGILState;
    PyObject *sipMeth;

    sipMeth = sipIsPyMethod(&sipGILState, &sipPyMethods[22], &sipPySelf, SIP_NULLPTR, sipName_DoSetSize);

    if (!sipMeth)
    {
        ::wxPGArrayEditorDialog::DoSetSize(x, y, width, height, sizeFlags);
        return;
    }

    extern void sipVH__propgrid_42(sip_gilstate_t, sipVirtErrorHandlerFunc, sipSimpleWrapper *, PyObject *, int, int, int, int, int);

    sipVH__propgrid_42(sipGILState, 0, sipPySelf, sipMeth, x, y, width, height, sizeFlags);
}

void sipwxPGArrayEditorDialog::DoGetClientSize(int*width, int*height) const
{
    sip_gilstate_t sipGILState;
    PyObject *sipMeth;

    sipMeth = sipIsPyMethod(&sipGILState, const_cast<char *>(&sipPyMethods[23]), const_cast<sipSimpleWrapper **>(&sipPySelf), SIP_NULLPTR, sipName_DoGetClientSize);

    if (!sipMeth)
    {
        ::wxPGArrayEditorDialog::DoGetClientSize(width, height);
        return;
    }

    extern void sipVH__propgrid_43(sip_gilstate_t, sipVirtErrorHandlerFunc, sipSimpleWrapper *, PyObject *, int*, int*);

    sipVH__propgrid_43(sipGILState, 0, sipPySelf, sipMeth, width, height);
}

void sipwxPGArrayEditorDialog::DoGetSize(int*width, int*height) const
{
    sip_gilstate_t sipGILState;
    PyObject *sipMeth;

    sipMeth = sipIsPyMethod(&sipGILState, const_cast<char *>(&sipPyMethods[24]), const_cast<sipSimpleWrapper **>(&sipPySelf), SIP_NULLPTR, sipName_DoGetSize);

    if (!sipMeth)
    {
        ::wxPGArrayEditorDialog::DoGetSize(width, height);
        return;
    }

    extern void sipVH__propgrid_43(sip_gilstate_t, sipVirtErrorHandlerFunc, sipSimpleWrapper *, PyObject *, int*, int*);

    sipVH__propgrid_43(sipGILState, 0, sipPySelf, sipMeth, width, height);
}

void sipwxPGArrayEditorDialog::DoGetPosition(int*x, int*y) const
{
    sip_gilstate_t sipGILState;
    PyObject *sipMeth;

    sipMeth = sipIsPyMethod(&sipGILState, const_cast<char *>(&sipPyMethods[25]), const_cast<sipSimpleWrapper **>(&sipPySelf), SIP_NULLPTR, sipName_DoGetPosition);

    if (!sipMeth)
    {
        ::wxPGArrayEditorDialog::DoGetPosition(x, y);
        return;
    }

    extern void sipVH__propgrid_43(sip_gilstate_t, sipVirtErrorHandlerFunc, sipSimpleWrapper *, PyObject *, int*, int*);

    sipVH__propgrid_43(sipGILState, 0, sipPySelf, sipMeth, x, y);
}

void sipwxPGArrayEditorDialog::DoEnable(bool enable)
{
    sip_gilstate_t sipGILState;
    PyObject *sipMeth;

    sipMeth = sipIsPyMethod(&sipGILState, &sipPyMethods[26], &sipPySelf, SIP_NULLPTR, sipName_DoEnable);

    if (!sipMeth)
    {
        ::wxPGArrayEditorDialog::DoEnable(enable);
        return;
    }

    extern void sipVH__propgrid_44(sip_gilstate_t, sipVirtErrorHandlerFunc, sipSimpleWrapper *, PyObject *, bool);

    sipVH__propgrid_44(sipGILState, 0, sipPySelf, sipMeth, enable);
}

::wxWindow* sipwxPGArrayEditorDialog::GetMainWindowOfCompositeControl()
{
    sip_gilstate_t sipGILState;
    PyObject *sipMeth;

    sipMeth = sipIsPyMethod(&sipGILState, &sipPyMethods[27], &sipPySelf, SIP_NULLPTR, sipName_GetMainWindowOfCompositeControl);

    if (!sipMeth)
        return ::wxPGArrayEditorDialog::GetMainWindowOfCompositeControl();

    extern ::wxWindow* sipVH__propgrid_45(sip_gilstate_t, sipVirtErrorHandlerFunc, sipSimpleWrapper *, PyObject *);

    return sipVH__propgrid_45(sipGILState, 0, sipPySelf, sipMeth);
}

void sipwxPGArrayEditorDialog::OnInternalIdle()
{
    sip_gilstate_t sipGILState;
    PyObject *sipMeth;

    sipMeth = sipIsPyMethod(&sipGILState, &sipPyMethods[28], &sipPySelf, SIP_NULLPTR, sipName_OnInternalIdle);

    if (!sipMeth)
    {
        ::wxPGArrayEditorDialog::OnInternalIdle();
        return;
    }

    extern void sipVH__propgrid_3(sip_gilstate_t, sipVirtErrorHandlerFunc, sipSimpleWrapper *, PyObject *);

    sipVH__propgrid_3(sipGILState, 0, sipPySelf, sipMeth);
}

void sipwxPGArrayEditorDialog::InitDialog()
{
    sip_gilstate_t sipGILState;
    PyObject *sipMeth;

    sipMeth = sipIsPyMethod(&sipGILState, &sipPyMethods[29], &sipPySelf, SIP_NULLPTR, sipName_InitDialog);

    if (!sipMeth)
    {
        ::wxPGArrayEditorDialog::InitDialog();
        return;
    }

    extern void sipVH__propgrid_3(sip_gilstate_t, sipVirtErrorHandlerFunc, sipSimpleWrapper *, PyObject *);

    sipVH__propgrid_3(sipGILState, 0, sipPySelf, sipMeth);
}

void sipwxPGArrayEditorDialog::InheritAttributes()
{
    sip_gilstate_t sipGILState;
    PyObject *sipMeth;

    sipMeth = sipIsPyMethod(&sipGILState, &sipPyMethods[30], &sipPySelf, SIP_NULLPTR, sipName_InheritAttributes);

    if (!sipMeth)
    {
        ::wxPGArrayEditorDialog::InheritAttributes();
        return;
    }

    extern void sipVH__propgrid_3(sip_gilstate_t, sipVirtErrorHandlerFunc, sipSimpleWrapper *, PyObject *);

    sipVH__propgrid_3(sipGILState, 0, sipPySelf, sipMeth);
}

bool sipwxPGArrayEditorDialog::Destroy()
{
    sip_gilstate_t sipGILState;
    PyObject *sipMeth;

    sipMeth = sipIsPyMethod(&sipGILState, &sipPyMethods[31], &sipPySelf, SIP_NULLPTR, sipName_Destroy);

    if (!sipMeth)
        return ::wxPGArrayEditorDialog::Destroy();

    extern bool sipVH__propgrid_33(sip_gilstate_t, sipVirtErrorHandlerFunc, sipSimpleWrapper *, PyObject *);

    return sipVH__propgrid_33(sipGILState, 0, sipPySelf, sipMeth);
}

bool sipwxPGArrayEditorDialog::Validate()
{
    sip_gilstate_t sipGILState;
    PyObject *sipMeth;

    sipMeth = sipIsPyMethod(&sipGILState, &sipPyMethods[32], &sipPySelf, SIP_NULLPTR, sipName_Validate);

    if (!sipMeth)
        return ::wxPGArrayEditorDialog::Validate();

    extern bool sipVH__propgrid_33(sip_gilstate_t, sipVirtErrorHandlerFunc, sipSimpleWrapper *, PyObject *);

    return sipVH__propgrid_33(sipGILState, 0, sipPySelf, sipMeth);
}

bool sipwxPGArrayEditorDialog::TransferDataToWindow()
{
    sip_gilstate_t sipGILState;
    PyObject *sipMeth;

    sipMeth = sipIsPyMethod(&sipGILState, &sipPyMethods[33], &sipPySelf, SIP_NULLPTR, sipName_TransferDataToWindow);

    if (!sipMeth)
        return ::wxPGArrayEditorDialog::TransferDataToWindow();

    extern bool sipVH__propgrid_33(sip_gilstate_t, sipVirtErrorHandlerFunc, sipSimpleWrapper *, PyObject *);

    return sipVH__propgrid_33(sipGILState, 0, sipPySelf, sipMeth);
}

bool sipwxPGArrayEditorDialog::TransferDataFromWindow()
{
    sip_gilstate_t sipGILState;
    PyObject *sipMeth;

    sipMeth = sipIsPyMethod(&sipGILState, &sipPyMethods[34], &sipPySelf, SIP_NULLPTR, sipName_TransferDataFromWindow);

    if (!sipMeth)
        return ::wxPGArrayEditorDialog::TransferDataFromWindow();

    extern bool sipVH__propgrid_33(sip_gilstate_t, sipVirtErrorHandlerFunc, sipSimpleWrapper *, PyObject *);

    return sipVH__propgrid_33(sipGILState, 0, sipPySelf, sipMeth);
}

void sipwxPGArrayEditorDialog::SetValidator(const ::wxValidator& validator)
{
    sip_gilstate_t sipGILState;
    PyObject *sipMeth;

    sipMeth = sipIsPyMethod(&sipGILState, &sipPyMethods[35], &sipPySelf, SIP_NULLPTR, sipName_SetValidator);

    if (!sipMeth)
    {
        ::wxPGArrayEditorDialog::SetValidator(validator);
        return;
    }

    extern void sipVH__propgrid_46(sip_gilstate_t, sipVirtErrorHandlerFunc, sipSimpleWrapper *, PyObject *, const ::wxValidator&);

    sipVH__propgrid_46(sipGILState, 0, sipPySelf, sipMeth, validator);
}

::wxValidator* sipwxPGArrayEditorDialog::GetValidator()
{
    sip_gilstate_t sipGILState;
    PyObject *sipMeth;

    sipMeth = sipIsPyMethod(&sipGILState, &sipPyMethods[36], &sipPySelf, SIP_NULLPTR, sipName_GetValidator);

    if (!sipMeth)
        return ::wxPGArrayEditorDialog::GetValidator();

    extern ::wxValidator* sipVH__propgrid_13(sip_gilstate_t, sipVirtErrorHandlerFunc, sipSimpleWrapper *, PyObject *);

    return sipVH__propgrid_13(sipGILState, 0, sipPySelf, sipMeth);
}

bool sipwxPGArrayEditorDialog::ShouldInheritColours() const
{
    sip_gilstate_t sipGILState;
    PyObject *sipMeth;

    sipMeth = sipIsPyMethod(&sipGILState, const_cast<char *>(&sipPyMethods[37]), const_cast<sipSimpleWrapper **>(&sipPySelf), SIP_NULLPTR, sipName_ShouldInheritColours);

    if (!sipMeth)
        return ::wxPGArrayEditorDialog::ShouldInheritColours();

    extern bool sipVH__propgrid_33(sip_gilstate_t, sipVirtErrorHandlerFunc, sipSimpleWrapper *, PyObject *);

    return sipVH__propgrid_33(sipGILState, 0, sipPySelf, sipMeth);
}

bool sipwxPGArrayEditorDialog::HasTransparentBackground()
{
    sip_gilstate_t sipGILState;
    PyObject *sipMeth;

    sipMeth = sipIsPyMethod(&sipGILState, &sipPyMethods[38], &sipPySelf, SIP_NULLPTR, sipName_HasTransparentBackground);

    if (!sipMeth)
        return ::wxPGArrayEditorDialog::HasTransparentBackground();

    extern bool sipVH__propgrid_33(sip_gilstate_t, sipVirtErrorHandlerFunc, sipSimpleWrapper *, PyObject *);

    return sipVH__propgrid_33(sipGILState, 0, sipPySelf, sipMeth);
}

::wxPoint sipwxPGArrayEditorDialog::GetClientAreaOrigin() const
{
    sip_gilstate_t sipGILState;
    PyObject *sipMeth;

    sipMeth = sipIsPyMethod(&sipGILState, const_cast<char *>(&sipPyMethods[39]), const_cast<sipSimpleWrapper **>(&sipPySelf), SIP_NULLPTR, sipName_GetClientAreaOrigin);

    if (!sipMeth)
        return ::wxPGArrayEditorDialog::GetClientAreaOrigin();

    extern ::wxPoint sipVH__propgrid_47(sip_gilstate_t, sipVirtErrorHandlerFunc, sipSimpleWrapper *, PyObject *);

    return sipVH__propgrid_47(sipGILState, 0, sipPySelf, sipMeth);
}

bool sipwxPGArrayEditorDialog::InformFirstDirection(int direction, int size, int availableOtherDir)
{
    sip_gilstate_t sipGILState;
    PyObject *sipMeth;

    sipMeth = sipIsPyMethod(&sipGILState, &sipPyMethods[40], &sipPySelf, SIP_NULLPTR, sipName_InformFirstDirection);

    if (!sipMeth)
        return ::wxPGArrayEditorDialog::InformFirstDirection(direction, size, availableOtherDir);

    extern bool sipVH__propgrid_48(sip_gilstate_t, sipVirtErrorHandlerFunc, sipSimpleWrapper *, PyObject *, int, int, int);

    return sipVH__propgrid_48(sipGILState, 0, sipPySelf, sipMeth, direction, size, availableOtherDir);
}

void sipwxPGArrayEditorDialog::EnableVisibleFocus(bool enabled)
{
    sip_gilstate_t sipGILState;
    PyObject *sipMeth;

    sipMeth = sipIsPyMethod(&sipGILState, &sipPyMethods[41], &sipPySelf, SIP_NULLPTR, sipName_EnableVisibleFocus);

    if (!sipMeth)
    {
        ::wxPGArrayEditorDialog::EnableVisibleFocus(enabled);
        return;
    }

    extern void sipVH__propgrid_44(sip_gilstate_t, sipVirtErrorHandlerFunc, sipSimpleWrapper *, PyObject *, bool);

    sipVH__propgrid_44(sipGILState, 0, sipPySelf, sipMeth, enabled);
}

void sipwxPGArrayEditorDialog::SetCanFocus(bool canFocus)
{
    sip_gilstate_t sipGILState;
    PyObject *sipMeth;

    sipMeth = sipIsPyMethod(&sipGILState, &sipPyMethods[42], &sipPySelf, SIP_NULLPTR, sipName_SetCanFocus);

    if (!sipMeth)
    {
        ::wxPGArrayEditorDialog::SetCanFocus(canFocus);
        return;
    }

    extern void sipVH__propgrid_44(sip_gilstate_t, sipVirtErrorHandlerFunc, sipSimpleWrapper *, PyObject *, bool);

    sipVH__propgrid_44(sipGILState, 0, sipPySelf, sipMeth, canFocus);
}

bool sipwxPGArrayEditorDialog::AcceptsFocusRecursively() const
{
    sip_gilstate_t sipGILState;
    PyObject *sipMeth;

    sipMeth = sipIsPyMethod(&sipGILState, const_cast<char *>(&sipPyMethods[43]), const_cast<sipSimpleWrapper **>(&sipPySelf), SIP_NULLPTR, sipName_AcceptsFocusRecursively);

    if (!sipMeth)
        return ::wxPGArrayEditorDialog::AcceptsFocusRecursively();

    extern bool sipVH__propgrid_33(sip_gilstate_t, sipVirtErrorHandlerFunc, sipSimpleWrapper *, PyObject *);

    return sipVH__propgrid_33(sipGILState, 0, sipPySelf, sipMeth);
}

bool sipwxPGArrayEditorDialog::AcceptsFocusFromKeyboard() const
{
    sip_gilstate_t sipGILState;
    PyObject *sipMeth;

    sipMeth = sipIsPyMethod(&sipGILState, const_cast<char *>(&sipPyMethods[44]), const_cast<sipSimpleWrapper **>(&sipPySelf), SIP_NULLPTR, sipName_AcceptsFocusFromKeyboard);

    if (!sipMeth)
        return ::wxPGArrayEditorDialog::AcceptsFocusFromKeyboard();

    extern bool sipVH__propgrid_33(sip_gilstate_t, sipVirtErrorHandlerFunc, sipSimpleWrapper *, PyObject *);

    return sipVH__propgrid_33(sipGILState, 0, sipPySelf, sipMeth);
}

bool sipwxPGArrayEditorDialog::AcceptsFocus() const
{
    sip_gilstate_t sipGILState;
    PyObject *sipMeth;

    sipMeth = sipIsPyMethod(&sipGILState, const_cast<char *>(&sipPyMethods[45]), const_cast<sipSimpleWrapper **>(&sipPySelf), SIP_NULLPTR, sipName_AcceptsFocus);

    if (!sipMeth)
        return ::wxPGArrayEditorDialog::AcceptsFocus();

    extern bool sipVH__propgrid_33(sip_gilstate_t, sipVirtErrorHandlerFunc, sipSimpleWrapper *, PyObject *);

    return sipVH__propgrid_33(sipGILState, 0, sipPySelf, sipMeth);
}

bool sipwxPGArrayEditorDialog::TryAfter(::wxEvent& event)
{
    sip_gilstate_t sipGILState;
    PyObject *sipMeth;

    sipMeth = sipIsPyMethod(&sipGILState, &sipPyMethods[46], &sipPySelf, SIP_NULLPTR, sipName_TryAfter);

    if (!sipMeth)
        return ::wxPGArrayEditorDialog::TryAfter(event);

    extern bool sipVH__propgrid_49(sip_gilstate_t, sipVirtErrorHandlerFunc, sipSimpleWrapper *, PyObject *, ::wxEvent&);

    return sipVH__propgrid_49(sipGILState, 0, sipPySelf, sipMeth, event);
}

bool sipwxPGArrayEditorDialog::TryBefore(::wxEvent& event)
{
    sip_gilstate_t sipGILState;
    PyObject *sipMeth;

    sipMeth = sipIsPyMethod(&sipGILState, &sipPyMethods[47], &sipPySelf, SIP_NULLPTR, sipName_TryBefore);

    if (!sipMeth)
        return ::wxPGArrayEditorDialog::TryBefore(event);

    extern bool sipVH__propgrid_49(sip_gilstate_t, sipVirtErrorHandlerFunc, sipSimpleWrapper *, PyObject *, ::wxEvent&);

    return sipVH__propgrid_49(sipGILState, 0, sipPySelf, sipMeth, event);
}

bool sipwxPGArrayEditorDialog::ProcessEvent(::wxEvent& event)
{
    sip_gilstate_t sipGILState;
    PyObject *sipMeth;

    sipMeth = sipIsPyMethod(&sipGILState, &sipPyMethods[48], &sipPySelf, SIP_NULLPTR, sipName_ProcessEvent);

    if (!sipMeth)
        return ::wxPGArrayEditorDialog::ProcessEvent(event);

    extern bool sipVH__propgrid_49(sip_gilstate_t, sipVirtErrorHandlerFunc, sipSimpleWrapper *, PyObject *, ::wxEvent&);

    return sipVH__propgrid_49(sipGILState, 0, sipPySelf, sipMeth, event);
}

void sipwxPGArrayEditorDialog::AddChild(::wxWindowBase*child)
{
    sip_gilstate_t sipGILState;
    PyObject *sipMeth;

    sipMeth = sipIsPyMethod(&sipGILState, &sipPyMethods[49], &sipPySelf, SIP_NULLPTR, sipName_AddChild);

    if (!sipMeth)
    {
        ::wxPGArrayEditorDialog::AddChild(child);
        return;
    }

    extern void sipVH__propgrid_50(sip_gilstate_t, sipVirtErrorHandlerFunc, sipSimpleWrapper *, PyObject *, ::wxWindowBase*);

    sipVH__propgrid_50(sipGILState, 0, sipPySelf, sipMeth, child);
}

void sipwxPGArrayEditorDialog::RemoveChild(::wxWindowBase*child)
{
    sip_gilstate_t sipGILState;
    PyObject *sipMeth;

    sipMeth = sipIsPyMethod(&sipGILState, &sipPyMethods[50], &sipPySelf, SIP_NULLPTR, sipName_RemoveChild);

    if (!sipMeth)
    {
        ::wxPGArrayEditorDialog::RemoveChild(child);
        return;
    }

    extern void sipVH__propgrid_50(sip_gilstate_t, sipVirtErrorHandlerFunc, sipSimpleWrapper *, PyObject *, ::wxWindowBase*);

    sipVH__propgrid_50(sipGILState, 0, sipPySelf, sipMeth, child);
}

::wxWindow* sipwxPGArrayEditorDialog::GetContentWindow() const
{
    sip_gilstate_t sipGILState;
    PyObject *sipMeth;

    sipMeth = sipIsPyMethod(&sipGILState, const_cast<char *>(&sipPyMethods[51]), const_cast<sipSimpleWrapper **>(&sipPySelf), SIP_NULLPTR, sipName_GetContentWindow);

    if (!sipMeth)
        return ::wxPGArrayEditorDialog::GetContentWindow();

    extern ::wxWindow* sipVH__propgrid_45(sip_gilstate_t, sipVirtErrorHandlerFunc, sipSimpleWrapper *, PyObject *);

    return sipVH__propgrid_45(sipGILState, 0, sipPySelf, sipMeth);
}

void sipwxPGArrayEditorDialog::sipProtect_SendDestroyEvent()
{
    ::wxWindow::SendDestroyEvent();
}

bool sipwxPGArrayEditorDialog::sipProtectVirt_ProcessEvent(bool sipSelfWasArg, ::wxEvent& event)
{
    return (sipSelfWasArg ? ::wxDialog::ProcessEvent(event) : ProcessEvent(event));
}

void sipwxPGArrayEditorDialog::sipProtectVirt_DoEnable(bool sipSelfWasArg, bool enable)
{
    (sipSelfWasArg ? ::wxDialog::DoEnable(enable) : DoEnable(enable));
}

void sipwxPGArrayEditorDialog::sipProtectVirt_DoGetPosition(bool sipSelfWasArg, int*x, int*y) const
{
    (sipSelfWasArg ? ::wxDialog::DoGetPosition(x, y) : DoGetPosition(x, y));
}

void sipwxPGArrayEditorDialog::sipProtectVirt_DoGetSize(bool sipSelfWasArg, int*width, int*height) const
{
    (sipSelfWasArg ? ::wxDialog::DoGetSize(width, height) : DoGetSize(width, height));
}

void sipwxPGArrayEditorDialog::sipProtectVirt_DoGetClientSize(bool sipSelfWasArg, int*width, int*height) const
{
    (sipSelfWasArg ? ::wxDialog::DoGetClientSize(width, height) : DoGetClientSize(width, height));
}

::wxSize sipwxPGArrayEditorDialog::sipProtectVirt_DoGetBestSize(bool sipSelfWasArg) const
{
    return (sipSelfWasArg ? ::wxDialog::DoGetBestSize() : DoGetBestSize());
}

::wxSize sipwxPGArrayEditorDialog::sipProtectVirt_DoGetBestClientSize(bool sipSelfWasArg) const
{
    return (sipSelfWasArg ? ::wxDialog::DoGetBestClientSize() : DoGetBestClientSize());
}

void sipwxPGArrayEditorDialog::sipProtectVirt_DoSetSize(bool sipSelfWasArg, int x, int y, int width, int height, int sizeFlags)
{
    (sipSelfWasArg ? ::wxDialog::DoSetSize(x, y, width, height, sizeFlags) : DoSetSize(x, y, width, height, sizeFlags));
}

void sipwxPGArrayEditorDialog::sipProtectVirt_DoSetClientSize(bool sipSelfWasArg, int width, int height)
{
    (sipSelfWasArg ? ::wxDialog::DoSetClientSize(width, height) : DoSetClientSize(width, height));
}

void sipwxPGArrayEditorDialog::sipProtectVirt_DoSetSizeHints(bool sipSelfWasArg, int minW, int minH, int maxW, int maxH, int incW, int incH)
{
    (sipSelfWasArg ? ::wxDialog::DoSetSizeHints(minW, minH, maxW, maxH, incW, incH) : DoSetSizeHints(minW, minH, maxW, maxH, incW, incH));
}

::wxSize sipwxPGArrayEditorDialog::sipProtectVirt_DoGetBorderSize(bool sipSelfWasArg) const
{
    return (sipSelfWasArg ? ::wxDialog::DoGetBorderSize() : DoGetBorderSize());
}

void sipwxPGArrayEditorDialog::sipProtectVirt_DoMoveWindow(bool sipSelfWasArg, int x, int y, int width, int height)
{
    (sipSelfWasArg ? ::wxDialog::DoMoveWindow(x, y, width, height) : DoMoveWindow(x, y, width, height));
}

void sipwxPGArrayEditorDialog::sipProtectVirt_DoSetWindowVariant(bool sipSelfWasArg, ::wxWindowVariant variant)
{
    (sipSelfWasArg ? ::wxDialog::DoSetWindowVariant(variant) : DoSetWindowVariant(variant));
}

::wxBorder sipwxPGArrayEditorDialog::sipProtectVirt_GetDefaultBorder(bool sipSelfWasArg) const
{
    return (sipSelfWasArg ? ::wxDialog::GetDefaultBorder() : GetDefaultBorder());
}

::wxBorder sipwxPGArrayEditorDialog::sipProtectVirt_GetDefaultBorderForControl(bool sipSelfWasArg) const
{
    return (sipSelfWasArg ? ::wxDialog::GetDefaultBorderForControl() : GetDefaultBorderForControl());
}

void sipwxPGArrayEditorDialog::sipProtectVirt_DoFreeze(bool sipSelfWasArg)
{
    (sipSelfWasArg ? ::wxDialog::DoFreeze() : DoFreeze());
}

void sipwxPGArrayEditorDialog::sipProtectVirt_DoThaw(bool sipSelfWasArg)
{
    (sipSelfWasArg ? ::wxDialog::DoThaw() : DoThaw());
}

bool sipwxPGArrayEditorDialog::sipProtectVirt_HasTransparentBackground(bool sipSelfWasArg)
{
    return (sipSelfWasArg ? ::wxDialog::HasTransparentBackground() : HasTransparentBackground());
}

bool sipwxPGArrayEditorDialog::sipProtectVirt_TryBefore(bool sipSelfWasArg, ::wxEvent& event)
{
    return (sipSelfWasArg ? ::wxDialog::TryBefore(event) : TryBefore(event));
}

bool sipwxPGArrayEditorDialog::sipProtectVirt_TryAfter(bool sipSelfWasArg, ::wxEvent& event)
{
    return (sipSelfWasArg ? ::wxDialog::TryAfter(event) : TryAfter(event));
}

::wxString sipwxPGArrayEditorDialog::sipProtect_ArrayGet(size_t index)
{
    return ArrayGet(index);
}

size_t sipwxPGArrayEditorDialog::sipProtect_ArrayGetCount()
{
    return ArrayGetCount();
}

bool sipwxPGArrayEditorDialog::sipProtect_ArrayInsert(const ::wxString& str, int index)
{
    return ArrayInsert(str, index);
}

bool sipwxPGArrayEditorDialog::sipProtect_ArraySet(size_t index, const ::wxString& str)
{
    return ArraySet(index, str);
}

void sipwxPGArrayEditorDialog::sipProtect_ArrayRemoveAt(int index)
{
    ArrayRemoveAt(index);
}

void sipwxPGArrayEditorDialog::sipProtect_ArraySwap(size_t first, size_t second)
{
    ArraySwap(first, second);
}

bool sipwxPGArrayEditorDialog::sipProtectVirt_OnCustomNewAction(bool sipSelfWasArg, ::wxString*resString)
{
    return (sipSelfWasArg ? ::wxPGArrayEditorDialog::OnCustomNewAction(resString) : OnCustomNewAction(resString));
}


PyDoc_STRVAR(doc_wxPGArrayEditorDialog_SendDestroyEvent, "SendDestroyEvent()\n"
"\n"
"Generate wxWindowDestroyEvent for this window.");

extern "C" {static PyObject *meth_wxPGArrayEditorDialog_SendDestroyEvent(PyObject *, PyObject *);}
static PyObject *meth_wxPGArrayEditorDialog_SendDestroyEvent(PyObject *sipSelf, PyObject *sipArgs)
{
    PyObject *sipParseErr = SIP_NULLPTR;

    {
        sipwxPGArrayEditorDialog *sipCpp;

        if (sipParseArgs(&sipParseErr, sipArgs, "B", &sipSelf, sipType_wxPGArrayEditorDialog, &sipCpp))
        {
            PyErr_Clear();

            Py_BEGIN_ALLOW_THREADS
            sipCpp->sipProtect_SendDestroyEvent();
            Py_END_ALLOW_THREADS

            if (PyErr_Occurred())
                return 0;

            Py_INCREF(Py_None);
            return Py_None;
        }
    }

    sipNoMethod(sipParseErr, sipName_PGArrayEditorDialog, sipName_SendDestroyEvent, SIP_NULLPTR);

    return SIP_NULLPTR;
}


PyDoc_STRVAR(doc_wxPGArrayEditorDialog_ProcessEvent, "ProcessEvent(self, event: Event) -> bool");

extern "C" {static PyObject *meth_wxPGArrayEditorDialog_ProcessEvent(PyObject *, PyObject *, PyObject *);}
static PyObject *meth_wxPGArrayEditorDialog_ProcessEvent(PyObject *sipSelf, PyObject *sipArgs, PyObject *sipKwds)
{
    PyObject *sipParseErr = SIP_NULLPTR;
    bool sipSelfWasArg = (!sipSelf || sipIsDerivedClass((sipSimpleWrapper *)sipSelf));

    {
        ::wxEvent* event;
        sipwxPGArrayEditorDialog *sipCpp;

        static const char *sipKwdList[] = {
            sipName_event,
        };

        if (sipParseKwdArgs(&sipParseErr, sipArgs, sipKwds, sipKwdList, SIP_NULLPTR, "BJ9", &sipSelf, sipType_wxPGArrayEditorDialog, &sipCpp, sipType_wxEvent, &event))
        {
            bool sipRes;

            PyErr_Clear();

            Py_BEGIN_ALLOW_THREADS
            sipRes = sipCpp->sipProtectVirt_ProcessEvent(sipSelfWasArg, *event);
            Py_END_ALLOW_THREADS

            if (PyErr_Occurred())
                return 0;

            return PyBool_FromLong(sipRes);
        }
    }

    sipNoMethod(sipParseErr, sipName_PGArrayEditorDialog, sipName_ProcessEvent, doc_wxPGArrayEditorDialog_ProcessEvent);

    return SIP_NULLPTR;
}


PyDoc_STRVAR(doc_wxPGArrayEditorDialog_DoEnable, "DoEnable(self, enable: bool)");

extern "C" {static PyObject *meth_wxPGArrayEditorDialog_DoEnable(PyObject *, PyObject *, PyObject *);}
static PyObject *meth_wxPGArrayEditorDialog_DoEnable(PyObject *sipSelf, PyObject *sipArgs, PyObject *sipKwds)
{
    PyObject *sipParseErr = SIP_NULLPTR;
    bool sipSelfWasArg = (!sipSelf || sipIsDerivedClass((sipSimpleWrapper *)sipSelf));

    {
        bool enable;
        sipwxPGArrayEditorDialog *sipCpp;

        static const char *sipKwdList[] = {
            sipName_enable,
        };

        if (sipParseKwdArgs(&sipParseErr, sipArgs, sipKwds, sipKwdList, SIP_NULLPTR, "Bb", &sipSelf, sipType_wxPGArrayEditorDialog, &sipCpp, &enable))
        {
            PyErr_Clear();

            Py_BEGIN_ALLOW_THREADS
            sipCpp->sipProtectVirt_DoEnable(sipSelfWasArg, enable);
            Py_END_ALLOW_THREADS

            if (PyErr_Occurred())
                return 0;

            Py_INCREF(Py_None);
            return Py_None;
        }
    }

    sipNoMethod(sipParseErr, sipName_PGArrayEditorDialog, sipName_DoEnable, doc_wxPGArrayEditorDialog_DoEnable);

    return SIP_NULLPTR;
}


PyDoc_STRVAR(doc_wxPGArrayEditorDialog_DoGetPosition, "DoGetPosition(self) -> (int, int)");

extern "C" {static PyObject *meth_wxPGArrayEditorDialog_DoGetPosition(PyObject *, PyObject *, PyObject *);}
static PyObject *meth_wxPGArrayEditorDialog_DoGetPosition(PyObject *sipSelf, PyObject *sipArgs, PyObject *sipKwds)
{
    PyObject *sipParseErr = SIP_NULLPTR;
    bool sipSelfWasArg = (!sipSelf || sipIsDerivedClass((sipSimpleWrapper *)sipSelf));

    {
        int x;
        int y;
        const sipwxPGArrayEditorDialog *sipCpp;

        if (sipParseKwdArgs(&sipParseErr, sipArgs, sipKwds, SIP_NULLPTR, SIP_NULLPTR, "B", &sipSelf, sipType_wxPGArrayEditorDialog, &sipCpp))
        {
            PyErr_Clear();

            Py_BEGIN_ALLOW_THREADS
            sipCpp->sipProtectVirt_DoGetPosition(sipSelfWasArg, &x, &y);
            Py_END_ALLOW_THREADS

            if (PyErr_Occurred())
                return 0;

            return sipBuildResult(0, "(ii)", x, y);
        }
    }

    sipNoMethod(sipParseErr, sipName_PGArrayEditorDialog, sipName_DoGetPosition, doc_wxPGArrayEditorDialog_DoGetPosition);

    return SIP_NULLPTR;
}


PyDoc_STRVAR(doc_wxPGArrayEditorDialog_DoGetSize, "DoGetSize(self) -> (int, int)");

extern "C" {static PyObject *meth_wxPGArrayEditorDialog_DoGetSize(PyObject *, PyObject *, PyObject *);}
static PyObject *meth_wxPGArrayEditorDialog_DoGetSize(PyObject *sipSelf, PyObject *sipArgs, PyObject *sipKwds)
{
    PyObject *sipParseErr = SIP_NULLPTR;
    bool sipSelfWasArg = (!sipSelf || sipIsDerivedClass((sipSimpleWrapper *)sipSelf));

    {
        int width;
        int height;
        const sipwxPGArrayEditorDialog *sipCpp;

        if (sipParseKwdArgs(&sipParseErr, sipArgs, sipKwds, SIP_NULLPTR, SIP_NULLPTR, "B", &sipSelf, sipType_wxPGArrayEditorDialog, &sipCpp))
        {
            PyErr_Clear();

            Py_BEGIN_ALLOW_THREADS
            sipCpp->sipProtectVirt_DoGetSize(sipSelfWasArg, &width, &height);
            Py_END_ALLOW_THREADS

            if (PyErr_Occurred())
                return 0;

            return sipBuildResult(0, "(ii)", width, height);
        }
    }

    sipNoMethod(sipParseErr, sipName_PGArrayEditorDialog, sipName_DoGetSize, doc_wxPGArrayEditorDialog_DoGetSize);

    return SIP_NULLPTR;
}


PyDoc_STRVAR(doc_wxPGArrayEditorDialog_DoGetClientSize, "DoGetClientSize(self) -> (int, int)");

extern "C" {static PyObject *meth_wxPGArrayEditorDialog_DoGetClientSize(PyObject *, PyObject *, PyObject *);}
static PyObject *meth_wxPGArrayEditorDialog_DoGetClientSize(PyObject *sipSelf, PyObject *sipArgs, PyObject *sipKwds)
{
    PyObject *sipParseErr = SIP_NULLPTR;
    bool sipSelfWasArg = (!sipSelf || sipIsDerivedClass((sipSimpleWrapper *)sipSelf));

    {
        int width;
        int height;
        const sipwxPGArrayEditorDialog *sipCpp;

        if (sipParseKwdArgs(&sipParseErr, sipArgs, sipKwds, SIP_NULLPTR, SIP_NULLPTR, "B", &sipSelf, sipType_wxPGArrayEditorDialog, &sipCpp))
        {
            PyErr_Clear();

            Py_BEGIN_ALLOW_THREADS
            sipCpp->sipProtectVirt_DoGetClientSize(sipSelfWasArg, &width, &height);
            Py_END_ALLOW_THREADS

            if (PyErr_Occurred())
                return 0;

            return sipBuildResult(0, "(ii)", width, height);
        }
    }

    sipNoMethod(sipParseErr, sipName_PGArrayEditorDialog, sipName_DoGetClientSize, doc_wxPGArrayEditorDialog_DoGetClientSize);

    return SIP_NULLPTR;
}


PyDoc_STRVAR(doc_wxPGArrayEditorDialog_DoGetBestSize, "DoGetBestSize(self) -> Size");

extern "C" {static PyObject *meth_wxPGArrayEditorDialog_DoGetBestSize(PyObject *, PyObject *);}
static PyObject *meth_wxPGArrayEditorDialog_DoGetBestSize(PyObject *sipSelf, PyObject *sipArgs)
{
    PyObject *sipParseErr = SIP_NULLPTR;
    bool sipSelfWasArg = (!sipSelf || sipIsDerivedClass((sipSimpleWrapper *)sipSelf));

    {
        const sipwxPGArrayEditorDialog *sipCpp;

        if (sipParseArgs(&sipParseErr, sipArgs, "B", &sipSelf, sipType_wxPGArrayEditorDialog, &sipCpp))
        {
            ::wxSize*sipRes;

            PyErr_Clear();

            Py_BEGIN_ALLOW_THREADS
            sipRes = new ::wxSize(sipCpp->sipProtectVirt_DoGetBestSize(sipSelfWasArg));
            Py_END_ALLOW_THREADS

            if (PyErr_Occurred())
                return 0;

            return sipConvertFromNewType(sipRes, sipType_wxSize, SIP_NULLPTR);
        }
    }

    sipNoMethod(sipParseErr, sipName_PGArrayEditorDialog, sipName_DoGetBestSize, doc_wxPGArrayEditorDialog_DoGetBestSize);

    return SIP_NULLPTR;
}


PyDoc_STRVAR(doc_wxPGArrayEditorDialog_DoGetBestClientSize, "DoGetBestClientSize(self) -> Size");

extern "C" {static PyObject *meth_wxPGArrayEditorDialog_DoGetBestClientSize(PyObject *, PyObject *);}
static PyObject *meth_wxPGArrayEditorDialog_DoGetBestClientSize(PyObject *sipSelf, PyObject *sipArgs)
{
    PyObject *sipParseErr = SIP_NULLPTR;
    bool sipSelfWasArg = (!sipSelf || sipIsDerivedClass((sipSimpleWrapper *)sipSelf));

    {
        const sipwxPGArrayEditorDialog *sipCpp;

        if (sipParseArgs(&sipParseErr, sipArgs, "B", &sipSelf, sipType_wxPGArrayEditorDialog, &sipCpp))
        {
            ::wxSize*sipRes;

            PyErr_Clear();

            Py_BEGIN_ALLOW_THREADS
            sipRes = new ::wxSize(sipCpp->sipProtectVirt_DoGetBestClientSize(sipSelfWasArg));
            Py_END_ALLOW_THREADS

            if (PyErr_Occurred())
                return 0;

            return sipConvertFromNewType(sipRes, sipType_wxSize, SIP_NULLPTR);
        }
    }

    sipNoMethod(sipParseErr, sipName_PGArrayEditorDialog, sipName_DoGetBestClientSize, doc_wxPGArrayEditorDialog_DoGetBestClientSize);

    return SIP_NULLPTR;
}


PyDoc_STRVAR(doc_wxPGArrayEditorDialog_DoSetSize, "DoSetSize(self, x: int, y: int, width: int, height: int, sizeFlags: int)");

extern "C" {static PyObject *meth_wxPGArrayEditorDialog_DoSetSize(PyObject *, PyObject *, PyObject *);}
static PyObject *meth_wxPGArrayEditorDialog_DoSetSize(PyObject *sipSelf, PyObject *sipArgs, PyObject *sipKwds)
{
    PyObject *sipParseErr = SIP_NULLPTR;
    bool sipSelfWasArg = (!sipSelf || sipIsDerivedClass((sipSimpleWrapper *)sipSelf));

    {
        int x;
        int y;
        int width;
        int height;
        int sizeFlags;
        sipwxPGArrayEditorDialog *sipCpp;

        static const char *sipKwdList[] = {
            sipName_x,
            sipName_y,
            sipName_width,
            sipName_height,
            sipName_sizeFlags,
        };

        if (sipParseKwdArgs(&sipParseErr, sipArgs, sipKwds, sipKwdList, SIP_NULLPTR, "Biiiii", &sipSelf, sipType_wxPGArrayEditorDialog, &sipCpp, &x, &y, &width, &height, &sizeFlags))
        {
            PyErr_Clear();

            Py_BEGIN_ALLOW_THREADS
            sipCpp->sipProtectVirt_DoSetSize(sipSelfWasArg, x, y, width, height, sizeFlags);
            Py_END_ALLOW_THREADS

            if (PyErr_Occurred())
                return 0;

            Py_INCREF(Py_None);
            return Py_None;
        }
    }

    sipNoMethod(sipParseErr, sipName_PGArrayEditorDialog, sipName_DoSetSize, doc_wxPGArrayEditorDialog_DoSetSize);

    return SIP_NULLPTR;
}


PyDoc_STRVAR(doc_wxPGArrayEditorDialog_DoSetClientSize, "DoSetClientSize(self, width: int, height: int)");

extern "C" {static PyObject *meth_wxPGArrayEditorDialog_DoSetClientSize(PyObject *, PyObject *, PyObject *);}
static PyObject *meth_wxPGArrayEditorDialog_DoSetClientSize(PyObject *sipSelf, PyObject *sipArgs, PyObject *sipKwds)
{
    PyObject *sipParseErr = SIP_NULLPTR;
    bool sipSelfWasArg = (!sipSelf || sipIsDerivedClass((sipSimpleWrapper *)sipSelf));

    {
        int width;
        int height;
        sipwxPGArrayEditorDialog *sipCpp;

        static const char *sipKwdList[] = {
            sipName_width,
            sipName_height,
        };

        if (sipParseKwdArgs(&sipParseErr, sipArgs, sipKwds, sipKwdList, SIP_NULLPTR, "Bii", &sipSelf, sipType_wxPGArrayEditorDialog, &sipCpp, &width, &height))
        {
            PyErr_Clear();

            Py_BEGIN_ALLOW_THREADS
            sipCpp->sipProtectVirt_DoSetClientSize(sipSelfWasArg, width, height);
            Py_END_ALLOW_THREADS

            if (PyErr_Occurred())
                return 0;

            Py_INCREF(Py_None);
            return Py_None;
        }
    }

    sipNoMethod(sipParseErr, sipName_PGArrayEditorDialog, sipName_DoSetClientSize, doc_wxPGArrayEditorDialog_DoSetClientSize);

    return SIP_NULLPTR;
}


PyDoc_STRVAR(doc_wxPGArrayEditorDialog_DoSetSizeHints, "DoSetSizeHints(self, minW: int, minH: int, maxW: int, maxH: int, incW: int, incH: int)");

extern "C" {static PyObject *meth_wxPGArrayEditorDialog_DoSetSizeHints(PyObject *, PyObject *, PyObject *);}
static PyObject *meth_wxPGArrayEditorDialog_DoSetSizeHints(PyObject *sipSelf, PyObject *sipArgs, PyObject *sipKwds)
{
    PyObject *sipParseErr = SIP_NULLPTR;
    bool sipSelfWasArg = (!sipSelf || sipIsDerivedClass((sipSimpleWrapper *)sipSelf));

    {
        int minW;
        int minH;
        int maxW;
        int maxH;
        int incW;
        int incH;
        sipwxPGArrayEditorDialog *sipCpp;

        static const char *sipKwdList[] = {
            sipName_minW,
            sipName_minH,
            sipName_maxW,
            sipName_maxH,
            sipName_incW,
            sipName_incH,
        };

        if (sipParseKwdArgs(&sipParseErr, sipArgs, sipKwds, sipKwdList, SIP_NULLPTR, "Biiiiii", &sipSelf, sipType_wxPGArrayEditorDialog, &sipCpp, &minW, &minH, &maxW, &maxH, &incW, &incH))
        {
            PyErr_Clear();

            Py_BEGIN_ALLOW_THREADS
            sipCpp->sipProtectVirt_DoSetSizeHints(sipSelfWasArg, minW, minH, maxW, maxH, incW, incH);
            Py_END_ALLOW_THREADS

            if (PyErr_Occurred())
                return 0;

            Py_INCREF(Py_None);
            return Py_None;
        }
    }

    sipNoMethod(sipParseErr, sipName_PGArrayEditorDialog, sipName_DoSetSizeHints, doc_wxPGArrayEditorDialog_DoSetSizeHints);

    return SIP_NULLPTR;
}


PyDoc_STRVAR(doc_wxPGArrayEditorDialog_DoGetBorderSize, "DoGetBorderSize(self) -> Size");

extern "C" {static PyObject *meth_wxPGArrayEditorDialog_DoGetBorderSize(PyObject *, PyObject *);}
static PyObject *meth_wxPGArrayEditorDialog_DoGetBorderSize(PyObject *sipSelf, PyObject *sipArgs)
{
    PyObject *sipParseErr = SIP_NULLPTR;
    bool sipSelfWasArg = (!sipSelf || sipIsDerivedClass((sipSimpleWrapper *)sipSelf));

    {
        const sipwxPGArrayEditorDialog *sipCpp;

        if (sipParseArgs(&sipParseErr, sipArgs, "B", &sipSelf, sipType_wxPGArrayEditorDialog, &sipCpp))
        {
            ::wxSize*sipRes;

            PyErr_Clear();

            Py_BEGIN_ALLOW_THREADS
            sipRes = new ::wxSize(sipCpp->sipProtectVirt_DoGetBorderSize(sipSelfWasArg));
            Py_END_ALLOW_THREADS

            if (PyErr_Occurred())
                return 0;

            return sipConvertFromNewType(sipRes, sipType_wxSize, SIP_NULLPTR);
        }
    }

    sipNoMethod(sipParseErr, sipName_PGArrayEditorDialog, sipName_DoGetBorderSize, doc_wxPGArrayEditorDialog_DoGetBorderSize);

    return SIP_NULLPTR;
}


PyDoc_STRVAR(doc_wxPGArrayEditorDialog_DoMoveWindow, "DoMoveWindow(self, x: int, y: int, width: int, height: int)");

extern "C" {static PyObject *meth_wxPGArrayEditorDialog_DoMoveWindow(PyObject *, PyObject *, PyObject *);}
static PyObject *meth_wxPGArrayEditorDialog_DoMoveWindow(PyObject *sipSelf, PyObject *sipArgs, PyObject *sipKwds)
{
    PyObject *sipParseErr = SIP_NULLPTR;
    bool sipSelfWasArg = (!sipSelf || sipIsDerivedClass((sipSimpleWrapper *)sipSelf));

    {
        int x;
        int y;
        int width;
        int height;
        sipwxPGArrayEditorDialog *sipCpp;

        static const char *sipKwdList[] = {
            sipName_x,
            sipName_y,
            sipName_width,
            sipName_height,
        };

        if (sipParseKwdArgs(&sipParseErr, sipArgs, sipKwds, sipKwdList, SIP_NULLPTR, "Biiii", &sipSelf, sipType_wxPGArrayEditorDialog, &sipCpp, &x, &y, &width, &height))
        {
            PyErr_Clear();

            Py_BEGIN_ALLOW_THREADS
            sipCpp->sipProtectVirt_DoMoveWindow(sipSelfWasArg, x, y, width, height);
            Py_END_ALLOW_THREADS

            if (PyErr_Occurred())
                return 0;

            Py_INCREF(Py_None);
            return Py_None;
        }
    }

    sipNoMethod(sipParseErr, sipName_PGArrayEditorDialog, sipName_DoMoveWindow, doc_wxPGArrayEditorDialog_DoMoveWindow);

    return SIP_NULLPTR;
}


PyDoc_STRVAR(doc_wxPGArrayEditorDialog_DoSetWindowVariant, "DoSetWindowVariant(self, variant: WindowVariant)");

extern "C" {static PyObject *meth_wxPGArrayEditorDialog_DoSetWindowVariant(PyObject *, PyObject *, PyObject *);}
static PyObject *meth_wxPGArrayEditorDialog_DoSetWindowVariant(PyObject *sipSelf, PyObject *sipArgs, PyObject *sipKwds)
{
    PyObject *sipParseErr = SIP_NULLPTR;
    bool sipSelfWasArg = (!sipSelf || sipIsDerivedClass((sipSimpleWrapper *)sipSelf));

    {
        ::wxWindowVariant variant;
        sipwxPGArrayEditorDialog *sipCpp;

        static const char *sipKwdList[] = {
            sipName_variant,
        };

        if (sipParseKwdArgs(&sipParseErr, sipArgs, sipKwds, sipKwdList, SIP_NULLPTR, "BE", &sipSelf, sipType_wxPGArrayEditorDialog, &sipCpp, sipType_wxWindowVariant, &variant))
        {
            PyErr_Clear();

            Py_BEGIN_ALLOW_THREADS
            sipCpp->sipProtectVirt_DoSetWindowVariant(sipSelfWasArg, variant);
            Py_END_ALLOW_THREADS

            if (PyErr_Occurred())
                return 0;

            Py_INCREF(Py_None);
            return Py_None;
        }
    }

    sipNoMethod(sipParseErr, sipName_PGArrayEditorDialog, sipName_DoSetWindowVariant, doc_wxPGArrayEditorDialog_DoSetWindowVariant);

    return SIP_NULLPTR;
}


PyDoc_STRVAR(doc_wxPGArrayEditorDialog_GetDefaultBorder, "GetDefaultBorder(self) -> Border");

extern "C" {static PyObject *meth_wxPGArrayEditorDialog_GetDefaultBorder(PyObject *, PyObject *);}
static PyObject *meth_wxPGArrayEditorDialog_GetDefaultBorder(PyObject *sipSelf, PyObject *sipArgs)
{
    PyObject *sipParseErr = SIP_NULLPTR;
    bool sipSelfWasArg = (!sipSelf || sipIsDerivedClass((sipSimpleWrapper *)sipSelf));

    {
        const sipwxPGArrayEditorDialog *sipCpp;

        if (sipParseArgs(&sipParseErr, sipArgs, "B", &sipSelf, sipType_wxPGArrayEditorDialog, &sipCpp))
        {
            ::wxBorder sipRes;

            PyErr_Clear();

            Py_BEGIN_ALLOW_THREADS
            sipRes = sipCpp->sipProtectVirt_GetDefaultBorder(sipSelfWasArg);
            Py_END_ALLOW_THREADS

            if (PyErr_Occurred())
                return 0;

            return sipConvertFromEnum(static_cast<int>(sipRes), sipType_wxBorder);
        }
    }

    sipNoMethod(sipParseErr, sipName_PGArrayEditorDialog, sipName_GetDefaultBorder, doc_wxPGArrayEditorDialog_GetDefaultBorder);

    return SIP_NULLPTR;
}


PyDoc_STRVAR(doc_wxPGArrayEditorDialog_GetDefaultBorderForControl, "GetDefaultBorderForControl(self) -> Border");

extern "C" {static PyObject *meth_wxPGArrayEditorDialog_GetDefaultBorderForControl(PyObject *, PyObject *);}
static PyObject *meth_wxPGArrayEditorDialog_GetDefaultBorderForControl(PyObject *sipSelf, PyObject *sipArgs)
{
    PyObject *sipParseErr = SIP_NULLPTR;
    bool sipSelfWasArg = (!sipSelf || sipIsDerivedClass((sipSimpleWrapper *)sipSelf));

    {
        const sipwxPGArrayEditorDialog *sipCpp;

        if (sipParseArgs(&sipParseErr, sipArgs, "B", &sipSelf, sipType_wxPGArrayEditorDialog, &sipCpp))
        {
            ::wxBorder sipRes;

            PyErr_Clear();

            Py_BEGIN_ALLOW_THREADS
            sipRes = sipCpp->sipProtectVirt_GetDefaultBorderForControl(sipSelfWasArg);
            Py_END_ALLOW_THREADS

            if (PyErr_Occurred())
                return 0;

            return sipConvertFromEnum(static_cast<int>(sipRes), sipType_wxBorder);
        }
    }

    sipNoMethod(sipParseErr, sipName_PGArrayEditorDialog, sipName_GetDefaultBorderForControl, doc_wxPGArrayEditorDialog_GetDefaultBorderForControl);

    return SIP_NULLPTR;
}


PyDoc_STRVAR(doc_wxPGArrayEditorDialog_DoFreeze, "DoFreeze(self)");

extern "C" {static PyObject *meth_wxPGArrayEditorDialog_DoFreeze(PyObject *, PyObject *);}
static PyObject *meth_wxPGArrayEditorDialog_DoFreeze(PyObject *sipSelf, PyObject *sipArgs)
{
    PyObject *sipParseErr = SIP_NULLPTR;
    bool sipSelfWasArg = (!sipSelf || sipIsDerivedClass((sipSimpleWrapper *)sipSelf));

    {
        sipwxPGArrayEditorDialog *sipCpp;

        if (sipParseArgs(&sipParseErr, sipArgs, "B", &sipSelf, sipType_wxPGArrayEditorDialog, &sipCpp))
        {
            PyErr_Clear();

            Py_BEGIN_ALLOW_THREADS
            sipCpp->sipProtectVirt_DoFreeze(sipSelfWasArg);
            Py_END_ALLOW_THREADS

            if (PyErr_Occurred())
                return 0;

            Py_INCREF(Py_None);
            return Py_None;
        }
    }

    sipNoMethod(sipParseErr, sipName_PGArrayEditorDialog, sipName_DoFreeze, doc_wxPGArrayEditorDialog_DoFreeze);

    return SIP_NULLPTR;
}


PyDoc_STRVAR(doc_wxPGArrayEditorDialog_DoThaw, "DoThaw(self)");

extern "C" {static PyObject *meth_wxPGArrayEditorDialog_DoThaw(PyObject *, PyObject *);}
static PyObject *meth_wxPGArrayEditorDialog_DoThaw(PyObject *sipSelf, PyObject *sipArgs)
{
    PyObject *sipParseErr = SIP_NULLPTR;
    bool sipSelfWasArg = (!sipSelf || sipIsDerivedClass((sipSimpleWrapper *)sipSelf));

    {
        sipwxPGArrayEditorDialog *sipCpp;

        if (sipParseArgs(&sipParseErr, sipArgs, "B", &sipSelf, sipType_wxPGArrayEditorDialog, &sipCpp))
        {
            PyErr_Clear();

            Py_BEGIN_ALLOW_THREADS
            sipCpp->sipProtectVirt_DoThaw(sipSelfWasArg);
            Py_END_ALLOW_THREADS

            if (PyErr_Occurred())
                return 0;

            Py_INCREF(Py_None);
            return Py_None;
        }
    }

    sipNoMethod(sipParseErr, sipName_PGArrayEditorDialog, sipName_DoThaw, doc_wxPGArrayEditorDialog_DoThaw);

    return SIP_NULLPTR;
}


PyDoc_STRVAR(doc_wxPGArrayEditorDialog_HasTransparentBackground, "HasTransparentBackground(self) -> bool");

extern "C" {static PyObject *meth_wxPGArrayEditorDialog_HasTransparentBackground(PyObject *, PyObject *);}
static PyObject *meth_wxPGArrayEditorDialog_HasTransparentBackground(PyObject *sipSelf, PyObject *sipArgs)
{
    PyObject *sipParseErr = SIP_NULLPTR;
    bool sipSelfWasArg = (!sipSelf || sipIsDerivedClass((sipSimpleWrapper *)sipSelf));

    {
        sipwxPGArrayEditorDialog *sipCpp;

        if (sipParseArgs(&sipParseErr, sipArgs, "B", &sipSelf, sipType_wxPGArrayEditorDialog, &sipCpp))
        {
            bool sipRes;

            PyErr_Clear();

            Py_BEGIN_ALLOW_THREADS
            sipRes = sipCpp->sipProtectVirt_HasTransparentBackground(sipSelfWasArg);
            Py_END_ALLOW_THREADS

            if (PyErr_Occurred())
                return 0;

            return PyBool_FromLong(sipRes);
        }
    }

    sipNoMethod(sipParseErr, sipName_PGArrayEditorDialog, sipName_HasTransparentBackground, doc_wxPGArrayEditorDialog_HasTransparentBackground);

    return SIP_NULLPTR;
}


PyDoc_STRVAR(doc_wxPGArrayEditorDialog_TryBefore, "TryBefore(self, event: Event) -> bool");

extern "C" {static PyObject *meth_wxPGArrayEditorDialog_TryBefore(PyObject *, PyObject *, PyObject *);}
static PyObject *meth_wxPGArrayEditorDialog_TryBefore(PyObject *sipSelf, PyObject *sipArgs, PyObject *sipKwds)
{
    PyObject *sipParseErr = SIP_NULLPTR;
    bool sipSelfWasArg = (!sipSelf || sipIsDerivedClass((sipSimpleWrapper *)sipSelf));

    {
        ::wxEvent* event;
        sipwxPGArrayEditorDialog *sipCpp;

        static const char *sipKwdList[] = {
            sipName_event,
        };

        if (sipParseKwdArgs(&sipParseErr, sipArgs, sipKwds, sipKwdList, SIP_NULLPTR, "BJ9", &sipSelf, sipType_wxPGArrayEditorDialog, &sipCpp, sipType_wxEvent, &event))
        {
            bool sipRes;

            PyErr_Clear();

            Py_BEGIN_ALLOW_THREADS
            sipRes = sipCpp->sipProtectVirt_TryBefore(sipSelfWasArg, *event);
            Py_END_ALLOW_THREADS

            if (PyErr_Occurred())
                return 0;

            return PyBool_FromLong(sipRes);
        }
    }

    sipNoMethod(sipParseErr, sipName_PGArrayEditorDialog, sipName_TryBefore, doc_wxPGArrayEditorDialog_TryBefore);

    return SIP_NULLPTR;
}


PyDoc_STRVAR(doc_wxPGArrayEditorDialog_TryAfter, "TryAfter(self, event: Event) -> bool");

extern "C" {static PyObject *meth_wxPGArrayEditorDialog_TryAfter(PyObject *, PyObject *, PyObject *);}
static PyObject *meth_wxPGArrayEditorDialog_TryAfter(PyObject *sipSelf, PyObject *sipArgs, PyObject *sipKwds)
{
    PyObject *sipParseErr = SIP_NULLPTR;
    bool sipSelfWasArg = (!sipSelf || sipIsDerivedClass((sipSimpleWrapper *)sipSelf));

    {
        ::wxEvent* event;
        sipwxPGArrayEditorDialog *sipCpp;

        static const char *sipKwdList[] = {
            sipName_event,
        };

        if (sipParseKwdArgs(&sipParseErr, sipArgs, sipKwds, sipKwdList, SIP_NULLPTR, "BJ9", &sipSelf, sipType_wxPGArrayEditorDialog, &sipCpp, sipType_wxEvent, &event))
        {
            bool sipRes;

            PyErr_Clear();

            Py_BEGIN_ALLOW_THREADS
            sipRes = sipCpp->sipProtectVirt_TryAfter(sipSelfWasArg, *event);
            Py_END_ALLOW_THREADS

            if (PyErr_Occurred())
                return 0;

            return PyBool_FromLong(sipRes);
        }
    }

    sipNoMethod(sipParseErr, sipName_PGArrayEditorDialog, sipName_TryAfter, doc_wxPGArrayEditorDialog_TryAfter);

    return SIP_NULLPTR;
}


PyDoc_STRVAR(doc_wxPGArrayEditorDialog_Init, "Init()");

extern "C" {static PyObject *meth_wxPGArrayEditorDialog_Init(PyObject *, PyObject *);}
static PyObject *meth_wxPGArrayEditorDialog_Init(PyObject *sipSelf, PyObject *sipArgs)
{
    PyObject *sipParseErr = SIP_NULLPTR;

    {
        ::wxPGArrayEditorDialog *sipCpp;

        if (sipParseArgs(&sipParseErr, sipArgs, "B", &sipSelf, sipType_wxPGArrayEditorDialog, &sipCpp))
        {
            PyErr_Clear();

            Py_BEGIN_ALLOW_THREADS
            sipCpp->Init();
            Py_END_ALLOW_THREADS

            if (PyErr_Occurred())
                return 0;

            Py_INCREF(Py_None);
            return Py_None;
        }
    }

    sipNoMethod(sipParseErr, sipName_PGArrayEditorDialog, sipName_Init, SIP_NULLPTR);

    return SIP_NULLPTR;
}


PyDoc_STRVAR(doc_wxPGArrayEditorDialog_Create, "Create(parent, message, caption, style=AEDIALOG_STYLE, pos=wx.DefaultPosition, sz=wx.DefaultSize) -> bool");

extern "C" {static PyObject *meth_wxPGArrayEditorDialog_Create(PyObject *, PyObject *, PyObject *);}
static PyObject *meth_wxPGArrayEditorDialog_Create(PyObject *sipSelf, PyObject *sipArgs, PyObject *sipKwds)
{
    PyObject *sipParseErr = SIP_NULLPTR;

    {
        ::wxWindow* parent;
        const ::wxString* message;
        int messageState = 0;
        const ::wxString* caption;
        int captionState = 0;
        long style = wxAEDIALOG_STYLE;
        const ::wxPoint& posdef = wxDefaultPosition;
        const ::wxPoint* pos = &posdef;
        int posState = 0;
        const ::wxSize& szdef = wxDefaultSize;
        const ::wxSize* sz = &szdef;
        int szState = 0;
        sipWrapper *sipOwner = SIP_NULLPTR;
        ::wxPGArrayEditorDialog *sipCpp;

        static const char *sipKwdList[] = {
            sipName_parent,
            sipName_message,
            sipName_caption,
            sipName_style,
            sipName_pos,
            sipName_sz,
        };

        if (sipParseKwdArgs(&sipParseErr, sipArgs, sipKwds, sipKwdList, SIP_NULLPTR, "BJHJ1J1|lJ1J1", &sipSelf, sipType_wxPGArrayEditorDialog, &sipCpp, sipType_wxWindow, &parent, &sipOwner, sipType_wxString, &message, &messageState, sipType_wxString, &caption, &captionState, &style, sipType_wxPoint, &pos, &posState, sipType_wxSize, &sz, &szState))
        {
            bool sipRes;

            PyErr_Clear();

            Py_BEGIN_ALLOW_THREADS
            sipRes = sipCpp->Create(parent, *message, *caption, style, *pos, *sz);
            Py_END_ALLOW_THREADS

            if (sipOwner)
                sipTransferTo(sipSelf, (PyObject *)sipOwner);
            else
                sipTransferBack(sipSelf);
            sipReleaseType(const_cast< ::wxString *>(message), sipType_wxString, messageState);
            sipReleaseType(const_cast< ::wxString *>(caption), sipType_wxString, captionState);
            sipReleaseType(const_cast< ::wxPoint *>(pos), sipType_wxPoint, posState);
            sipReleaseType(const_cast< ::wxSize *>(sz), sipType_wxSize, szState);

            if (PyErr_Occurred())
                return 0;

            return PyBool_FromLong(sipRes);
        }
    }

    sipNoMethod(sipParseErr, sipName_PGArrayEditorDialog, sipName_Create, SIP_NULLPTR);

    return SIP_NULLPTR;
}


PyDoc_STRVAR(doc_wxPGArrayEditorDialog_EnableCustomNewAction, "EnableCustomNewAction()");

extern "C" {static PyObject *meth_wxPGArrayEditorDialog_EnableCustomNewAction(PyObject *, PyObject *);}
static PyObject *meth_wxPGArrayEditorDialog_EnableCustomNewAction(PyObject *sipSelf, PyObject *sipArgs)
{
    PyObject *sipParseErr = SIP_NULLPTR;

    {
        ::wxPGArrayEditorDialog *sipCpp;

        if (sipParseArgs(&sipParseErr, sipArgs, "B", &sipSelf, sipType_wxPGArrayEditorDialog, &sipCpp))
        {
            PyErr_Clear();

            Py_BEGIN_ALLOW_THREADS
            sipCpp->EnableCustomNewAction();
            Py_END_ALLOW_THREADS

            if (PyErr_Occurred())
                return 0;

            Py_INCREF(Py_None);
            return Py_None;
        }
    }

    sipNoMethod(sipParseErr, sipName_PGArrayEditorDialog, sipName_EnableCustomNewAction, SIP_NULLPTR);

    return SIP_NULLPTR;
}


PyDoc_STRVAR(doc_wxPGArrayEditorDialog_SetNewButtonText, "SetNewButtonText(text)\n"
"\n"
"Sets tooltip text for button allowing the user to enter new string.");

extern "C" {static PyObject *meth_wxPGArrayEditorDialog_SetNewButtonText(PyObject *, PyObject *, PyObject *);}
static PyObject *meth_wxPGArrayEditorDialog_SetNewButtonText(PyObject *sipSelf, PyObject *sipArgs, PyObject *sipKwds)
{
    PyObject *sipParseErr = SIP_NULLPTR;

    {
        const ::wxString* text;
        int textState = 0;
        ::wxPGArrayEditorDialog *sipCpp;

        static const char *sipKwdList[] = {
            sipName_text,
        };

        if (sipParseKwdArgs(&sipParseErr, sipArgs, sipKwds, sipKwdList, SIP_NULLPTR, "BJ1", &sipSelf, sipType_wxPGArrayEditorDialog, &sipCpp, sipType_wxString, &text, &textState))
        {
            PyErr_Clear();

            Py_BEGIN_ALLOW_THREADS
            sipCpp->SetNewButtonText(*text);
            Py_END_ALLOW_THREADS
            sipReleaseType(const_cast< ::wxString *>(text), sipType_wxString, textState);

            if (PyErr_Occurred())
                return 0;

            Py_INCREF(Py_None);
            return Py_None;
        }
    }

    sipNoMethod(sipParseErr, sipName_PGArrayEditorDialog, sipName_SetNewButtonText, SIP_NULLPTR);

    return SIP_NULLPTR;
}


PyDoc_STRVAR(doc_wxPGArrayEditorDialog_SetDialogValue, "SetDialogValue(value)\n"
"\n"
"Set value modified by dialog.");

extern "C" {static PyObject *meth_wxPGArrayEditorDialog_SetDialogValue(PyObject *, PyObject *, PyObject *);}
static PyObject *meth_wxPGArrayEditorDialog_SetDialogValue(PyObject *sipSelf, PyObject *sipArgs, PyObject *sipKwds)
{
    PyObject *sipParseErr = SIP_NULLPTR;
    bool sipSelfWasArg = (!sipSelf || sipIsDerivedClass((sipSimpleWrapper *)sipSelf));

    {
        const ::wxPGVariant* value;
        int valueState = 0;
        ::wxPGArrayEditorDialog *sipCpp;

        static const char *sipKwdList[] = {
            sipName_value,
        };

        if (sipParseKwdArgs(&sipParseErr, sipArgs, sipKwds, sipKwdList, SIP_NULLPTR, "BJ1", &sipSelf, sipType_wxPGArrayEditorDialog, &sipCpp, sipType_wxPGVariant, &value, &valueState))
        {
            PyErr_Clear();

            Py_BEGIN_ALLOW_THREADS
            (sipSelfWasArg ? sipCpp->::wxPGArrayEditorDialog::SetDialogValue(*value) : sipCpp->SetDialogValue(*value));
            Py_END_ALLOW_THREADS
            sipReleaseType(const_cast< ::wxPGVariant *>(value), sipType_wxPGVariant, valueState);

            if (PyErr_Occurred())
                return 0;

            Py_INCREF(Py_None);
            return Py_None;
        }
    }

    sipNoMethod(sipParseErr, sipName_PGArrayEditorDialog, sipName_SetDialogValue, SIP_NULLPTR);

    return SIP_NULLPTR;
}


PyDoc_STRVAR(doc_wxPGArrayEditorDialog_GetDialogValue, "GetDialogValue() -> PGVariant\n"
"\n"
"Return value modified by dialog.");

extern "C" {static PyObject *meth_wxPGArrayEditorDialog_GetDialogValue(PyObject *, PyObject *);}
static PyObject *meth_wxPGArrayEditorDialog_GetDialogValue(PyObject *sipSelf, PyObject *sipArgs)
{
    PyObject *sipParseErr = SIP_NULLPTR;
    bool sipSelfWasArg = (!sipSelf || sipIsDerivedClass((sipSimpleWrapper *)sipSelf));

    {
        const ::wxPGArrayEditorDialog *sipCpp;

        if (sipParseArgs(&sipParseErr, sipArgs, "B", &sipSelf, sipType_wxPGArrayEditorDialog, &sipCpp))
        {
            ::wxPGVariant*sipRes;

            PyErr_Clear();

            Py_BEGIN_ALLOW_THREADS
            sipRes = new ::wxPGVariant((sipSelfWasArg ? sipCpp->::wxPGArrayEditorDialog::GetDialogValue() : sipCpp->GetDialogValue()));
            Py_END_ALLOW_THREADS

            if (PyErr_Occurred())
                return 0;

            return sipConvertFromNewType(sipRes, sipType_wxPGVariant, SIP_NULLPTR);
        }
    }

    sipNoMethod(sipParseErr, sipName_PGArrayEditorDialog, sipName_GetDialogValue, SIP_NULLPTR);

    return SIP_NULLPTR;
}


PyDoc_STRVAR(doc_wxPGArrayEditorDialog_GetTextCtrlValidator, "GetTextCtrlValidator() -> wx.Validator\n"
"\n"
"Override to return wxValidator to be used with the wxTextCtrl in\n"
"dialog.");

extern "C" {static PyObject *meth_wxPGArrayEditorDialog_GetTextCtrlValidator(PyObject *, PyObject *);}
static PyObject *meth_wxPGArrayEditorDialog_GetTextCtrlValidator(PyObject *sipSelf, PyObject *sipArgs)
{
    PyObject *sipParseErr = SIP_NULLPTR;
    bool sipSelfWasArg = (!sipSelf || sipIsDerivedClass((sipSimpleWrapper *)sipSelf));

    {
        const ::wxPGArrayEditorDialog *sipCpp;

        if (sipParseArgs(&sipParseErr, sipArgs, "B", &sipSelf, sipType_wxPGArrayEditorDialog, &sipCpp))
        {
            ::wxValidator*sipRes;

            PyErr_Clear();

            Py_BEGIN_ALLOW_THREADS
            sipRes = (sipSelfWasArg ? sipCpp->::wxPGArrayEditorDialog::GetTextCtrlValidator() : sipCpp->GetTextCtrlValidator());
            Py_END_ALLOW_THREADS

            if (PyErr_Occurred())
                return 0;

            return sipConvertFromType(sipRes, sipType_wxValidator, SIP_NULLPTR);
        }
    }

    sipNoMethod(sipParseErr, sipName_PGArrayEditorDialog, sipName_GetTextCtrlValidator, SIP_NULLPTR);

    return SIP_NULLPTR;
}


PyDoc_STRVAR(doc_wxPGArrayEditorDialog_IsModified, "IsModified() -> bool\n"
"\n"
"Returns true if array was actually modified.");

extern "C" {static PyObject *meth_wxPGArrayEditorDialog_IsModified(PyObject *, PyObject *);}
static PyObject *meth_wxPGArrayEditorDialog_IsModified(PyObject *sipSelf, PyObject *sipArgs)
{
    PyObject *sipParseErr = SIP_NULLPTR;

    {
        const ::wxPGArrayEditorDialog *sipCpp;

        if (sipParseArgs(&sipParseErr, sipArgs, "B", &sipSelf, sipType_wxPGArrayEditorDialog, &sipCpp))
        {
            bool sipRes;

            PyErr_Clear();

            Py_BEGIN_ALLOW_THREADS
            sipRes = sipCpp->IsModified();
            Py_END_ALLOW_THREADS

            if (PyErr_Occurred())
                return 0;

            return PyBool_FromLong(sipRes);
        }
    }

    sipNoMethod(sipParseErr, sipName_PGArrayEditorDialog, sipName_IsModified, SIP_NULLPTR);

    return SIP_NULLPTR;
}


PyDoc_STRVAR(doc_wxPGArrayEditorDialog_GetSelection, "GetSelection() -> int");

extern "C" {static PyObject *meth_wxPGArrayEditorDialog_GetSelection(PyObject *, PyObject *);}
static PyObject *meth_wxPGArrayEditorDialog_GetSelection(PyObject *sipSelf, PyObject *sipArgs)
{
    PyObject *sipParseErr = SIP_NULLPTR;

    {
        const ::wxPGArrayEditorDialog *sipCpp;

        if (sipParseArgs(&sipParseErr, sipArgs, "B", &sipSelf, sipType_wxPGArrayEditorDialog, &sipCpp))
        {
            int sipRes;

            PyErr_Clear();

            Py_BEGIN_ALLOW_THREADS
            sipRes = sipCpp->GetSelection();
            Py_END_ALLOW_THREADS

            if (PyErr_Occurred())
                return 0;

            return PyLong_FromLong(sipRes);
        }
    }

    sipNoMethod(sipParseErr, sipName_PGArrayEditorDialog, sipName_GetSelection, SIP_NULLPTR);

    return SIP_NULLPTR;
}


PyDoc_STRVAR(doc_wxPGArrayEditorDialog_GetClassDefaultAttributes, "GetClassDefaultAttributes(variant=wx.WINDOW_VARIANT_NORMAL) -> wx.VisualAttributes");

extern "C" {static PyObject *meth_wxPGArrayEditorDialog_GetClassDefaultAttributes(PyObject *, PyObject *, PyObject *);}
static PyObject *meth_wxPGArrayEditorDialog_GetClassDefaultAttributes(PyObject *, PyObject *sipArgs, PyObject *sipKwds)
{
    PyObject *sipParseErr = SIP_NULLPTR;

    {
        ::wxWindowVariant variant = wxWINDOW_VARIANT_NORMAL;

        static const char *sipKwdList[] = {
            sipName_variant,
        };

        if (sipParseKwdArgs(&sipParseErr, sipArgs, sipKwds, sipKwdList, SIP_NULLPTR, "|E", sipType_wxWindowVariant, &variant))
        {
            ::wxVisualAttributes*sipRes;

        if (!wxPyCheckForApp()) return NULL;

            PyErr_Clear();

            Py_BEGIN_ALLOW_THREADS
            sipRes = new ::wxVisualAttributes(::wxPGArrayEditorDialog::GetClassDefaultAttributes(variant));
            Py_END_ALLOW_THREADS

            if (PyErr_Occurred())
                return 0;

            return sipConvertFromNewType(sipRes, sipType_wxVisualAttributes, SIP_NULLPTR);
        }
    }

    sipNoMethod(sipParseErr, sipName_PGArrayEditorDialog, sipName_GetClassDefaultAttributes, SIP_NULLPTR);

    return SIP_NULLPTR;
}


PyDoc_STRVAR(doc_wxPGArrayEditorDialog_ArrayGet, "ArrayGet(index) -> String");

extern "C" {static PyObject *meth_wxPGArrayEditorDialog_ArrayGet(PyObject *, PyObject *, PyObject *);}
static PyObject *meth_wxPGArrayEditorDialog_ArrayGet(PyObject *sipSelf, PyObject *sipArgs, PyObject *sipKwds)
{
    PyObject *sipParseErr = SIP_NULLPTR;
    PyObject *sipOrigSelf = sipSelf;

    {
        size_t index;
        sipwxPGArrayEditorDialog *sipCpp;

        static const char *sipKwdList[] = {
            sipName_index,
        };

        if (sipParseKwdArgs(&sipParseErr, sipArgs, sipKwds, sipKwdList, SIP_NULLPTR, "B=", &sipSelf, sipType_wxPGArrayEditorDialog, &sipCpp, &index))
        {
            ::wxString*sipRes;

            if (!sipOrigSelf)
            {
                sipAbstractMethod(sipName_PGArrayEditorDialog, sipName_ArrayGet);
                return SIP_NULLPTR;
            }

            PyErr_Clear();

            Py_BEGIN_ALLOW_THREADS
            sipRes = new ::wxString(sipCpp->sipProtect_ArrayGet(index));
            Py_END_ALLOW_THREADS

            if (PyErr_Occurred())
                return 0;

            return sipConvertFromNewType(sipRes, sipType_wxString, SIP_NULLPTR);
        }
    }

    sipNoMethod(sipParseErr, sipName_PGArrayEditorDialog, sipName_ArrayGet, SIP_NULLPTR);

    return SIP_NULLPTR;
}


PyDoc_STRVAR(doc_wxPGArrayEditorDialog_ArrayGetCount, "ArrayGetCount() -> size_t");

extern "C" {static PyObject *meth_wxPGArrayEditorDialog_ArrayGetCount(PyObject *, PyObject *);}
static PyObject *meth_wxPGArrayEditorDialog_ArrayGetCount(PyObject *sipSelf, PyObject *sipArgs)
{
    PyObject *sipParseErr = SIP_NULLPTR;
    PyObject *sipOrigSelf = sipSelf;

    {
        sipwxPGArrayEditorDialog *sipCpp;

        if (sipParseArgs(&sipParseErr, sipArgs, "B", &sipSelf, sipType_wxPGArrayEditorDialog, &sipCpp))
        {
            size_t sipRes;

            if (!sipOrigSelf)
            {
                sipAbstractMethod(sipName_PGArrayEditorDialog, sipName_ArrayGetCount);
                return SIP_NULLPTR;
            }

            PyErr_Clear();

            Py_BEGIN_ALLOW_THREADS
            sipRes = sipCpp->sipProtect_ArrayGetCount();
            Py_END_ALLOW_THREADS

            if (PyErr_Occurred())
                return 0;

            return PyLong_FromUnsignedLong(sipRes);
        }
    }

    sipNoMethod(sipParseErr, sipName_PGArrayEditorDialog, sipName_ArrayGetCount, SIP_NULLPTR);

    return SIP_NULLPTR;
}


PyDoc_STRVAR(doc_wxPGArrayEditorDialog_ArrayInsert, "ArrayInsert(str, index) -> bool");

extern "C" {static PyObject *meth_wxPGArrayEditorDialog_ArrayInsert(PyObject *, PyObject *, PyObject *);}
static PyObject *meth_wxPGArrayEditorDialog_ArrayInsert(PyObject *sipSelf, PyObject *sipArgs, PyObject *sipKwds)
{
    PyObject *sipParseErr = SIP_NULLPTR;
    PyObject *sipOrigSelf = sipSelf;

    {
        const ::wxString* str;
        int strState = 0;
        int index;
        sipwxPGArrayEditorDialog *sipCpp;

        static const char *sipKwdList[] = {
            sipName_str,
            sipName_index,
        };

        if (sipParseKwdArgs(&sipParseErr, sipArgs, sipKwds, sipKwdList, SIP_NULLPTR, "BJ1i", &sipSelf, sipType_wxPGArrayEditorDialog, &sipCpp, sipType_wxString, &str, &strState, &index))
        {
            bool sipRes;

            if (!sipOrigSelf)
            {
                sipAbstractMethod(sipName_PGArrayEditorDialog, sipName_ArrayInsert);
                return SIP_NULLPTR;
            }

            PyErr_Clear();

            Py_BEGIN_ALLOW_THREADS
            sipRes = sipCpp->sipProtect_ArrayInsert(*str, index);
            Py_END_ALLOW_THREADS
            sipReleaseType(const_cast< ::wxString *>(str), sipType_wxString, strState);

            if (PyErr_Occurred())
                return 0;

            return PyBool_FromLong(sipRes);
        }
    }

    sipNoMethod(sipParseErr, sipName_PGArrayEditorDialog, sipName_ArrayInsert, SIP_NULLPTR);

    return SIP_NULLPTR;
}


PyDoc_STRVAR(doc_wxPGArrayEditorDialog_ArraySet, "ArraySet(index, str) -> bool");

extern "C" {static PyObject *meth_wxPGArrayEditorDialog_ArraySet(PyObject *, PyObject *, PyObject *);}
static PyObject *meth_wxPGArrayEditorDialog_ArraySet(PyObject *sipSelf, PyObject *sipArgs, PyObject *sipKwds)
{
    PyObject *sipParseErr = SIP_NULLPTR;
    PyObject *sipOrigSelf = sipSelf;

    {
        size_t index;
        const ::wxString* str;
        int strState = 0;
        sipwxPGArrayEditorDialog *sipCpp;

        static const char *sipKwdList[] = {
            sipName_index,
            sipName_str,
        };

        if (sipParseKwdArgs(&sipParseErr, sipArgs, sipKwds, sipKwdList, SIP_NULLPTR, "B=J1", &sipSelf, sipType_wxPGArrayEditorDialog, &sipCpp, &index, sipType_wxString, &str, &strState))
        {
            bool sipRes;

            if (!sipOrigSelf)
            {
                sipAbstractMethod(sipName_PGArrayEditorDialog, sipName_ArraySet);
                return SIP_NULLPTR;
            }

            PyErr_Clear();

            Py_BEGIN_ALLOW_THREADS
            sipRes = sipCpp->sipProtect_ArraySet(index, *str);
            Py_END_ALLOW_THREADS
            sipReleaseType(const_cast< ::wxString *>(str), sipType_wxString, strState);

            if (PyErr_Occurred())
                return 0;

            return PyBool_FromLong(sipRes);
        }
    }

    sipNoMethod(sipParseErr, sipName_PGArrayEditorDialog, sipName_ArraySet, SIP_NULLPTR);

    return SIP_NULLPTR;
}


PyDoc_STRVAR(doc_wxPGArrayEditorDialog_ArrayRemoveAt, "ArrayRemoveAt(index)");

extern "C" {static PyObject *meth_wxPGArrayEditorDialog_ArrayRemoveAt(PyObject *, PyObject *, PyObject *);}
static PyObject *meth_wxPGArrayEditorDialog_ArrayRemoveAt(PyObject *sipSelf, PyObject *sipArgs, PyObject *sipKwds)
{
    PyObject *sipParseErr = SIP_NULLPTR;
    PyObject *sipOrigSelf = sipSelf;

    {
        int index;
        sipwxPGArrayEditorDialog *sipCpp;

        static const char *sipKwdList[] = {
            sipName_index,
        };

        if (sipParseKwdArgs(&sipParseErr, sipArgs, sipKwds, sipKwdList, SIP_NULLPTR, "Bi", &sipSelf, sipType_wxPGArrayEditorDialog, &sipCpp, &index))
        {
            if (!sipOrigSelf)
            {
                sipAbstractMethod(sipName_PGArrayEditorDialog, sipName_ArrayRemoveAt);
                return SIP_NULLPTR;
            }

            PyErr_Clear();

            Py_BEGIN_ALLOW_THREADS
            sipCpp->sipProtect_ArrayRemoveAt(index);
            Py_END_ALLOW_THREADS

            if (PyErr_Occurred())
                return 0;

            Py_INCREF(Py_None);
            return Py_None;
        }
    }

    sipNoMethod(sipParseErr, sipName_PGArrayEditorDialog, sipName_ArrayRemoveAt, SIP_NULLPTR);

    return SIP_NULLPTR;
}


PyDoc_STRVAR(doc_wxPGArrayEditorDialog_ArraySwap, "ArraySwap(first, second)");

extern "C" {static PyObject *meth_wxPGArrayEditorDialog_ArraySwap(PyObject *, PyObject *, PyObject *);}
static PyObject *meth_wxPGArrayEditorDialog_ArraySwap(PyObject *sipSelf, PyObject *sipArgs, PyObject *sipKwds)
{
    PyObject *sipParseErr = SIP_NULLPTR;
    PyObject *sipOrigSelf = sipSelf;

    {
        size_t first;
        size_t second;
        sipwxPGArrayEditorDialog *sipCpp;

        static const char *sipKwdList[] = {
            sipName_first,
            sipName_second,
        };

        if (sipParseKwdArgs(&sipParseErr, sipArgs, sipKwds, sipKwdList, SIP_NULLPTR, "B==", &sipSelf, sipType_wxPGArrayEditorDialog, &sipCpp, &first, &second))
        {
            if (!sipOrigSelf)
            {
                sipAbstractMethod(sipName_PGArrayEditorDialog, sipName_ArraySwap);
                return SIP_NULLPTR;
            }

            PyErr_Clear();

            Py_BEGIN_ALLOW_THREADS
            sipCpp->sipProtect_ArraySwap(first, second);
            Py_END_ALLOW_THREADS

            if (PyErr_Occurred())
                return 0;

            Py_INCREF(Py_None);
            return Py_None;
        }
    }

    sipNoMethod(sipParseErr, sipName_PGArrayEditorDialog, sipName_ArraySwap, SIP_NULLPTR);

    return SIP_NULLPTR;
}


PyDoc_STRVAR(doc_wxPGArrayEditorDialog_OnCustomNewAction, "OnCustomNewAction(resString) -> bool");

extern "C" {static PyObject *meth_wxPGArrayEditorDialog_OnCustomNewAction(PyObject *, PyObject *, PyObject *);}
static PyObject *meth_wxPGArrayEditorDialog_OnCustomNewAction(PyObject *sipSelf, PyObject *sipArgs, PyObject *sipKwds)
{
    PyObject *sipParseErr = SIP_NULLPTR;
    bool sipSelfWasArg = (!sipSelf || sipIsDerivedClass((sipSimpleWrapper *)sipSelf));

    {
        ::wxString* resString;
        int resStringState = 0;
        sipwxPGArrayEditorDialog *sipCpp;

        static const char *sipKwdList[] = {
            sipName_resString,
        };

        if (sipParseKwdArgs(&sipParseErr, sipArgs, sipKwds, sipKwdList, SIP_NULLPTR, "BJ0", &sipSelf, sipType_wxPGArrayEditorDialog, &sipCpp, sipType_wxString, &resString, &resStringState))
        {
            bool sipRes;

            PyErr_Clear();

            Py_BEGIN_ALLOW_THREADS
            sipRes = sipCpp->sipProtectVirt_OnCustomNewAction(sipSelfWasArg, resString);
            Py_END_ALLOW_THREADS
            sipReleaseType(resString, sipType_wxString, resStringState);

            if (PyErr_Occurred())
                return 0;

            return PyBool_FromLong(sipRes);
        }
    }

    sipNoMethod(sipParseErr, sipName_PGArrayEditorDialog, sipName_OnCustomNewAction, SIP_NULLPTR);

    return SIP_NULLPTR;
}


/* Cast a pointer to a type somewhere in its inheritance hierarchy. */
extern "C" {static void *cast_wxPGArrayEditorDialog(void *, const sipTypeDef *);}
static void *cast_wxPGArrayEditorDialog(void *sipCppV, const sipTypeDef *targetType)
{
    ::wxPGArrayEditorDialog *sipCpp = reinterpret_cast< ::wxPGArrayEditorDialog *>(sipCppV);

    if (targetType == sipType_wxPGArrayEditorDialog)
        return sipCppV;

    sipCppV = ((const sipClassTypeDef *)sipType_wxDialog)->ctd_cast(static_cast< ::wxDialog *>(sipCpp), targetType);
    if (sipCppV)
        return sipCppV;

    return SIP_NULLPTR;
}


/* Call the instance's destructor. */
extern "C" {static void release_wxPGArrayEditorDialog(void *, int);}
static void release_wxPGArrayEditorDialog(void *sipCppV, int sipState)
{
    Py_BEGIN_ALLOW_THREADS

    if (sipState & SIP_DERIVED_CLASS)
        delete reinterpret_cast<sipwxPGArrayEditorDialog *>(sipCppV);
    else
        delete reinterpret_cast< ::wxPGArrayEditorDialog *>(sipCppV);

    Py_END_ALLOW_THREADS
}


extern "C" {static void dealloc_wxPGArrayEditorDialog(sipSimpleWrapper *);}
static void dealloc_wxPGArrayEditorDialog(sipSimpleWrapper *sipSelf)
{
    if (sipIsDerivedClass(sipSelf))
        reinterpret_cast<sipwxPGArrayEditorDialog *>(sipGetAddress(sipSelf))->sipPySelf = SIP_NULLPTR;

    if (sipIsOwnedByPython(sipSelf))
    {
        release_wxPGArrayEditorDialog(sipGetAddress(sipSelf), sipIsDerivedClass(sipSelf));
    }
}


extern "C" {static void *init_type_wxPGArrayEditorDialog(sipSimpleWrapper *, PyObject *, PyObject *, PyObject **, PyObject **, PyObject **);}
static void *init_type_wxPGArrayEditorDialog(sipSimpleWrapper *sipSelf, PyObject *sipArgs, PyObject *sipKwds, PyObject **sipUnused, PyObject **, PyObject **sipParseErr)
{
    sipwxPGArrayEditorDialog *sipCpp = SIP_NULLPTR;

    {
        if (sipParseKwdArgs(sipParseErr, sipArgs, sipKwds, SIP_NULLPTR, sipUnused, ""))
        {

        if (!wxPyCheckForApp()) return NULL;

            PyErr_Clear();

            Py_BEGIN_ALLOW_THREADS
            sipCpp = new sipwxPGArrayEditorDialog();
            Py_END_ALLOW_THREADS

            if (PyErr_Occurred())
            {
                delete sipCpp;
                return SIP_NULLPTR;
            }

            sipCpp->sipPySelf = sipSelf;

            return sipCpp;
        }
    }

    return SIP_NULLPTR;
}


/* Define this type's super-types. */
static sipEncodedTypeDef supers_wxPGArrayEditorDialog[] = {{11, 0, 1}};


static PyMethodDef methods_wxPGArrayEditorDialog[] = {
    {sipName_ArrayGet, SIP_MLMETH_CAST(meth_wxPGArrayEditorDialog_ArrayGet), METH_VARARGS|METH_KEYWORDS, doc_wxPGArrayEditorDialog_ArrayGet},
    {sipName_ArrayGetCount, meth_wxPGArrayEditorDialog_ArrayGetCount, METH_VARARGS, doc_wxPGArrayEditorDialog_ArrayGetCount},
    {sipName_ArrayInsert, SIP_MLMETH_CAST(meth_wxPGArrayEditorDialog_ArrayInsert), METH_VARARGS|METH_KEYWORDS, doc_wxPGArrayEditorDialog_ArrayInsert},
    {sipName_ArrayRemoveAt, SIP_MLMETH_CAST(meth_wxPGArrayEditorDialog_ArrayRemoveAt), METH_VARARGS|METH_KEYWORDS, doc_wxPGArrayEditorDialog_ArrayRemoveAt},
    {sipName_ArraySet, SIP_MLMETH_CAST(meth_wxPGArrayEditorDialog_ArraySet), METH_VARARGS|METH_KEYWORDS, doc_wxPGArrayEditorDialog_ArraySet},
    {sipName_ArraySwap, SIP_MLMETH_CAST(meth_wxPGArrayEditorDialog_ArraySwap), METH_VARARGS|METH_KEYWORDS, doc_wxPGArrayEditorDialog_ArraySwap},
    {sipName_Create, SIP_MLMETH_CAST(meth_wxPGArrayEditorDialog_Create), METH_VARARGS|METH_KEYWORDS, doc_wxPGArrayEditorDialog_Create},
    {sipName_DoEnable, SIP_MLMETH_CAST(meth_wxPGArrayEditorDialog_DoEnable), METH_VARARGS|METH_KEYWORDS, SIP_NULLPTR},
    {sipName_DoFreeze, meth_wxPGArrayEditorDialog_DoFreeze, METH_VARARGS, SIP_NULLPTR},
    {sipName_DoGetBestClientSize, meth_wxPGArrayEditorDialog_DoGetBestClientSize, METH_VARARGS, SIP_NULLPTR},
    {sipName_DoGetBestSize, meth_wxPGArrayEditorDialog_DoGetBestSize, METH_VARARGS, SIP_NULLPTR},
    {sipName_DoGetBorderSize, meth_wxPGArrayEditorDialog_DoGetBorderSize, METH_VARARGS, SIP_NULLPTR},
    {sipName_DoGetClientSize, SIP_MLMETH_CAST(meth_wxPGArrayEditorDialog_DoGetClientSize), METH_VARARGS|METH_KEYWORDS, SIP_NULLPTR},
    {sipName_DoGetPosition, SIP_MLMETH_CAST(meth_wxPGArrayEditorDialog_DoGetPosition), METH_VARARGS|METH_KEYWORDS, SIP_NULLPTR},
    {sipName_DoGetSize, SIP_MLMETH_CAST(meth_wxPGArrayEditorDialog_DoGetSize), METH_VARARGS|METH_KEYWORDS, SIP_NULLPTR},
    {sipName_DoMoveWindow, SIP_MLMETH_CAST(meth_wxPGArrayEditorDialog_DoMoveWindow), METH_VARARGS|METH_KEYWORDS, SIP_NULLPTR},
    {sipName_DoSetClientSize, SIP_MLMETH_CAST(meth_wxPGArrayEditorDialog_DoSetClientSize), METH_VARARGS|METH_KEYWORDS, SIP_NULLPTR},
    {sipName_DoSetSize, SIP_MLMETH_CAST(meth_wxPGArrayEditorDialog_DoSetSize), METH_VARARGS|METH_KEYWORDS, SIP_NULLPTR},
    {sipName_DoSetSizeHints, SIP_MLMETH_CAST(meth_wxPGArrayEditorDialog_DoSetSizeHints), METH_VARARGS|METH_KEYWORDS, SIP_NULLPTR},
    {sipName_DoSetWindowVariant, SIP_MLMETH_CAST(meth_wxPGArrayEditorDialog_DoSetWindowVariant), METH_VARARGS|METH_KEYWORDS, SIP_NULLPTR},
    {sipName_DoThaw, meth_wxPGArrayEditorDialog_DoThaw, METH_VARARGS, SIP_NULLPTR},
    {sipName_EnableCustomNewAction, meth_wxPGArrayEditorDialog_EnableCustomNewAction, METH_VARARGS, doc_wxPGArrayEditorDialog_EnableCustomNewAction},
    {sipName_GetClassDefaultAttributes, SIP_MLMETH_CAST(meth_wxPGArrayEditorDialog_GetClassDefaultAttributes), METH_VARARGS|METH_KEYWORDS, doc_wxPGArrayEditorDialog_GetClassDefaultAttributes},
    {sipName_GetDefaultBorder, meth_wxPGArrayEditorDialog_GetDefaultBorder, METH_VARARGS, SIP_NULLPTR},
    {sipName_GetDefaultBorderForControl, meth_wxPGArrayEditorDialog_GetDefaultBorderForControl, METH_VARARGS, SIP_NULLPTR},
    {sipName_GetDialogValue, meth_wxPGArrayEditorDialog_GetDialogValue, METH_VARARGS, doc_wxPGArrayEditorDialog_GetDialogValue},
    {sipName_GetSelection, meth_wxPGArrayEditorDialog_GetSelection, METH_VARARGS, doc_wxPGArrayEditorDialog_GetSelection},
    {sipName_GetTextCtrlValidator, meth_wxPGArrayEditorDialog_GetTextCtrlValidator, METH_VARARGS, doc_wxPGArrayEditorDialog_GetTextCtrlValidator},
    {sipName_HasTransparentBackground, meth_wxPGArrayEditorDialog_HasTransparentBackground, METH_VARARGS, SIP_NULLPTR},
    {sipName_Init, meth_wxPGArrayEditorDialog_Init, METH_VARARGS, doc_wxPGArrayEditorDialog_Init},
    {sipName_IsModified, meth_wxPGArrayEditorDialog_IsModified, METH_VARARGS, doc_wxPGArrayEditorDialog_IsModified},
    {sipName_OnCustomNewAction, SIP_MLMETH_CAST(meth_wxPGArrayEditorDialog_OnCustomNewAction), METH_VARARGS|METH_KEYWORDS, doc_wxPGArrayEditorDialog_OnCustomNewAction},
    {sipName_ProcessEvent, SIP_MLMETH_CAST(meth_wxPGArrayEditorDialog_ProcessEvent), METH_VARARGS|METH_KEYWORDS, SIP_NULLPTR},
    {sipName_SendDestroyEvent, meth_wxPGArrayEditorDialog_SendDestroyEvent, METH_VARARGS, SIP_NULLPTR},
    {sipName_SetDialogValue, SIP_MLMETH_CAST(meth_wxPGArrayEditorDialog_SetDialogValue), METH_VARARGS|METH_KEYWORDS, doc_wxPGArrayEditorDialog_SetDialogValue},
    {sipName_SetNewButtonText, SIP_MLMETH_CAST(meth_wxPGArrayEditorDialog_SetNewButtonText), METH_VARARGS|METH_KEYWORDS, doc_wxPGArrayEditorDialog_SetNewButtonText},
    {sipName_TryAfter, SIP_MLMETH_CAST(meth_wxPGArrayEditorDialog_TryAfter), METH_VARARGS|METH_KEYWORDS, SIP_NULLPTR},
    {sipName_TryBefore, SIP_MLMETH_CAST(meth_wxPGArrayEditorDialog_TryBefore), METH_VARARGS|METH_KEYWORDS, SIP_NULLPTR}
};

sipVariableDef variables_wxPGArrayEditorDialog[] = {
    {PropertyVariable, sipName_TextCtrlValidator, &methods_wxPGArrayEditorDialog[27], SIP_NULLPTR, SIP_NULLPTR, SIP_NULLPTR},
    {PropertyVariable, sipName_Selection, &methods_wxPGArrayEditorDialog[26], SIP_NULLPTR, SIP_NULLPTR, SIP_NULLPTR},
    {PropertyVariable, sipName_DialogValue, &methods_wxPGArrayEditorDialog[25], &methods_wxPGArrayEditorDialog[34], SIP_NULLPTR, SIP_NULLPTR},
};

PyDoc_STRVAR(doc_wxPGArrayEditorDialog, "PGArrayEditorDialog()");


sipClassTypeDef sipTypeDef__propgrid_wxPGArrayEditorDialog = {
    {
        -1,
        SIP_NULLPTR,
        SIP_NULLPTR,
        SIP_TYPE_ABSTRACT|SIP_TYPE_SCC|SIP_TYPE_CLASS,
        sipNameNr_wxPGArrayEditorDialog,
        SIP_NULLPTR,
        SIP_NULLPTR,
    },
    {
        sipNameNr_PGArrayEditorDialog,
        {0, 0, 1},
        38, methods_wxPGArrayEditorDialog,
        0, SIP_NULLPTR,
        3, variables_wxPGArrayEditorDialog,
        {SIP_NULLPTR, SIP_NULLPTR, SIP_NULLPTR, SIP_NULLPTR, SIP_NULLPTR, SIP_NULLPTR, SIP_NULLPTR, SIP_NULLPTR, SIP_NULLPTR, SIP_NULLPTR},
    },
    doc_wxPGArrayEditorDialog,
    -1,
    -1,
    supers_wxPGArrayEditorDialog,
    SIP_NULLPTR,
    init_type_wxPGArrayEditorDialog,
    SIP_NULLPTR,
    SIP_NULLPTR,
    SIP_NULLPTR,
    SIP_NULLPTR,
    dealloc_wxPGArrayEditorDialog,
    SIP_NULLPTR,
    SIP_NULLPTR,
    SIP_NULLPTR,
    release_wxPGArrayEditorDialog,
    cast_wxPGArrayEditorDialog,
    SIP_NULLPTR,
    SIP_NULLPTR,
    SIP_NULLPTR,
    SIP_NULLPTR,
    SIP_NULLPTR,
    SIP_NULLPTR,
    SIP_NULLPTR,
    sizeof (::wxPGArrayEditorDialog),
};
