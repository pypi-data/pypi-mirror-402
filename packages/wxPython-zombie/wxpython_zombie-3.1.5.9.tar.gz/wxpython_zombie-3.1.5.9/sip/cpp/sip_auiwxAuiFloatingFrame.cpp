/*
 * Interface wrapper code.
 *
 * Generated by SIP 6.15.1
 */

#include "sipAPI_aui.h"

        #include <wx/aui/floatpane.h>

        #include <wx/window.h>
        #include <wx/aui/framemanager.h>
        #include <wx/aui/framemanager.h>
        #include <wx/window.h>
        #include <wx/event.h>
        #include <wx/gdicmn.h>
        #include <wx/validate.h>
        #include <wx/toolbar.h>
        #include <wx/statusbr.h>
        #include <wx/menu.h>
        #include <wx/gdicmn.h>
        #include <wx/iconbndl.h>
        #include <wx/icon.h>
        #include <wx/toplevel.h>
            #include <wx/toplevel.h>
        #include <wx/region.h>
        #include <wx/graphics.h>
        #include <wx/event.h>
    #include <wx/setup.h>
    #include "wxpy_api.h"
        #include <wx/event.h>
        #include <wx/cursor.h>
        #include <wx/caret.h>
        #include <wx/layout.h>
        #include <wx/sizer.h>
        #include <wx/dnd.h>
        #include <wx/access.h>
        #include <wx/accel.h>
        #include <wx/menu.h>
        #include <wx/tooltip.h>
        #include <wx/event.h>
        #include <wx/gdicmn.h>
        #include <wx/event.h>
        #include <wx/event.h>
        #include <wx/palette.h>
        #include <wx/colour.h>
        #include <wx/font.h>
        
        
        #include <wx/eventfilter.h>
        #include <wx/object.h>
        #include <wx/object.h>
        #include <wx/object.h>


class sipwxAuiFloatingFrame : public ::wxAuiFloatingFrame
{
public:
    sipwxAuiFloatingFrame(::wxWindow*, ::wxAuiManager*, const ::wxAuiPaneInfo&, ::wxWindowID, long);
    virtual ~sipwxAuiFloatingFrame();

    /*
     * There is a public method for every protected method visible from
     * this class.
     */
    void sipProtect_SendDestroyEvent();
    bool sipProtectVirt_ProcessEvent(bool, ::wxEvent&);
    void sipProtectVirt_DoEnable(bool, bool);
    void sipProtectVirt_DoGetPosition(bool, int*, int*) const;
    void sipProtectVirt_DoGetSize(bool, int*, int*) const;
    void sipProtectVirt_DoGetClientSize(bool, int*, int*) const;
    ::wxSize sipProtectVirt_DoGetBestSize(bool) const;
    ::wxSize sipProtectVirt_DoGetBestClientSize(bool) const;
    void sipProtectVirt_DoSetSize(bool, int, int, int, int, int);
    void sipProtectVirt_DoSetClientSize(bool, int, int);
    void sipProtectVirt_DoSetSizeHints(bool, int, int, int, int, int, int);
    ::wxSize sipProtectVirt_DoGetBorderSize(bool) const;
    void sipProtectVirt_DoMoveWindow(bool, int, int, int, int);
    void sipProtectVirt_DoSetWindowVariant(bool, ::wxWindowVariant);
    ::wxBorder sipProtectVirt_GetDefaultBorder(bool) const;
    ::wxBorder sipProtectVirt_GetDefaultBorderForControl(bool) const;
    void sipProtectVirt_DoFreeze(bool);
    void sipProtectVirt_DoThaw(bool);
    bool sipProtectVirt_HasTransparentBackground(bool);
    bool sipProtectVirt_TryBefore(bool, ::wxEvent&);
    bool sipProtectVirt_TryAfter(bool, ::wxEvent&);

    /*
     * There is a protected method for every virtual method visible from
     * this class.
     */
protected:
    bool ShouldPreventAppExit() const SIP_OVERRIDE;
    ::wxSize DoGetBestClientSize() const SIP_OVERRIDE;
    ::wxSize DoGetBestSize() const SIP_OVERRIDE;
    void DoThaw() SIP_OVERRIDE;
    void DoFreeze() SIP_OVERRIDE;
    ::wxBorder GetDefaultBorderForControl() const SIP_OVERRIDE;
    ::wxBorder GetDefaultBorder() const SIP_OVERRIDE;
    void DoSetWindowVariant(::wxWindowVariant) SIP_OVERRIDE;
    void DoMoveWindow(int, int, int, int) SIP_OVERRIDE;
    ::wxSize DoGetBorderSize() const SIP_OVERRIDE;
    void DoSetSizeHints(int, int, int, int, int, int) SIP_OVERRIDE;
    void DoSetClientSize(int, int) SIP_OVERRIDE;
    void DoSetSize(int, int, int, int, int) SIP_OVERRIDE;
    void DoGetClientSize(int*, int*) const SIP_OVERRIDE;
    void DoGetSize(int*, int*) const SIP_OVERRIDE;
    void DoGetPosition(int*, int*) const SIP_OVERRIDE;
    void DoEnable(bool) SIP_OVERRIDE;
    ::wxWindow* GetMainWindowOfCompositeControl() SIP_OVERRIDE;
    void OnInternalIdle() SIP_OVERRIDE;
    void InitDialog() SIP_OVERRIDE;
    void InheritAttributes() SIP_OVERRIDE;
    bool Destroy() SIP_OVERRIDE;
    bool Validate() SIP_OVERRIDE;
    bool TransferDataToWindow() SIP_OVERRIDE;
    bool TransferDataFromWindow() SIP_OVERRIDE;
    void SetValidator(const ::wxValidator&) SIP_OVERRIDE;
    ::wxValidator* GetValidator() SIP_OVERRIDE;
    bool ShouldInheritColours() const SIP_OVERRIDE;
    bool HasTransparentBackground() SIP_OVERRIDE;
    ::wxPoint GetClientAreaOrigin() const SIP_OVERRIDE;
    bool InformFirstDirection(int, int, int) SIP_OVERRIDE;
    void EnableVisibleFocus(bool) SIP_OVERRIDE;
    void SetCanFocus(bool) SIP_OVERRIDE;
    bool AcceptsFocusRecursively() const SIP_OVERRIDE;
    bool AcceptsFocusFromKeyboard() const SIP_OVERRIDE;
    bool AcceptsFocus() const SIP_OVERRIDE;
    bool TryAfter(::wxEvent&) SIP_OVERRIDE;
    bool TryBefore(::wxEvent&) SIP_OVERRIDE;
    bool ProcessEvent(::wxEvent&) SIP_OVERRIDE;
    void AddChild(::wxWindowBase*) SIP_OVERRIDE;
    void RemoveChild(::wxWindowBase*) SIP_OVERRIDE;
    void DoGiveHelp(const ::wxString&, bool) SIP_OVERRIDE;
    ::wxStatusBar* OnCreateStatusBar(int, long, ::wxWindowID, const ::wxString&) SIP_OVERRIDE;
    ::wxToolBar* OnCreateToolBar(long, ::wxWindowID, const ::wxString&) SIP_OVERRIDE;

public:
    sipSimpleWrapper *sipPySelf;

private:
    sipwxAuiFloatingFrame(const sipwxAuiFloatingFrame &);
    sipwxAuiFloatingFrame &operator = (const sipwxAuiFloatingFrame &);

    char sipPyMethods[44];
};

sipwxAuiFloatingFrame::sipwxAuiFloatingFrame(::wxWindow*parent, ::wxAuiManager*ownerMgr, const ::wxAuiPaneInfo& pane, ::wxWindowID id, long style): ::wxAuiFloatingFrame(parent, ownerMgr, pane, id, style), sipPySelf(SIP_NULLPTR)
{
    memset(sipPyMethods, 0, sizeof (sipPyMethods));
}

sipwxAuiFloatingFrame::~sipwxAuiFloatingFrame()
{
    sipInstanceDestroyedEx(&sipPySelf);
}

bool sipwxAuiFloatingFrame::ShouldPreventAppExit() const
{
    sip_gilstate_t sipGILState;
    PyObject *sipMeth;

    sipMeth = sipIsPyMethod(&sipGILState, const_cast<char *>(&sipPyMethods[0]), const_cast<sipSimpleWrapper **>(&sipPySelf), SIP_NULLPTR, sipName_ShouldPreventAppExit);

    if (!sipMeth)
        return ::wxAuiFloatingFrame::ShouldPreventAppExit();

    extern bool sipVH__aui_12(sip_gilstate_t, sipVirtErrorHandlerFunc, sipSimpleWrapper *, PyObject *);

    return sipVH__aui_12(sipGILState, 0, sipPySelf, sipMeth);
}

::wxSize sipwxAuiFloatingFrame::DoGetBestClientSize() const
{
    sip_gilstate_t sipGILState;
    PyObject *sipMeth;

    sipMeth = sipIsPyMethod(&sipGILState, const_cast<char *>(&sipPyMethods[1]), const_cast<sipSimpleWrapper **>(&sipPySelf), SIP_NULLPTR, sipName_DoGetBestClientSize);

    if (!sipMeth)
        return ::wxAuiFloatingFrame::DoGetBestClientSize();

    extern ::wxSize sipVH__aui_23(sip_gilstate_t, sipVirtErrorHandlerFunc, sipSimpleWrapper *, PyObject *);

    return sipVH__aui_23(sipGILState, 0, sipPySelf, sipMeth);
}

::wxSize sipwxAuiFloatingFrame::DoGetBestSize() const
{
    sip_gilstate_t sipGILState;
    PyObject *sipMeth;

    sipMeth = sipIsPyMethod(&sipGILState, const_cast<char *>(&sipPyMethods[2]), const_cast<sipSimpleWrapper **>(&sipPySelf), SIP_NULLPTR, sipName_DoGetBestSize);

    if (!sipMeth)
        return ::wxAuiFloatingFrame::DoGetBestSize();

    extern ::wxSize sipVH__aui_23(sip_gilstate_t, sipVirtErrorHandlerFunc, sipSimpleWrapper *, PyObject *);

    return sipVH__aui_23(sipGILState, 0, sipPySelf, sipMeth);
}

void sipwxAuiFloatingFrame::DoThaw()
{
    sip_gilstate_t sipGILState;
    PyObject *sipMeth;

    sipMeth = sipIsPyMethod(&sipGILState, &sipPyMethods[3], &sipPySelf, SIP_NULLPTR, sipName_DoThaw);

    if (!sipMeth)
    {
        ::wxAuiFloatingFrame::DoThaw();
        return;
    }

    extern void sipVH__aui_3(sip_gilstate_t, sipVirtErrorHandlerFunc, sipSimpleWrapper *, PyObject *);

    sipVH__aui_3(sipGILState, 0, sipPySelf, sipMeth);
}

void sipwxAuiFloatingFrame::DoFreeze()
{
    sip_gilstate_t sipGILState;
    PyObject *sipMeth;

    sipMeth = sipIsPyMethod(&sipGILState, &sipPyMethods[4], &sipPySelf, SIP_NULLPTR, sipName_DoFreeze);

    if (!sipMeth)
    {
        ::wxAuiFloatingFrame::DoFreeze();
        return;
    }

    extern void sipVH__aui_3(sip_gilstate_t, sipVirtErrorHandlerFunc, sipSimpleWrapper *, PyObject *);

    sipVH__aui_3(sipGILState, 0, sipPySelf, sipMeth);
}

::wxBorder sipwxAuiFloatingFrame::GetDefaultBorderForControl() const
{
    sip_gilstate_t sipGILState;
    PyObject *sipMeth;

    sipMeth = sipIsPyMethod(&sipGILState, const_cast<char *>(&sipPyMethods[5]), const_cast<sipSimpleWrapper **>(&sipPySelf), SIP_NULLPTR, sipName_GetDefaultBorderForControl);

    if (!sipMeth)
        return ::wxAuiFloatingFrame::GetDefaultBorderForControl();

    extern ::wxBorder sipVH__aui_26(sip_gilstate_t, sipVirtErrorHandlerFunc, sipSimpleWrapper *, PyObject *);

    return sipVH__aui_26(sipGILState, 0, sipPySelf, sipMeth);
}

::wxBorder sipwxAuiFloatingFrame::GetDefaultBorder() const
{
    sip_gilstate_t sipGILState;
    PyObject *sipMeth;

    sipMeth = sipIsPyMethod(&sipGILState, const_cast<char *>(&sipPyMethods[6]), const_cast<sipSimpleWrapper **>(&sipPySelf), SIP_NULLPTR, sipName_GetDefaultBorder);

    if (!sipMeth)
        return ::wxAuiFloatingFrame::GetDefaultBorder();

    extern ::wxBorder sipVH__aui_26(sip_gilstate_t, sipVirtErrorHandlerFunc, sipSimpleWrapper *, PyObject *);

    return sipVH__aui_26(sipGILState, 0, sipPySelf, sipMeth);
}

void sipwxAuiFloatingFrame::DoSetWindowVariant(::wxWindowVariant variant)
{
    sip_gilstate_t sipGILState;
    PyObject *sipMeth;

    sipMeth = sipIsPyMethod(&sipGILState, &sipPyMethods[7], &sipPySelf, SIP_NULLPTR, sipName_DoSetWindowVariant);

    if (!sipMeth)
    {
        ::wxAuiFloatingFrame::DoSetWindowVariant(variant);
        return;
    }

    extern void sipVH__aui_25(sip_gilstate_t, sipVirtErrorHandlerFunc, sipSimpleWrapper *, PyObject *, ::wxWindowVariant);

    sipVH__aui_25(sipGILState, 0, sipPySelf, sipMeth, variant);
}

void sipwxAuiFloatingFrame::DoMoveWindow(int x, int y, int width, int height)
{
    sip_gilstate_t sipGILState;
    PyObject *sipMeth;

    sipMeth = sipIsPyMethod(&sipGILState, &sipPyMethods[8], &sipPySelf, SIP_NULLPTR, sipName_DoMoveWindow);

    if (!sipMeth)
    {
        ::wxAuiFloatingFrame::DoMoveWindow(x, y, width, height);
        return;
    }

    extern void sipVH__aui_24(sip_gilstate_t, sipVirtErrorHandlerFunc, sipSimpleWrapper *, PyObject *, int, int, int, int);

    sipVH__aui_24(sipGILState, 0, sipPySelf, sipMeth, x, y, width, height);
}

::wxSize sipwxAuiFloatingFrame::DoGetBorderSize() const
{
    sip_gilstate_t sipGILState;
    PyObject *sipMeth;

    sipMeth = sipIsPyMethod(&sipGILState, const_cast<char *>(&sipPyMethods[9]), const_cast<sipSimpleWrapper **>(&sipPySelf), SIP_NULLPTR, sipName_DoGetBorderSize);

    if (!sipMeth)
        return ::wxAuiFloatingFrame::DoGetBorderSize();

    extern ::wxSize sipVH__aui_23(sip_gilstate_t, sipVirtErrorHandlerFunc, sipSimpleWrapper *, PyObject *);

    return sipVH__aui_23(sipGILState, 0, sipPySelf, sipMeth);
}

void sipwxAuiFloatingFrame::DoSetSizeHints(int minW, int minH, int maxW, int maxH, int incW, int incH)
{
    sip_gilstate_t sipGILState;
    PyObject *sipMeth;

    sipMeth = sipIsPyMethod(&sipGILState, &sipPyMethods[10], &sipPySelf, SIP_NULLPTR, sipName_DoSetSizeHints);

    if (!sipMeth)
    {
        ::wxAuiFloatingFrame::DoSetSizeHints(minW, minH, maxW, maxH, incW, incH);
        return;
    }

    extern void sipVH__aui_22(sip_gilstate_t, sipVirtErrorHandlerFunc, sipSimpleWrapper *, PyObject *, int, int, int, int, int, int);

    sipVH__aui_22(sipGILState, 0, sipPySelf, sipMeth, minW, minH, maxW, maxH, incW, incH);
}

void sipwxAuiFloatingFrame::DoSetClientSize(int width, int height)
{
    sip_gilstate_t sipGILState;
    PyObject *sipMeth;

    sipMeth = sipIsPyMethod(&sipGILState, &sipPyMethods[11], &sipPySelf, SIP_NULLPTR, sipName_DoSetClientSize);

    if (!sipMeth)
    {
        ::wxAuiFloatingFrame::DoSetClientSize(width, height);
        return;
    }

    extern void sipVH__aui_21(sip_gilstate_t, sipVirtErrorHandlerFunc, sipSimpleWrapper *, PyObject *, int, int);

    sipVH__aui_21(sipGILState, 0, sipPySelf, sipMeth, width, height);
}

void sipwxAuiFloatingFrame::DoSetSize(int x, int y, int width, int height, int sizeFlags)
{
    sip_gilstate_t sipGILState;
    PyObject *sipMeth;

    sipMeth = sipIsPyMethod(&sipGILState, &sipPyMethods[12], &sipPySelf, SIP_NULLPTR, sipName_DoSetSize);

    if (!sipMeth)
    {
        ::wxAuiFloatingFrame::DoSetSize(x, y, width, height, sizeFlags);
        return;
    }

    extern void sipVH__aui_20(sip_gilstate_t, sipVirtErrorHandlerFunc, sipSimpleWrapper *, PyObject *, int, int, int, int, int);

    sipVH__aui_20(sipGILState, 0, sipPySelf, sipMeth, x, y, width, height, sizeFlags);
}

void sipwxAuiFloatingFrame::DoGetClientSize(int*width, int*height) const
{
    sip_gilstate_t sipGILState;
    PyObject *sipMeth;

    sipMeth = sipIsPyMethod(&sipGILState, const_cast<char *>(&sipPyMethods[13]), const_cast<sipSimpleWrapper **>(&sipPySelf), SIP_NULLPTR, sipName_DoGetClientSize);

    if (!sipMeth)
    {
        ::wxAuiFloatingFrame::DoGetClientSize(width, height);
        return;
    }

    extern void sipVH__aui_19(sip_gilstate_t, sipVirtErrorHandlerFunc, sipSimpleWrapper *, PyObject *, int*, int*);

    sipVH__aui_19(sipGILState, 0, sipPySelf, sipMeth, width, height);
}

void sipwxAuiFloatingFrame::DoGetSize(int*width, int*height) const
{
    sip_gilstate_t sipGILState;
    PyObject *sipMeth;

    sipMeth = sipIsPyMethod(&sipGILState, const_cast<char *>(&sipPyMethods[14]), const_cast<sipSimpleWrapper **>(&sipPySelf), SIP_NULLPTR, sipName_DoGetSize);

    if (!sipMeth)
    {
        ::wxAuiFloatingFrame::DoGetSize(width, height);
        return;
    }

    extern void sipVH__aui_19(sip_gilstate_t, sipVirtErrorHandlerFunc, sipSimpleWrapper *, PyObject *, int*, int*);

    sipVH__aui_19(sipGILState, 0, sipPySelf, sipMeth, width, height);
}

void sipwxAuiFloatingFrame::DoGetPosition(int*x, int*y) const
{
    sip_gilstate_t sipGILState;
    PyObject *sipMeth;

    sipMeth = sipIsPyMethod(&sipGILState, const_cast<char *>(&sipPyMethods[15]), const_cast<sipSimpleWrapper **>(&sipPySelf), SIP_NULLPTR, sipName_DoGetPosition);

    if (!sipMeth)
    {
        ::wxAuiFloatingFrame::DoGetPosition(x, y);
        return;
    }

    extern void sipVH__aui_19(sip_gilstate_t, sipVirtErrorHandlerFunc, sipSimpleWrapper *, PyObject *, int*, int*);

    sipVH__aui_19(sipGILState, 0, sipPySelf, sipMeth, x, y);
}

void sipwxAuiFloatingFrame::DoEnable(bool enable)
{
    sip_gilstate_t sipGILState;
    PyObject *sipMeth;

    sipMeth = sipIsPyMethod(&sipGILState, &sipPyMethods[16], &sipPySelf, SIP_NULLPTR, sipName_DoEnable);

    if (!sipMeth)
    {
        ::wxAuiFloatingFrame::DoEnable(enable);
        return;
    }

    extern void sipVH__aui_13(sip_gilstate_t, sipVirtErrorHandlerFunc, sipSimpleWrapper *, PyObject *, bool);

    sipVH__aui_13(sipGILState, 0, sipPySelf, sipMeth, enable);
}

::wxWindow* sipwxAuiFloatingFrame::GetMainWindowOfCompositeControl()
{
    sip_gilstate_t sipGILState;
    PyObject *sipMeth;

    sipMeth = sipIsPyMethod(&sipGILState, &sipPyMethods[17], &sipPySelf, SIP_NULLPTR, sipName_GetMainWindowOfCompositeControl);

    if (!sipMeth)
        return ::wxAuiFloatingFrame::GetMainWindowOfCompositeControl();

    extern ::wxWindow* sipVH__aui_18(sip_gilstate_t, sipVirtErrorHandlerFunc, sipSimpleWrapper *, PyObject *);

    return sipVH__aui_18(sipGILState, 0, sipPySelf, sipMeth);
}

void sipwxAuiFloatingFrame::OnInternalIdle()
{
    sip_gilstate_t sipGILState;
    PyObject *sipMeth;

    sipMeth = sipIsPyMethod(&sipGILState, &sipPyMethods[18], &sipPySelf, SIP_NULLPTR, sipName_OnInternalIdle);

    if (!sipMeth)
    {
        ::wxAuiFloatingFrame::OnInternalIdle();
        return;
    }

    extern void sipVH__aui_3(sip_gilstate_t, sipVirtErrorHandlerFunc, sipSimpleWrapper *, PyObject *);

    sipVH__aui_3(sipGILState, 0, sipPySelf, sipMeth);
}

void sipwxAuiFloatingFrame::InitDialog()
{
    sip_gilstate_t sipGILState;
    PyObject *sipMeth;

    sipMeth = sipIsPyMethod(&sipGILState, &sipPyMethods[19], &sipPySelf, SIP_NULLPTR, sipName_InitDialog);

    if (!sipMeth)
    {
        ::wxAuiFloatingFrame::InitDialog();
        return;
    }

    extern void sipVH__aui_3(sip_gilstate_t, sipVirtErrorHandlerFunc, sipSimpleWrapper *, PyObject *);

    sipVH__aui_3(sipGILState, 0, sipPySelf, sipMeth);
}

void sipwxAuiFloatingFrame::InheritAttributes()
{
    sip_gilstate_t sipGILState;
    PyObject *sipMeth;

    sipMeth = sipIsPyMethod(&sipGILState, &sipPyMethods[20], &sipPySelf, SIP_NULLPTR, sipName_InheritAttributes);

    if (!sipMeth)
    {
        ::wxAuiFloatingFrame::InheritAttributes();
        return;
    }

    extern void sipVH__aui_3(sip_gilstate_t, sipVirtErrorHandlerFunc, sipSimpleWrapper *, PyObject *);

    sipVH__aui_3(sipGILState, 0, sipPySelf, sipMeth);
}

bool sipwxAuiFloatingFrame::Destroy()
{
    sip_gilstate_t sipGILState;
    PyObject *sipMeth;

    sipMeth = sipIsPyMethod(&sipGILState, &sipPyMethods[21], &sipPySelf, SIP_NULLPTR, sipName_Destroy);

    if (!sipMeth)
        return ::wxAuiFloatingFrame::Destroy();

    extern bool sipVH__aui_12(sip_gilstate_t, sipVirtErrorHandlerFunc, sipSimpleWrapper *, PyObject *);

    return sipVH__aui_12(sipGILState, 0, sipPySelf, sipMeth);
}

bool sipwxAuiFloatingFrame::Validate()
{
    sip_gilstate_t sipGILState;
    PyObject *sipMeth;

    sipMeth = sipIsPyMethod(&sipGILState, &sipPyMethods[22], &sipPySelf, SIP_NULLPTR, sipName_Validate);

    if (!sipMeth)
        return ::wxAuiFloatingFrame::Validate();

    extern bool sipVH__aui_12(sip_gilstate_t, sipVirtErrorHandlerFunc, sipSimpleWrapper *, PyObject *);

    return sipVH__aui_12(sipGILState, 0, sipPySelf, sipMeth);
}

bool sipwxAuiFloatingFrame::TransferDataToWindow()
{
    sip_gilstate_t sipGILState;
    PyObject *sipMeth;

    sipMeth = sipIsPyMethod(&sipGILState, &sipPyMethods[23], &sipPySelf, SIP_NULLPTR, sipName_TransferDataToWindow);

    if (!sipMeth)
        return ::wxAuiFloatingFrame::TransferDataToWindow();

    extern bool sipVH__aui_12(sip_gilstate_t, sipVirtErrorHandlerFunc, sipSimpleWrapper *, PyObject *);

    return sipVH__aui_12(sipGILState, 0, sipPySelf, sipMeth);
}

bool sipwxAuiFloatingFrame::TransferDataFromWindow()
{
    sip_gilstate_t sipGILState;
    PyObject *sipMeth;

    sipMeth = sipIsPyMethod(&sipGILState, &sipPyMethods[24], &sipPySelf, SIP_NULLPTR, sipName_TransferDataFromWindow);

    if (!sipMeth)
        return ::wxAuiFloatingFrame::TransferDataFromWindow();

    extern bool sipVH__aui_12(sip_gilstate_t, sipVirtErrorHandlerFunc, sipSimpleWrapper *, PyObject *);

    return sipVH__aui_12(sipGILState, 0, sipPySelf, sipMeth);
}

void sipwxAuiFloatingFrame::SetValidator(const ::wxValidator& validator)
{
    sip_gilstate_t sipGILState;
    PyObject *sipMeth;

    sipMeth = sipIsPyMethod(&sipGILState, &sipPyMethods[25], &sipPySelf, SIP_NULLPTR, sipName_SetValidator);

    if (!sipMeth)
    {
        ::wxAuiFloatingFrame::SetValidator(validator);
        return;
    }

    extern void sipVH__aui_17(sip_gilstate_t, sipVirtErrorHandlerFunc, sipSimpleWrapper *, PyObject *, const ::wxValidator&);

    sipVH__aui_17(sipGILState, 0, sipPySelf, sipMeth, validator);
}

::wxValidator* sipwxAuiFloatingFrame::GetValidator()
{
    sip_gilstate_t sipGILState;
    PyObject *sipMeth;

    sipMeth = sipIsPyMethod(&sipGILState, &sipPyMethods[26], &sipPySelf, SIP_NULLPTR, sipName_GetValidator);

    if (!sipMeth)
        return ::wxAuiFloatingFrame::GetValidator();

    extern ::wxValidator* sipVH__aui_16(sip_gilstate_t, sipVirtErrorHandlerFunc, sipSimpleWrapper *, PyObject *);

    return sipVH__aui_16(sipGILState, 0, sipPySelf, sipMeth);
}

bool sipwxAuiFloatingFrame::ShouldInheritColours() const
{
    sip_gilstate_t sipGILState;
    PyObject *sipMeth;

    sipMeth = sipIsPyMethod(&sipGILState, const_cast<char *>(&sipPyMethods[27]), const_cast<sipSimpleWrapper **>(&sipPySelf), SIP_NULLPTR, sipName_ShouldInheritColours);

    if (!sipMeth)
        return ::wxAuiFloatingFrame::ShouldInheritColours();

    extern bool sipVH__aui_12(sip_gilstate_t, sipVirtErrorHandlerFunc, sipSimpleWrapper *, PyObject *);

    return sipVH__aui_12(sipGILState, 0, sipPySelf, sipMeth);
}

bool sipwxAuiFloatingFrame::HasTransparentBackground()
{
    sip_gilstate_t sipGILState;
    PyObject *sipMeth;

    sipMeth = sipIsPyMethod(&sipGILState, &sipPyMethods[28], &sipPySelf, SIP_NULLPTR, sipName_HasTransparentBackground);

    if (!sipMeth)
        return ::wxAuiFloatingFrame::HasTransparentBackground();

    extern bool sipVH__aui_12(sip_gilstate_t, sipVirtErrorHandlerFunc, sipSimpleWrapper *, PyObject *);

    return sipVH__aui_12(sipGILState, 0, sipPySelf, sipMeth);
}

::wxPoint sipwxAuiFloatingFrame::GetClientAreaOrigin() const
{
    sip_gilstate_t sipGILState;
    PyObject *sipMeth;

    sipMeth = sipIsPyMethod(&sipGILState, const_cast<char *>(&sipPyMethods[29]), const_cast<sipSimpleWrapper **>(&sipPySelf), SIP_NULLPTR, sipName_GetClientAreaOrigin);

    if (!sipMeth)
        return ::wxAuiFloatingFrame::GetClientAreaOrigin();

    extern ::wxPoint sipVH__aui_15(sip_gilstate_t, sipVirtErrorHandlerFunc, sipSimpleWrapper *, PyObject *);

    return sipVH__aui_15(sipGILState, 0, sipPySelf, sipMeth);
}

bool sipwxAuiFloatingFrame::InformFirstDirection(int direction, int size, int availableOtherDir)
{
    sip_gilstate_t sipGILState;
    PyObject *sipMeth;

    sipMeth = sipIsPyMethod(&sipGILState, &sipPyMethods[30], &sipPySelf, SIP_NULLPTR, sipName_InformFirstDirection);

    if (!sipMeth)
        return ::wxAuiFloatingFrame::InformFirstDirection(direction, size, availableOtherDir);

    extern bool sipVH__aui_14(sip_gilstate_t, sipVirtErrorHandlerFunc, sipSimpleWrapper *, PyObject *, int, int, int);

    return sipVH__aui_14(sipGILState, 0, sipPySelf, sipMeth, direction, size, availableOtherDir);
}

void sipwxAuiFloatingFrame::EnableVisibleFocus(bool enabled)
{
    sip_gilstate_t sipGILState;
    PyObject *sipMeth;

    sipMeth = sipIsPyMethod(&sipGILState, &sipPyMethods[31], &sipPySelf, SIP_NULLPTR, sipName_EnableVisibleFocus);

    if (!sipMeth)
    {
        ::wxAuiFloatingFrame::EnableVisibleFocus(enabled);
        return;
    }

    extern void sipVH__aui_13(sip_gilstate_t, sipVirtErrorHandlerFunc, sipSimpleWrapper *, PyObject *, bool);

    sipVH__aui_13(sipGILState, 0, sipPySelf, sipMeth, enabled);
}

void sipwxAuiFloatingFrame::SetCanFocus(bool canFocus)
{
    sip_gilstate_t sipGILState;
    PyObject *sipMeth;

    sipMeth = sipIsPyMethod(&sipGILState, &sipPyMethods[32], &sipPySelf, SIP_NULLPTR, sipName_SetCanFocus);

    if (!sipMeth)
    {
        ::wxAuiFloatingFrame::SetCanFocus(canFocus);
        return;
    }

    extern void sipVH__aui_13(sip_gilstate_t, sipVirtErrorHandlerFunc, sipSimpleWrapper *, PyObject *, bool);

    sipVH__aui_13(sipGILState, 0, sipPySelf, sipMeth, canFocus);
}

bool sipwxAuiFloatingFrame::AcceptsFocusRecursively() const
{
    sip_gilstate_t sipGILState;
    PyObject *sipMeth;

    sipMeth = sipIsPyMethod(&sipGILState, const_cast<char *>(&sipPyMethods[33]), const_cast<sipSimpleWrapper **>(&sipPySelf), SIP_NULLPTR, sipName_AcceptsFocusRecursively);

    if (!sipMeth)
        return ::wxAuiFloatingFrame::AcceptsFocusRecursively();

    extern bool sipVH__aui_12(sip_gilstate_t, sipVirtErrorHandlerFunc, sipSimpleWrapper *, PyObject *);

    return sipVH__aui_12(sipGILState, 0, sipPySelf, sipMeth);
}

bool sipwxAuiFloatingFrame::AcceptsFocusFromKeyboard() const
{
    sip_gilstate_t sipGILState;
    PyObject *sipMeth;

    sipMeth = sipIsPyMethod(&sipGILState, const_cast<char *>(&sipPyMethods[34]), const_cast<sipSimpleWrapper **>(&sipPySelf), SIP_NULLPTR, sipName_AcceptsFocusFromKeyboard);

    if (!sipMeth)
        return ::wxAuiFloatingFrame::AcceptsFocusFromKeyboard();

    extern bool sipVH__aui_12(sip_gilstate_t, sipVirtErrorHandlerFunc, sipSimpleWrapper *, PyObject *);

    return sipVH__aui_12(sipGILState, 0, sipPySelf, sipMeth);
}

bool sipwxAuiFloatingFrame::AcceptsFocus() const
{
    sip_gilstate_t sipGILState;
    PyObject *sipMeth;

    sipMeth = sipIsPyMethod(&sipGILState, const_cast<char *>(&sipPyMethods[35]), const_cast<sipSimpleWrapper **>(&sipPySelf), SIP_NULLPTR, sipName_AcceptsFocus);

    if (!sipMeth)
        return ::wxAuiFloatingFrame::AcceptsFocus();

    extern bool sipVH__aui_12(sip_gilstate_t, sipVirtErrorHandlerFunc, sipSimpleWrapper *, PyObject *);

    return sipVH__aui_12(sipGILState, 0, sipPySelf, sipMeth);
}

bool sipwxAuiFloatingFrame::TryAfter(::wxEvent& event)
{
    sip_gilstate_t sipGILState;
    PyObject *sipMeth;

    sipMeth = sipIsPyMethod(&sipGILState, &sipPyMethods[36], &sipPySelf, SIP_NULLPTR, sipName_TryAfter);

    if (!sipMeth)
        return ::wxAuiFloatingFrame::TryAfter(event);

    extern bool sipVH__aui_0(sip_gilstate_t, sipVirtErrorHandlerFunc, sipSimpleWrapper *, PyObject *, ::wxEvent&);

    return sipVH__aui_0(sipGILState, 0, sipPySelf, sipMeth, event);
}

bool sipwxAuiFloatingFrame::TryBefore(::wxEvent& event)
{
    sip_gilstate_t sipGILState;
    PyObject *sipMeth;

    sipMeth = sipIsPyMethod(&sipGILState, &sipPyMethods[37], &sipPySelf, SIP_NULLPTR, sipName_TryBefore);

    if (!sipMeth)
        return ::wxAuiFloatingFrame::TryBefore(event);

    extern bool sipVH__aui_0(sip_gilstate_t, sipVirtErrorHandlerFunc, sipSimpleWrapper *, PyObject *, ::wxEvent&);

    return sipVH__aui_0(sipGILState, 0, sipPySelf, sipMeth, event);
}

bool sipwxAuiFloatingFrame::ProcessEvent(::wxEvent& event)
{
    sip_gilstate_t sipGILState;
    PyObject *sipMeth;

    sipMeth = sipIsPyMethod(&sipGILState, &sipPyMethods[38], &sipPySelf, SIP_NULLPTR, sipName_ProcessEvent);

    if (!sipMeth)
        return ::wxAuiFloatingFrame::ProcessEvent(event);

    extern bool sipVH__aui_0(sip_gilstate_t, sipVirtErrorHandlerFunc, sipSimpleWrapper *, PyObject *, ::wxEvent&);

    return sipVH__aui_0(sipGILState, 0, sipPySelf, sipMeth, event);
}

void sipwxAuiFloatingFrame::AddChild(::wxWindowBase*child)
{
    sip_gilstate_t sipGILState;
    PyObject *sipMeth;

    sipMeth = sipIsPyMethod(&sipGILState, &sipPyMethods[39], &sipPySelf, SIP_NULLPTR, sipName_AddChild);

    if (!sipMeth)
    {
        ::wxAuiFloatingFrame::AddChild(child);
        return;
    }

    extern void sipVH__aui_11(sip_gilstate_t, sipVirtErrorHandlerFunc, sipSimpleWrapper *, PyObject *, ::wxWindowBase*);

    sipVH__aui_11(sipGILState, 0, sipPySelf, sipMeth, child);
}

void sipwxAuiFloatingFrame::RemoveChild(::wxWindowBase*child)
{
    sip_gilstate_t sipGILState;
    PyObject *sipMeth;

    sipMeth = sipIsPyMethod(&sipGILState, &sipPyMethods[40], &sipPySelf, SIP_NULLPTR, sipName_RemoveChild);

    if (!sipMeth)
    {
        ::wxAuiFloatingFrame::RemoveChild(child);
        return;
    }

    extern void sipVH__aui_11(sip_gilstate_t, sipVirtErrorHandlerFunc, sipSimpleWrapper *, PyObject *, ::wxWindowBase*);

    sipVH__aui_11(sipGILState, 0, sipPySelf, sipMeth, child);
}

void sipwxAuiFloatingFrame::DoGiveHelp(const ::wxString& text, bool show)
{
    sip_gilstate_t sipGILState;
    PyObject *sipMeth;

    sipMeth = sipIsPyMethod(&sipGILState, &sipPyMethods[41], &sipPySelf, SIP_NULLPTR, sipName_DoGiveHelp);

    if (!sipMeth)
    {
        ::wxAuiFloatingFrame::DoGiveHelp(text, show);
        return;
    }

    extern void sipVH__aui_10(sip_gilstate_t, sipVirtErrorHandlerFunc, sipSimpleWrapper *, PyObject *, const ::wxString&, bool);

    sipVH__aui_10(sipGILState, 0, sipPySelf, sipMeth, text, show);
}

::wxStatusBar* sipwxAuiFloatingFrame::OnCreateStatusBar(int number, long style, ::wxWindowID id, const ::wxString& name)
{
    sip_gilstate_t sipGILState;
    PyObject *sipMeth;

    sipMeth = sipIsPyMethod(&sipGILState, &sipPyMethods[42], &sipPySelf, SIP_NULLPTR, sipName_OnCreateStatusBar);

    if (!sipMeth)
        return ::wxAuiFloatingFrame::OnCreateStatusBar(number, style, id, name);

    extern ::wxStatusBar* sipVH__aui_9(sip_gilstate_t, sipVirtErrorHandlerFunc, sipSimpleWrapper *, PyObject *, int, long, ::wxWindowID, const ::wxString&);

    return sipVH__aui_9(sipGILState, 0, sipPySelf, sipMeth, number, style, id, name);
}

::wxToolBar* sipwxAuiFloatingFrame::OnCreateToolBar(long style, ::wxWindowID id, const ::wxString& name)
{
    sip_gilstate_t sipGILState;
    PyObject *sipMeth;

    sipMeth = sipIsPyMethod(&sipGILState, &sipPyMethods[43], &sipPySelf, SIP_NULLPTR, sipName_OnCreateToolBar);

    if (!sipMeth)
        return ::wxAuiFloatingFrame::OnCreateToolBar(style, id, name);

    extern ::wxToolBar* sipVH__aui_8(sip_gilstate_t, sipVirtErrorHandlerFunc, sipSimpleWrapper *, PyObject *, long, ::wxWindowID, const ::wxString&);

    return sipVH__aui_8(sipGILState, 0, sipPySelf, sipMeth, style, id, name);
}

void sipwxAuiFloatingFrame::sipProtect_SendDestroyEvent()
{
    ::wxWindow::SendDestroyEvent();
}

bool sipwxAuiFloatingFrame::sipProtectVirt_ProcessEvent(bool sipSelfWasArg, ::wxEvent& event)
{
    return (sipSelfWasArg ? ::wxFrame::ProcessEvent(event) : ProcessEvent(event));
}

void sipwxAuiFloatingFrame::sipProtectVirt_DoEnable(bool sipSelfWasArg, bool enable)
{
    (sipSelfWasArg ? ::wxFrame::DoEnable(enable) : DoEnable(enable));
}

void sipwxAuiFloatingFrame::sipProtectVirt_DoGetPosition(bool sipSelfWasArg, int*x, int*y) const
{
    (sipSelfWasArg ? ::wxFrame::DoGetPosition(x, y) : DoGetPosition(x, y));
}

void sipwxAuiFloatingFrame::sipProtectVirt_DoGetSize(bool sipSelfWasArg, int*width, int*height) const
{
    (sipSelfWasArg ? ::wxFrame::DoGetSize(width, height) : DoGetSize(width, height));
}

void sipwxAuiFloatingFrame::sipProtectVirt_DoGetClientSize(bool sipSelfWasArg, int*width, int*height) const
{
    (sipSelfWasArg ? ::wxFrame::DoGetClientSize(width, height) : DoGetClientSize(width, height));
}

::wxSize sipwxAuiFloatingFrame::sipProtectVirt_DoGetBestSize(bool sipSelfWasArg) const
{
    return (sipSelfWasArg ? ::wxFrame::DoGetBestSize() : DoGetBestSize());
}

::wxSize sipwxAuiFloatingFrame::sipProtectVirt_DoGetBestClientSize(bool sipSelfWasArg) const
{
    return (sipSelfWasArg ? ::wxFrame::DoGetBestClientSize() : DoGetBestClientSize());
}

void sipwxAuiFloatingFrame::sipProtectVirt_DoSetSize(bool sipSelfWasArg, int x, int y, int width, int height, int sizeFlags)
{
    (sipSelfWasArg ? ::wxFrame::DoSetSize(x, y, width, height, sizeFlags) : DoSetSize(x, y, width, height, sizeFlags));
}

void sipwxAuiFloatingFrame::sipProtectVirt_DoSetClientSize(bool sipSelfWasArg, int width, int height)
{
    (sipSelfWasArg ? ::wxFrame::DoSetClientSize(width, height) : DoSetClientSize(width, height));
}

void sipwxAuiFloatingFrame::sipProtectVirt_DoSetSizeHints(bool sipSelfWasArg, int minW, int minH, int maxW, int maxH, int incW, int incH)
{
    (sipSelfWasArg ? ::wxFrame::DoSetSizeHints(minW, minH, maxW, maxH, incW, incH) : DoSetSizeHints(minW, minH, maxW, maxH, incW, incH));
}

::wxSize sipwxAuiFloatingFrame::sipProtectVirt_DoGetBorderSize(bool sipSelfWasArg) const
{
    return (sipSelfWasArg ? ::wxFrame::DoGetBorderSize() : DoGetBorderSize());
}

void sipwxAuiFloatingFrame::sipProtectVirt_DoMoveWindow(bool sipSelfWasArg, int x, int y, int width, int height)
{
    (sipSelfWasArg ? ::wxFrame::DoMoveWindow(x, y, width, height) : DoMoveWindow(x, y, width, height));
}

void sipwxAuiFloatingFrame::sipProtectVirt_DoSetWindowVariant(bool sipSelfWasArg, ::wxWindowVariant variant)
{
    (sipSelfWasArg ? ::wxFrame::DoSetWindowVariant(variant) : DoSetWindowVariant(variant));
}

::wxBorder sipwxAuiFloatingFrame::sipProtectVirt_GetDefaultBorder(bool sipSelfWasArg) const
{
    return (sipSelfWasArg ? ::wxFrame::GetDefaultBorder() : GetDefaultBorder());
}

::wxBorder sipwxAuiFloatingFrame::sipProtectVirt_GetDefaultBorderForControl(bool sipSelfWasArg) const
{
    return (sipSelfWasArg ? ::wxFrame::GetDefaultBorderForControl() : GetDefaultBorderForControl());
}

void sipwxAuiFloatingFrame::sipProtectVirt_DoFreeze(bool sipSelfWasArg)
{
    (sipSelfWasArg ? ::wxFrame::DoFreeze() : DoFreeze());
}

void sipwxAuiFloatingFrame::sipProtectVirt_DoThaw(bool sipSelfWasArg)
{
    (sipSelfWasArg ? ::wxFrame::DoThaw() : DoThaw());
}

bool sipwxAuiFloatingFrame::sipProtectVirt_HasTransparentBackground(bool sipSelfWasArg)
{
    return (sipSelfWasArg ? ::wxFrame::HasTransparentBackground() : HasTransparentBackground());
}

bool sipwxAuiFloatingFrame::sipProtectVirt_TryBefore(bool sipSelfWasArg, ::wxEvent& event)
{
    return (sipSelfWasArg ? ::wxFrame::TryBefore(event) : TryBefore(event));
}

bool sipwxAuiFloatingFrame::sipProtectVirt_TryAfter(bool sipSelfWasArg, ::wxEvent& event)
{
    return (sipSelfWasArg ? ::wxFrame::TryAfter(event) : TryAfter(event));
}


PyDoc_STRVAR(doc_wxAuiFloatingFrame_SendDestroyEvent, "SendDestroyEvent()\n"
"\n"
"Generate wxWindowDestroyEvent for this window.");

extern "C" {static PyObject *meth_wxAuiFloatingFrame_SendDestroyEvent(PyObject *, PyObject *);}
static PyObject *meth_wxAuiFloatingFrame_SendDestroyEvent(PyObject *sipSelf, PyObject *sipArgs)
{
    PyObject *sipParseErr = SIP_NULLPTR;

    {
        sipwxAuiFloatingFrame *sipCpp;

        if (sipParseArgs(&sipParseErr, sipArgs, "B", &sipSelf, sipType_wxAuiFloatingFrame, &sipCpp))
        {
            PyErr_Clear();

            Py_BEGIN_ALLOW_THREADS
            sipCpp->sipProtect_SendDestroyEvent();
            Py_END_ALLOW_THREADS

            if (PyErr_Occurred())
                return 0;

            Py_INCREF(Py_None);
            return Py_None;
        }
    }

    sipNoMethod(sipParseErr, sipName_AuiFloatingFrame, sipName_SendDestroyEvent, SIP_NULLPTR);

    return SIP_NULLPTR;
}


PyDoc_STRVAR(doc_wxAuiFloatingFrame_ProcessEvent, "ProcessEvent(self, event: Event) -> bool");

extern "C" {static PyObject *meth_wxAuiFloatingFrame_ProcessEvent(PyObject *, PyObject *, PyObject *);}
static PyObject *meth_wxAuiFloatingFrame_ProcessEvent(PyObject *sipSelf, PyObject *sipArgs, PyObject *sipKwds)
{
    PyObject *sipParseErr = SIP_NULLPTR;
    bool sipSelfWasArg = (!sipSelf || sipIsDerivedClass((sipSimpleWrapper *)sipSelf));

    {
        ::wxEvent* event;
        sipwxAuiFloatingFrame *sipCpp;

        static const char *sipKwdList[] = {
            sipName_event,
        };

        if (sipParseKwdArgs(&sipParseErr, sipArgs, sipKwds, sipKwdList, SIP_NULLPTR, "BJ9", &sipSelf, sipType_wxAuiFloatingFrame, &sipCpp, sipType_wxEvent, &event))
        {
            bool sipRes;

            PyErr_Clear();

            Py_BEGIN_ALLOW_THREADS
            sipRes = sipCpp->sipProtectVirt_ProcessEvent(sipSelfWasArg, *event);
            Py_END_ALLOW_THREADS

            if (PyErr_Occurred())
                return 0;

            return PyBool_FromLong(sipRes);
        }
    }

    sipNoMethod(sipParseErr, sipName_AuiFloatingFrame, sipName_ProcessEvent, doc_wxAuiFloatingFrame_ProcessEvent);

    return SIP_NULLPTR;
}


PyDoc_STRVAR(doc_wxAuiFloatingFrame_DoEnable, "DoEnable(self, enable: bool)");

extern "C" {static PyObject *meth_wxAuiFloatingFrame_DoEnable(PyObject *, PyObject *, PyObject *);}
static PyObject *meth_wxAuiFloatingFrame_DoEnable(PyObject *sipSelf, PyObject *sipArgs, PyObject *sipKwds)
{
    PyObject *sipParseErr = SIP_NULLPTR;
    bool sipSelfWasArg = (!sipSelf || sipIsDerivedClass((sipSimpleWrapper *)sipSelf));

    {
        bool enable;
        sipwxAuiFloatingFrame *sipCpp;

        static const char *sipKwdList[] = {
            sipName_enable,
        };

        if (sipParseKwdArgs(&sipParseErr, sipArgs, sipKwds, sipKwdList, SIP_NULLPTR, "Bb", &sipSelf, sipType_wxAuiFloatingFrame, &sipCpp, &enable))
        {
            PyErr_Clear();

            Py_BEGIN_ALLOW_THREADS
            sipCpp->sipProtectVirt_DoEnable(sipSelfWasArg, enable);
            Py_END_ALLOW_THREADS

            if (PyErr_Occurred())
                return 0;

            Py_INCREF(Py_None);
            return Py_None;
        }
    }

    sipNoMethod(sipParseErr, sipName_AuiFloatingFrame, sipName_DoEnable, doc_wxAuiFloatingFrame_DoEnable);

    return SIP_NULLPTR;
}


PyDoc_STRVAR(doc_wxAuiFloatingFrame_DoGetPosition, "DoGetPosition(self) -> (int, int)");

extern "C" {static PyObject *meth_wxAuiFloatingFrame_DoGetPosition(PyObject *, PyObject *, PyObject *);}
static PyObject *meth_wxAuiFloatingFrame_DoGetPosition(PyObject *sipSelf, PyObject *sipArgs, PyObject *sipKwds)
{
    PyObject *sipParseErr = SIP_NULLPTR;
    bool sipSelfWasArg = (!sipSelf || sipIsDerivedClass((sipSimpleWrapper *)sipSelf));

    {
        int x;
        int y;
        const sipwxAuiFloatingFrame *sipCpp;

        if (sipParseKwdArgs(&sipParseErr, sipArgs, sipKwds, SIP_NULLPTR, SIP_NULLPTR, "B", &sipSelf, sipType_wxAuiFloatingFrame, &sipCpp))
        {
            PyErr_Clear();

            Py_BEGIN_ALLOW_THREADS
            sipCpp->sipProtectVirt_DoGetPosition(sipSelfWasArg, &x, &y);
            Py_END_ALLOW_THREADS

            if (PyErr_Occurred())
                return 0;

            return sipBuildResult(0, "(ii)", x, y);
        }
    }

    sipNoMethod(sipParseErr, sipName_AuiFloatingFrame, sipName_DoGetPosition, doc_wxAuiFloatingFrame_DoGetPosition);

    return SIP_NULLPTR;
}


PyDoc_STRVAR(doc_wxAuiFloatingFrame_DoGetSize, "DoGetSize(self) -> (int, int)");

extern "C" {static PyObject *meth_wxAuiFloatingFrame_DoGetSize(PyObject *, PyObject *, PyObject *);}
static PyObject *meth_wxAuiFloatingFrame_DoGetSize(PyObject *sipSelf, PyObject *sipArgs, PyObject *sipKwds)
{
    PyObject *sipParseErr = SIP_NULLPTR;
    bool sipSelfWasArg = (!sipSelf || sipIsDerivedClass((sipSimpleWrapper *)sipSelf));

    {
        int width;
        int height;
        const sipwxAuiFloatingFrame *sipCpp;

        if (sipParseKwdArgs(&sipParseErr, sipArgs, sipKwds, SIP_NULLPTR, SIP_NULLPTR, "B", &sipSelf, sipType_wxAuiFloatingFrame, &sipCpp))
        {
            PyErr_Clear();

            Py_BEGIN_ALLOW_THREADS
            sipCpp->sipProtectVirt_DoGetSize(sipSelfWasArg, &width, &height);
            Py_END_ALLOW_THREADS

            if (PyErr_Occurred())
                return 0;

            return sipBuildResult(0, "(ii)", width, height);
        }
    }

    sipNoMethod(sipParseErr, sipName_AuiFloatingFrame, sipName_DoGetSize, doc_wxAuiFloatingFrame_DoGetSize);

    return SIP_NULLPTR;
}


PyDoc_STRVAR(doc_wxAuiFloatingFrame_DoGetClientSize, "DoGetClientSize(self) -> (int, int)");

extern "C" {static PyObject *meth_wxAuiFloatingFrame_DoGetClientSize(PyObject *, PyObject *, PyObject *);}
static PyObject *meth_wxAuiFloatingFrame_DoGetClientSize(PyObject *sipSelf, PyObject *sipArgs, PyObject *sipKwds)
{
    PyObject *sipParseErr = SIP_NULLPTR;
    bool sipSelfWasArg = (!sipSelf || sipIsDerivedClass((sipSimpleWrapper *)sipSelf));

    {
        int width;
        int height;
        const sipwxAuiFloatingFrame *sipCpp;

        if (sipParseKwdArgs(&sipParseErr, sipArgs, sipKwds, SIP_NULLPTR, SIP_NULLPTR, "B", &sipSelf, sipType_wxAuiFloatingFrame, &sipCpp))
        {
            PyErr_Clear();

            Py_BEGIN_ALLOW_THREADS
            sipCpp->sipProtectVirt_DoGetClientSize(sipSelfWasArg, &width, &height);
            Py_END_ALLOW_THREADS

            if (PyErr_Occurred())
                return 0;

            return sipBuildResult(0, "(ii)", width, height);
        }
    }

    sipNoMethod(sipParseErr, sipName_AuiFloatingFrame, sipName_DoGetClientSize, doc_wxAuiFloatingFrame_DoGetClientSize);

    return SIP_NULLPTR;
}


PyDoc_STRVAR(doc_wxAuiFloatingFrame_DoGetBestSize, "DoGetBestSize(self) -> Size");

extern "C" {static PyObject *meth_wxAuiFloatingFrame_DoGetBestSize(PyObject *, PyObject *);}
static PyObject *meth_wxAuiFloatingFrame_DoGetBestSize(PyObject *sipSelf, PyObject *sipArgs)
{
    PyObject *sipParseErr = SIP_NULLPTR;
    bool sipSelfWasArg = (!sipSelf || sipIsDerivedClass((sipSimpleWrapper *)sipSelf));

    {
        const sipwxAuiFloatingFrame *sipCpp;

        if (sipParseArgs(&sipParseErr, sipArgs, "B", &sipSelf, sipType_wxAuiFloatingFrame, &sipCpp))
        {
            ::wxSize*sipRes;

            PyErr_Clear();

            Py_BEGIN_ALLOW_THREADS
            sipRes = new ::wxSize(sipCpp->sipProtectVirt_DoGetBestSize(sipSelfWasArg));
            Py_END_ALLOW_THREADS

            if (PyErr_Occurred())
                return 0;

            return sipConvertFromNewType(sipRes, sipType_wxSize, SIP_NULLPTR);
        }
    }

    sipNoMethod(sipParseErr, sipName_AuiFloatingFrame, sipName_DoGetBestSize, doc_wxAuiFloatingFrame_DoGetBestSize);

    return SIP_NULLPTR;
}


PyDoc_STRVAR(doc_wxAuiFloatingFrame_DoGetBestClientSize, "DoGetBestClientSize(self) -> Size");

extern "C" {static PyObject *meth_wxAuiFloatingFrame_DoGetBestClientSize(PyObject *, PyObject *);}
static PyObject *meth_wxAuiFloatingFrame_DoGetBestClientSize(PyObject *sipSelf, PyObject *sipArgs)
{
    PyObject *sipParseErr = SIP_NULLPTR;
    bool sipSelfWasArg = (!sipSelf || sipIsDerivedClass((sipSimpleWrapper *)sipSelf));

    {
        const sipwxAuiFloatingFrame *sipCpp;

        if (sipParseArgs(&sipParseErr, sipArgs, "B", &sipSelf, sipType_wxAuiFloatingFrame, &sipCpp))
        {
            ::wxSize*sipRes;

            PyErr_Clear();

            Py_BEGIN_ALLOW_THREADS
            sipRes = new ::wxSize(sipCpp->sipProtectVirt_DoGetBestClientSize(sipSelfWasArg));
            Py_END_ALLOW_THREADS

            if (PyErr_Occurred())
                return 0;

            return sipConvertFromNewType(sipRes, sipType_wxSize, SIP_NULLPTR);
        }
    }

    sipNoMethod(sipParseErr, sipName_AuiFloatingFrame, sipName_DoGetBestClientSize, doc_wxAuiFloatingFrame_DoGetBestClientSize);

    return SIP_NULLPTR;
}


PyDoc_STRVAR(doc_wxAuiFloatingFrame_DoSetSize, "DoSetSize(self, x: int, y: int, width: int, height: int, sizeFlags: int)");

extern "C" {static PyObject *meth_wxAuiFloatingFrame_DoSetSize(PyObject *, PyObject *, PyObject *);}
static PyObject *meth_wxAuiFloatingFrame_DoSetSize(PyObject *sipSelf, PyObject *sipArgs, PyObject *sipKwds)
{
    PyObject *sipParseErr = SIP_NULLPTR;
    bool sipSelfWasArg = (!sipSelf || sipIsDerivedClass((sipSimpleWrapper *)sipSelf));

    {
        int x;
        int y;
        int width;
        int height;
        int sizeFlags;
        sipwxAuiFloatingFrame *sipCpp;

        static const char *sipKwdList[] = {
            sipName_x,
            sipName_y,
            sipName_width,
            sipName_height,
            sipName_sizeFlags,
        };

        if (sipParseKwdArgs(&sipParseErr, sipArgs, sipKwds, sipKwdList, SIP_NULLPTR, "Biiiii", &sipSelf, sipType_wxAuiFloatingFrame, &sipCpp, &x, &y, &width, &height, &sizeFlags))
        {
            PyErr_Clear();

            Py_BEGIN_ALLOW_THREADS
            sipCpp->sipProtectVirt_DoSetSize(sipSelfWasArg, x, y, width, height, sizeFlags);
            Py_END_ALLOW_THREADS

            if (PyErr_Occurred())
                return 0;

            Py_INCREF(Py_None);
            return Py_None;
        }
    }

    sipNoMethod(sipParseErr, sipName_AuiFloatingFrame, sipName_DoSetSize, doc_wxAuiFloatingFrame_DoSetSize);

    return SIP_NULLPTR;
}


PyDoc_STRVAR(doc_wxAuiFloatingFrame_DoSetClientSize, "DoSetClientSize(self, width: int, height: int)");

extern "C" {static PyObject *meth_wxAuiFloatingFrame_DoSetClientSize(PyObject *, PyObject *, PyObject *);}
static PyObject *meth_wxAuiFloatingFrame_DoSetClientSize(PyObject *sipSelf, PyObject *sipArgs, PyObject *sipKwds)
{
    PyObject *sipParseErr = SIP_NULLPTR;
    bool sipSelfWasArg = (!sipSelf || sipIsDerivedClass((sipSimpleWrapper *)sipSelf));

    {
        int width;
        int height;
        sipwxAuiFloatingFrame *sipCpp;

        static const char *sipKwdList[] = {
            sipName_width,
            sipName_height,
        };

        if (sipParseKwdArgs(&sipParseErr, sipArgs, sipKwds, sipKwdList, SIP_NULLPTR, "Bii", &sipSelf, sipType_wxAuiFloatingFrame, &sipCpp, &width, &height))
        {
            PyErr_Clear();

            Py_BEGIN_ALLOW_THREADS
            sipCpp->sipProtectVirt_DoSetClientSize(sipSelfWasArg, width, height);
            Py_END_ALLOW_THREADS

            if (PyErr_Occurred())
                return 0;

            Py_INCREF(Py_None);
            return Py_None;
        }
    }

    sipNoMethod(sipParseErr, sipName_AuiFloatingFrame, sipName_DoSetClientSize, doc_wxAuiFloatingFrame_DoSetClientSize);

    return SIP_NULLPTR;
}


PyDoc_STRVAR(doc_wxAuiFloatingFrame_DoSetSizeHints, "DoSetSizeHints(self, minW: int, minH: int, maxW: int, maxH: int, incW: int, incH: int)");

extern "C" {static PyObject *meth_wxAuiFloatingFrame_DoSetSizeHints(PyObject *, PyObject *, PyObject *);}
static PyObject *meth_wxAuiFloatingFrame_DoSetSizeHints(PyObject *sipSelf, PyObject *sipArgs, PyObject *sipKwds)
{
    PyObject *sipParseErr = SIP_NULLPTR;
    bool sipSelfWasArg = (!sipSelf || sipIsDerivedClass((sipSimpleWrapper *)sipSelf));

    {
        int minW;
        int minH;
        int maxW;
        int maxH;
        int incW;
        int incH;
        sipwxAuiFloatingFrame *sipCpp;

        static const char *sipKwdList[] = {
            sipName_minW,
            sipName_minH,
            sipName_maxW,
            sipName_maxH,
            sipName_incW,
            sipName_incH,
        };

        if (sipParseKwdArgs(&sipParseErr, sipArgs, sipKwds, sipKwdList, SIP_NULLPTR, "Biiiiii", &sipSelf, sipType_wxAuiFloatingFrame, &sipCpp, &minW, &minH, &maxW, &maxH, &incW, &incH))
        {
            PyErr_Clear();

            Py_BEGIN_ALLOW_THREADS
            sipCpp->sipProtectVirt_DoSetSizeHints(sipSelfWasArg, minW, minH, maxW, maxH, incW, incH);
            Py_END_ALLOW_THREADS

            if (PyErr_Occurred())
                return 0;

            Py_INCREF(Py_None);
            return Py_None;
        }
    }

    sipNoMethod(sipParseErr, sipName_AuiFloatingFrame, sipName_DoSetSizeHints, doc_wxAuiFloatingFrame_DoSetSizeHints);

    return SIP_NULLPTR;
}


PyDoc_STRVAR(doc_wxAuiFloatingFrame_DoGetBorderSize, "DoGetBorderSize(self) -> Size");

extern "C" {static PyObject *meth_wxAuiFloatingFrame_DoGetBorderSize(PyObject *, PyObject *);}
static PyObject *meth_wxAuiFloatingFrame_DoGetBorderSize(PyObject *sipSelf, PyObject *sipArgs)
{
    PyObject *sipParseErr = SIP_NULLPTR;
    bool sipSelfWasArg = (!sipSelf || sipIsDerivedClass((sipSimpleWrapper *)sipSelf));

    {
        const sipwxAuiFloatingFrame *sipCpp;

        if (sipParseArgs(&sipParseErr, sipArgs, "B", &sipSelf, sipType_wxAuiFloatingFrame, &sipCpp))
        {
            ::wxSize*sipRes;

            PyErr_Clear();

            Py_BEGIN_ALLOW_THREADS
            sipRes = new ::wxSize(sipCpp->sipProtectVirt_DoGetBorderSize(sipSelfWasArg));
            Py_END_ALLOW_THREADS

            if (PyErr_Occurred())
                return 0;

            return sipConvertFromNewType(sipRes, sipType_wxSize, SIP_NULLPTR);
        }
    }

    sipNoMethod(sipParseErr, sipName_AuiFloatingFrame, sipName_DoGetBorderSize, doc_wxAuiFloatingFrame_DoGetBorderSize);

    return SIP_NULLPTR;
}


PyDoc_STRVAR(doc_wxAuiFloatingFrame_DoMoveWindow, "DoMoveWindow(self, x: int, y: int, width: int, height: int)");

extern "C" {static PyObject *meth_wxAuiFloatingFrame_DoMoveWindow(PyObject *, PyObject *, PyObject *);}
static PyObject *meth_wxAuiFloatingFrame_DoMoveWindow(PyObject *sipSelf, PyObject *sipArgs, PyObject *sipKwds)
{
    PyObject *sipParseErr = SIP_NULLPTR;
    bool sipSelfWasArg = (!sipSelf || sipIsDerivedClass((sipSimpleWrapper *)sipSelf));

    {
        int x;
        int y;
        int width;
        int height;
        sipwxAuiFloatingFrame *sipCpp;

        static const char *sipKwdList[] = {
            sipName_x,
            sipName_y,
            sipName_width,
            sipName_height,
        };

        if (sipParseKwdArgs(&sipParseErr, sipArgs, sipKwds, sipKwdList, SIP_NULLPTR, "Biiii", &sipSelf, sipType_wxAuiFloatingFrame, &sipCpp, &x, &y, &width, &height))
        {
            PyErr_Clear();

            Py_BEGIN_ALLOW_THREADS
            sipCpp->sipProtectVirt_DoMoveWindow(sipSelfWasArg, x, y, width, height);
            Py_END_ALLOW_THREADS

            if (PyErr_Occurred())
                return 0;

            Py_INCREF(Py_None);
            return Py_None;
        }
    }

    sipNoMethod(sipParseErr, sipName_AuiFloatingFrame, sipName_DoMoveWindow, doc_wxAuiFloatingFrame_DoMoveWindow);

    return SIP_NULLPTR;
}


PyDoc_STRVAR(doc_wxAuiFloatingFrame_DoSetWindowVariant, "DoSetWindowVariant(self, variant: WindowVariant)");

extern "C" {static PyObject *meth_wxAuiFloatingFrame_DoSetWindowVariant(PyObject *, PyObject *, PyObject *);}
static PyObject *meth_wxAuiFloatingFrame_DoSetWindowVariant(PyObject *sipSelf, PyObject *sipArgs, PyObject *sipKwds)
{
    PyObject *sipParseErr = SIP_NULLPTR;
    bool sipSelfWasArg = (!sipSelf || sipIsDerivedClass((sipSimpleWrapper *)sipSelf));

    {
        ::wxWindowVariant variant;
        sipwxAuiFloatingFrame *sipCpp;

        static const char *sipKwdList[] = {
            sipName_variant,
        };

        if (sipParseKwdArgs(&sipParseErr, sipArgs, sipKwds, sipKwdList, SIP_NULLPTR, "BE", &sipSelf, sipType_wxAuiFloatingFrame, &sipCpp, sipType_wxWindowVariant, &variant))
        {
            PyErr_Clear();

            Py_BEGIN_ALLOW_THREADS
            sipCpp->sipProtectVirt_DoSetWindowVariant(sipSelfWasArg, variant);
            Py_END_ALLOW_THREADS

            if (PyErr_Occurred())
                return 0;

            Py_INCREF(Py_None);
            return Py_None;
        }
    }

    sipNoMethod(sipParseErr, sipName_AuiFloatingFrame, sipName_DoSetWindowVariant, doc_wxAuiFloatingFrame_DoSetWindowVariant);

    return SIP_NULLPTR;
}


PyDoc_STRVAR(doc_wxAuiFloatingFrame_GetDefaultBorder, "GetDefaultBorder(self) -> Border");

extern "C" {static PyObject *meth_wxAuiFloatingFrame_GetDefaultBorder(PyObject *, PyObject *);}
static PyObject *meth_wxAuiFloatingFrame_GetDefaultBorder(PyObject *sipSelf, PyObject *sipArgs)
{
    PyObject *sipParseErr = SIP_NULLPTR;
    bool sipSelfWasArg = (!sipSelf || sipIsDerivedClass((sipSimpleWrapper *)sipSelf));

    {
        const sipwxAuiFloatingFrame *sipCpp;

        if (sipParseArgs(&sipParseErr, sipArgs, "B", &sipSelf, sipType_wxAuiFloatingFrame, &sipCpp))
        {
            ::wxBorder sipRes;

            PyErr_Clear();

            Py_BEGIN_ALLOW_THREADS
            sipRes = sipCpp->sipProtectVirt_GetDefaultBorder(sipSelfWasArg);
            Py_END_ALLOW_THREADS

            if (PyErr_Occurred())
                return 0;

            return sipConvertFromEnum(static_cast<int>(sipRes), sipType_wxBorder);
        }
    }

    sipNoMethod(sipParseErr, sipName_AuiFloatingFrame, sipName_GetDefaultBorder, doc_wxAuiFloatingFrame_GetDefaultBorder);

    return SIP_NULLPTR;
}


PyDoc_STRVAR(doc_wxAuiFloatingFrame_GetDefaultBorderForControl, "GetDefaultBorderForControl(self) -> Border");

extern "C" {static PyObject *meth_wxAuiFloatingFrame_GetDefaultBorderForControl(PyObject *, PyObject *);}
static PyObject *meth_wxAuiFloatingFrame_GetDefaultBorderForControl(PyObject *sipSelf, PyObject *sipArgs)
{
    PyObject *sipParseErr = SIP_NULLPTR;
    bool sipSelfWasArg = (!sipSelf || sipIsDerivedClass((sipSimpleWrapper *)sipSelf));

    {
        const sipwxAuiFloatingFrame *sipCpp;

        if (sipParseArgs(&sipParseErr, sipArgs, "B", &sipSelf, sipType_wxAuiFloatingFrame, &sipCpp))
        {
            ::wxBorder sipRes;

            PyErr_Clear();

            Py_BEGIN_ALLOW_THREADS
            sipRes = sipCpp->sipProtectVirt_GetDefaultBorderForControl(sipSelfWasArg);
            Py_END_ALLOW_THREADS

            if (PyErr_Occurred())
                return 0;

            return sipConvertFromEnum(static_cast<int>(sipRes), sipType_wxBorder);
        }
    }

    sipNoMethod(sipParseErr, sipName_AuiFloatingFrame, sipName_GetDefaultBorderForControl, doc_wxAuiFloatingFrame_GetDefaultBorderForControl);

    return SIP_NULLPTR;
}


PyDoc_STRVAR(doc_wxAuiFloatingFrame_DoFreeze, "DoFreeze(self)");

extern "C" {static PyObject *meth_wxAuiFloatingFrame_DoFreeze(PyObject *, PyObject *);}
static PyObject *meth_wxAuiFloatingFrame_DoFreeze(PyObject *sipSelf, PyObject *sipArgs)
{
    PyObject *sipParseErr = SIP_NULLPTR;
    bool sipSelfWasArg = (!sipSelf || sipIsDerivedClass((sipSimpleWrapper *)sipSelf));

    {
        sipwxAuiFloatingFrame *sipCpp;

        if (sipParseArgs(&sipParseErr, sipArgs, "B", &sipSelf, sipType_wxAuiFloatingFrame, &sipCpp))
        {
            PyErr_Clear();

            Py_BEGIN_ALLOW_THREADS
            sipCpp->sipProtectVirt_DoFreeze(sipSelfWasArg);
            Py_END_ALLOW_THREADS

            if (PyErr_Occurred())
                return 0;

            Py_INCREF(Py_None);
            return Py_None;
        }
    }

    sipNoMethod(sipParseErr, sipName_AuiFloatingFrame, sipName_DoFreeze, doc_wxAuiFloatingFrame_DoFreeze);

    return SIP_NULLPTR;
}


PyDoc_STRVAR(doc_wxAuiFloatingFrame_DoThaw, "DoThaw(self)");

extern "C" {static PyObject *meth_wxAuiFloatingFrame_DoThaw(PyObject *, PyObject *);}
static PyObject *meth_wxAuiFloatingFrame_DoThaw(PyObject *sipSelf, PyObject *sipArgs)
{
    PyObject *sipParseErr = SIP_NULLPTR;
    bool sipSelfWasArg = (!sipSelf || sipIsDerivedClass((sipSimpleWrapper *)sipSelf));

    {
        sipwxAuiFloatingFrame *sipCpp;

        if (sipParseArgs(&sipParseErr, sipArgs, "B", &sipSelf, sipType_wxAuiFloatingFrame, &sipCpp))
        {
            PyErr_Clear();

            Py_BEGIN_ALLOW_THREADS
            sipCpp->sipProtectVirt_DoThaw(sipSelfWasArg);
            Py_END_ALLOW_THREADS

            if (PyErr_Occurred())
                return 0;

            Py_INCREF(Py_None);
            return Py_None;
        }
    }

    sipNoMethod(sipParseErr, sipName_AuiFloatingFrame, sipName_DoThaw, doc_wxAuiFloatingFrame_DoThaw);

    return SIP_NULLPTR;
}


PyDoc_STRVAR(doc_wxAuiFloatingFrame_HasTransparentBackground, "HasTransparentBackground(self) -> bool");

extern "C" {static PyObject *meth_wxAuiFloatingFrame_HasTransparentBackground(PyObject *, PyObject *);}
static PyObject *meth_wxAuiFloatingFrame_HasTransparentBackground(PyObject *sipSelf, PyObject *sipArgs)
{
    PyObject *sipParseErr = SIP_NULLPTR;
    bool sipSelfWasArg = (!sipSelf || sipIsDerivedClass((sipSimpleWrapper *)sipSelf));

    {
        sipwxAuiFloatingFrame *sipCpp;

        if (sipParseArgs(&sipParseErr, sipArgs, "B", &sipSelf, sipType_wxAuiFloatingFrame, &sipCpp))
        {
            bool sipRes;

            PyErr_Clear();

            Py_BEGIN_ALLOW_THREADS
            sipRes = sipCpp->sipProtectVirt_HasTransparentBackground(sipSelfWasArg);
            Py_END_ALLOW_THREADS

            if (PyErr_Occurred())
                return 0;

            return PyBool_FromLong(sipRes);
        }
    }

    sipNoMethod(sipParseErr, sipName_AuiFloatingFrame, sipName_HasTransparentBackground, doc_wxAuiFloatingFrame_HasTransparentBackground);

    return SIP_NULLPTR;
}


PyDoc_STRVAR(doc_wxAuiFloatingFrame_TryBefore, "TryBefore(self, event: Event) -> bool");

extern "C" {static PyObject *meth_wxAuiFloatingFrame_TryBefore(PyObject *, PyObject *, PyObject *);}
static PyObject *meth_wxAuiFloatingFrame_TryBefore(PyObject *sipSelf, PyObject *sipArgs, PyObject *sipKwds)
{
    PyObject *sipParseErr = SIP_NULLPTR;
    bool sipSelfWasArg = (!sipSelf || sipIsDerivedClass((sipSimpleWrapper *)sipSelf));

    {
        ::wxEvent* event;
        sipwxAuiFloatingFrame *sipCpp;

        static const char *sipKwdList[] = {
            sipName_event,
        };

        if (sipParseKwdArgs(&sipParseErr, sipArgs, sipKwds, sipKwdList, SIP_NULLPTR, "BJ9", &sipSelf, sipType_wxAuiFloatingFrame, &sipCpp, sipType_wxEvent, &event))
        {
            bool sipRes;

            PyErr_Clear();

            Py_BEGIN_ALLOW_THREADS
            sipRes = sipCpp->sipProtectVirt_TryBefore(sipSelfWasArg, *event);
            Py_END_ALLOW_THREADS

            if (PyErr_Occurred())
                return 0;

            return PyBool_FromLong(sipRes);
        }
    }

    sipNoMethod(sipParseErr, sipName_AuiFloatingFrame, sipName_TryBefore, doc_wxAuiFloatingFrame_TryBefore);

    return SIP_NULLPTR;
}


PyDoc_STRVAR(doc_wxAuiFloatingFrame_TryAfter, "TryAfter(self, event: Event) -> bool");

extern "C" {static PyObject *meth_wxAuiFloatingFrame_TryAfter(PyObject *, PyObject *, PyObject *);}
static PyObject *meth_wxAuiFloatingFrame_TryAfter(PyObject *sipSelf, PyObject *sipArgs, PyObject *sipKwds)
{
    PyObject *sipParseErr = SIP_NULLPTR;
    bool sipSelfWasArg = (!sipSelf || sipIsDerivedClass((sipSimpleWrapper *)sipSelf));

    {
        ::wxEvent* event;
        sipwxAuiFloatingFrame *sipCpp;

        static const char *sipKwdList[] = {
            sipName_event,
        };

        if (sipParseKwdArgs(&sipParseErr, sipArgs, sipKwds, sipKwdList, SIP_NULLPTR, "BJ9", &sipSelf, sipType_wxAuiFloatingFrame, &sipCpp, sipType_wxEvent, &event))
        {
            bool sipRes;

            PyErr_Clear();

            Py_BEGIN_ALLOW_THREADS
            sipRes = sipCpp->sipProtectVirt_TryAfter(sipSelfWasArg, *event);
            Py_END_ALLOW_THREADS

            if (PyErr_Occurred())
                return 0;

            return PyBool_FromLong(sipRes);
        }
    }

    sipNoMethod(sipParseErr, sipName_AuiFloatingFrame, sipName_TryAfter, doc_wxAuiFloatingFrame_TryAfter);

    return SIP_NULLPTR;
}


PyDoc_STRVAR(doc_wxAuiFloatingFrame_SetPaneWindow, "SetPaneWindow(pane)");

extern "C" {static PyObject *meth_wxAuiFloatingFrame_SetPaneWindow(PyObject *, PyObject *, PyObject *);}
static PyObject *meth_wxAuiFloatingFrame_SetPaneWindow(PyObject *sipSelf, PyObject *sipArgs, PyObject *sipKwds)
{
    PyObject *sipParseErr = SIP_NULLPTR;

    {
        const ::wxAuiPaneInfo* pane;
        ::wxAuiFloatingFrame *sipCpp;

        static const char *sipKwdList[] = {
            sipName_pane,
        };

        if (sipParseKwdArgs(&sipParseErr, sipArgs, sipKwds, sipKwdList, SIP_NULLPTR, "BJ9", &sipSelf, sipType_wxAuiFloatingFrame, &sipCpp, sipType_wxAuiPaneInfo, &pane))
        {
            PyErr_Clear();

            Py_BEGIN_ALLOW_THREADS
            sipCpp->SetPaneWindow(*pane);
            Py_END_ALLOW_THREADS

            if (PyErr_Occurred())
                return 0;

            Py_INCREF(Py_None);
            return Py_None;
        }
    }

    sipNoMethod(sipParseErr, sipName_AuiFloatingFrame, sipName_SetPaneWindow, SIP_NULLPTR);

    return SIP_NULLPTR;
}


PyDoc_STRVAR(doc_wxAuiFloatingFrame_GetOwnerManager, "GetOwnerManager() -> AuiManager");

extern "C" {static PyObject *meth_wxAuiFloatingFrame_GetOwnerManager(PyObject *, PyObject *);}
static PyObject *meth_wxAuiFloatingFrame_GetOwnerManager(PyObject *sipSelf, PyObject *sipArgs)
{
    PyObject *sipParseErr = SIP_NULLPTR;

    {
        const ::wxAuiFloatingFrame *sipCpp;

        if (sipParseArgs(&sipParseErr, sipArgs, "B", &sipSelf, sipType_wxAuiFloatingFrame, &sipCpp))
        {
            ::wxAuiManager*sipRes;

            PyErr_Clear();

            Py_BEGIN_ALLOW_THREADS
            sipRes = sipCpp->GetOwnerManager();
            Py_END_ALLOW_THREADS

            if (PyErr_Occurred())
                return 0;

            return sipConvertFromType(sipRes, sipType_wxAuiManager, SIP_NULLPTR);
        }
    }

    sipNoMethod(sipParseErr, sipName_AuiFloatingFrame, sipName_GetOwnerManager, SIP_NULLPTR);

    return SIP_NULLPTR;
}


PyDoc_STRVAR(doc_wxAuiFloatingFrame_GetAuiManager, "GetAuiManager() -> AuiManager\n"
"\n"
"Returns the embedded wxAuiManager managing this floating pane's\n"
"contents.");

extern "C" {static PyObject *meth_wxAuiFloatingFrame_GetAuiManager(PyObject *, PyObject *);}
static PyObject *meth_wxAuiFloatingFrame_GetAuiManager(PyObject *sipSelf, PyObject *sipArgs)
{
    PyObject *sipParseErr = SIP_NULLPTR;

    {
        ::wxAuiFloatingFrame *sipCpp;

        if (sipParseArgs(&sipParseErr, sipArgs, "B", &sipSelf, sipType_wxAuiFloatingFrame, &sipCpp))
        {
            ::wxAuiManager*sipRes;

            PyErr_Clear();

            Py_BEGIN_ALLOW_THREADS
            sipRes = &sipCpp->GetAuiManager();
            Py_END_ALLOW_THREADS

            if (PyErr_Occurred())
                return 0;

            return sipConvertFromType(sipRes, sipType_wxAuiManager, SIP_NULLPTR);
        }
    }

    sipNoMethod(sipParseErr, sipName_AuiFloatingFrame, sipName_GetAuiManager, SIP_NULLPTR);

    return SIP_NULLPTR;
}


/* Cast a pointer to a type somewhere in its inheritance hierarchy. */
extern "C" {static void *cast_wxAuiFloatingFrame(void *, const sipTypeDef *);}
static void *cast_wxAuiFloatingFrame(void *sipCppV, const sipTypeDef *targetType)
{
    ::wxAuiFloatingFrame *sipCpp = reinterpret_cast< ::wxAuiFloatingFrame *>(sipCppV);

    if (targetType == sipType_wxAuiFloatingFrame)
        return sipCppV;

    sipCppV = ((const sipClassTypeDef *)sipType_wxFrame)->ctd_cast(static_cast< ::wxFrame *>(sipCpp), targetType);
    if (sipCppV)
        return sipCppV;

    return SIP_NULLPTR;
}


/* Call the instance's destructor. */
extern "C" {static void release_wxAuiFloatingFrame(void *, int);}
static void release_wxAuiFloatingFrame(void *sipCppV, int sipState)
{
    Py_BEGIN_ALLOW_THREADS

    if (sipState & SIP_DERIVED_CLASS)
        delete reinterpret_cast<sipwxAuiFloatingFrame *>(sipCppV);
    else
        delete reinterpret_cast< ::wxAuiFloatingFrame *>(sipCppV);

    Py_END_ALLOW_THREADS
}


extern "C" {static void dealloc_wxAuiFloatingFrame(sipSimpleWrapper *);}
static void dealloc_wxAuiFloatingFrame(sipSimpleWrapper *sipSelf)
{
    if (sipIsDerivedClass(sipSelf))
        reinterpret_cast<sipwxAuiFloatingFrame *>(sipGetAddress(sipSelf))->sipPySelf = SIP_NULLPTR;

    if (sipIsOwnedByPython(sipSelf))
    {
        release_wxAuiFloatingFrame(sipGetAddress(sipSelf), sipIsDerivedClass(sipSelf));
    }
}


extern "C" {static void *init_type_wxAuiFloatingFrame(sipSimpleWrapper *, PyObject *, PyObject *, PyObject **, PyObject **, PyObject **);}
static void *init_type_wxAuiFloatingFrame(sipSimpleWrapper *sipSelf, PyObject *sipArgs, PyObject *sipKwds, PyObject **sipUnused, PyObject **, PyObject **sipParseErr)
{
    sipwxAuiFloatingFrame *sipCpp = SIP_NULLPTR;

    {
        ::wxWindow* parent;
        ::wxAuiManager* ownerMgr;
        const ::wxAuiPaneInfo* pane;
        ::wxWindowID id = wxID_ANY;
        long style = wxRESIZE_BORDER|wxSYSTEM_MENU|wxCAPTION|wxFRAME_NO_TASKBAR|wxFRAME_FLOAT_ON_PARENT|wxCLIP_CHILDREN;

        static const char *sipKwdList[] = {
            sipName_parent,
            sipName_ownerMgr,
            sipName_pane,
            sipName_id,
            sipName_style,
        };

        if (sipParseKwdArgs(sipParseErr, sipArgs, sipKwds, sipKwdList, sipUnused, "J8J8J9|il", sipType_wxWindow, &parent, sipType_wxAuiManager, &ownerMgr, sipType_wxAuiPaneInfo, &pane, &id, &style))
        {
            PyErr_Clear();

            Py_BEGIN_ALLOW_THREADS
            sipCpp = new sipwxAuiFloatingFrame(parent, ownerMgr, *pane, id, style);
            Py_END_ALLOW_THREADS

            if (PyErr_Occurred())
            {
                delete sipCpp;
                return SIP_NULLPTR;
            }

            sipCpp->sipPySelf = sipSelf;

            return sipCpp;
        }
    }

    return SIP_NULLPTR;
}


/* Define this type's super-types. */
static sipEncodedTypeDef supers_wxAuiFloatingFrame[] = {{13, 0, 1}};


static PyMethodDef methods_wxAuiFloatingFrame[] = {
    {sipName_DoEnable, SIP_MLMETH_CAST(meth_wxAuiFloatingFrame_DoEnable), METH_VARARGS|METH_KEYWORDS, SIP_NULLPTR},
    {sipName_DoFreeze, meth_wxAuiFloatingFrame_DoFreeze, METH_VARARGS, SIP_NULLPTR},
    {sipName_DoGetBestClientSize, meth_wxAuiFloatingFrame_DoGetBestClientSize, METH_VARARGS, SIP_NULLPTR},
    {sipName_DoGetBestSize, meth_wxAuiFloatingFrame_DoGetBestSize, METH_VARARGS, SIP_NULLPTR},
    {sipName_DoGetBorderSize, meth_wxAuiFloatingFrame_DoGetBorderSize, METH_VARARGS, SIP_NULLPTR},
    {sipName_DoGetClientSize, SIP_MLMETH_CAST(meth_wxAuiFloatingFrame_DoGetClientSize), METH_VARARGS|METH_KEYWORDS, SIP_NULLPTR},
    {sipName_DoGetPosition, SIP_MLMETH_CAST(meth_wxAuiFloatingFrame_DoGetPosition), METH_VARARGS|METH_KEYWORDS, SIP_NULLPTR},
    {sipName_DoGetSize, SIP_MLMETH_CAST(meth_wxAuiFloatingFrame_DoGetSize), METH_VARARGS|METH_KEYWORDS, SIP_NULLPTR},
    {sipName_DoMoveWindow, SIP_MLMETH_CAST(meth_wxAuiFloatingFrame_DoMoveWindow), METH_VARARGS|METH_KEYWORDS, SIP_NULLPTR},
    {sipName_DoSetClientSize, SIP_MLMETH_CAST(meth_wxAuiFloatingFrame_DoSetClientSize), METH_VARARGS|METH_KEYWORDS, SIP_NULLPTR},
    {sipName_DoSetSize, SIP_MLMETH_CAST(meth_wxAuiFloatingFrame_DoSetSize), METH_VARARGS|METH_KEYWORDS, SIP_NULLPTR},
    {sipName_DoSetSizeHints, SIP_MLMETH_CAST(meth_wxAuiFloatingFrame_DoSetSizeHints), METH_VARARGS|METH_KEYWORDS, SIP_NULLPTR},
    {sipName_DoSetWindowVariant, SIP_MLMETH_CAST(meth_wxAuiFloatingFrame_DoSetWindowVariant), METH_VARARGS|METH_KEYWORDS, SIP_NULLPTR},
    {sipName_DoThaw, meth_wxAuiFloatingFrame_DoThaw, METH_VARARGS, SIP_NULLPTR},
    {sipName_GetAuiManager, meth_wxAuiFloatingFrame_GetAuiManager, METH_VARARGS, doc_wxAuiFloatingFrame_GetAuiManager},
    {sipName_GetDefaultBorder, meth_wxAuiFloatingFrame_GetDefaultBorder, METH_VARARGS, SIP_NULLPTR},
    {sipName_GetDefaultBorderForControl, meth_wxAuiFloatingFrame_GetDefaultBorderForControl, METH_VARARGS, SIP_NULLPTR},
    {sipName_GetOwnerManager, meth_wxAuiFloatingFrame_GetOwnerManager, METH_VARARGS, doc_wxAuiFloatingFrame_GetOwnerManager},
    {sipName_HasTransparentBackground, meth_wxAuiFloatingFrame_HasTransparentBackground, METH_VARARGS, SIP_NULLPTR},
    {sipName_ProcessEvent, SIP_MLMETH_CAST(meth_wxAuiFloatingFrame_ProcessEvent), METH_VARARGS|METH_KEYWORDS, SIP_NULLPTR},
    {sipName_SendDestroyEvent, meth_wxAuiFloatingFrame_SendDestroyEvent, METH_VARARGS, SIP_NULLPTR},
    {sipName_SetPaneWindow, SIP_MLMETH_CAST(meth_wxAuiFloatingFrame_SetPaneWindow), METH_VARARGS|METH_KEYWORDS, doc_wxAuiFloatingFrame_SetPaneWindow},
    {sipName_TryAfter, SIP_MLMETH_CAST(meth_wxAuiFloatingFrame_TryAfter), METH_VARARGS|METH_KEYWORDS, SIP_NULLPTR},
    {sipName_TryBefore, SIP_MLMETH_CAST(meth_wxAuiFloatingFrame_TryBefore), METH_VARARGS|METH_KEYWORDS, SIP_NULLPTR}
};

sipVariableDef variables_wxAuiFloatingFrame[] = {
    {PropertyVariable, sipName_OwnerManager, &methods_wxAuiFloatingFrame[17], SIP_NULLPTR, SIP_NULLPTR, SIP_NULLPTR},
    {PropertyVariable, sipName_AuiManager, &methods_wxAuiFloatingFrame[14], SIP_NULLPTR, SIP_NULLPTR, SIP_NULLPTR},
};

PyDoc_STRVAR(doc_wxAuiFloatingFrame, "AuiFloatingFrame(parent, ownerMgr, pane, id=wx.ID_ANY, style=wx.RESIZE_BORDER|wx.SYSTEM_MENU|wx.CAPTION|wx.FRAME_NO_TASKBAR|wx.FRAME_FLOAT_ON_PARENT|wx.CLIP_CHILDREN)");


sipClassTypeDef sipTypeDef__aui_wxAuiFloatingFrame = {
    {
        -1,
        SIP_NULLPTR,
        SIP_NULLPTR,
        SIP_TYPE_SCC|SIP_TYPE_CLASS,
        sipNameNr_wxAuiFloatingFrame,
        SIP_NULLPTR,
        SIP_NULLPTR,
    },
    {
        sipNameNr_AuiFloatingFrame,
        {0, 0, 1},
        24, methods_wxAuiFloatingFrame,
        0, SIP_NULLPTR,
        2, variables_wxAuiFloatingFrame,
        {SIP_NULLPTR, SIP_NULLPTR, SIP_NULLPTR, SIP_NULLPTR, SIP_NULLPTR, SIP_NULLPTR, SIP_NULLPTR, SIP_NULLPTR, SIP_NULLPTR, SIP_NULLPTR},
    },
    doc_wxAuiFloatingFrame,
    -1,
    -1,
    supers_wxAuiFloatingFrame,
    SIP_NULLPTR,
    init_type_wxAuiFloatingFrame,
    SIP_NULLPTR,
    SIP_NULLPTR,
    SIP_NULLPTR,
    SIP_NULLPTR,
    dealloc_wxAuiFloatingFrame,
    SIP_NULLPTR,
    SIP_NULLPTR,
    SIP_NULLPTR,
    release_wxAuiFloatingFrame,
    cast_wxAuiFloatingFrame,
    SIP_NULLPTR,
    SIP_NULLPTR,
    SIP_NULLPTR,
    SIP_NULLPTR,
    SIP_NULLPTR,
    SIP_NULLPTR,
    SIP_NULLPTR,
    sizeof (::wxAuiFloatingFrame),
};
